ASAP2_VERSION 1 51
/begin PROJECT EUP ""
/begin MODULE CPP ""
/begin MOD_COMMON "" BYTE_ORDER MSB_FIRST ALIGNMENT_BYTE 1 ALIGNMENT_WORD 2 ALIGNMENT_LONG 4 ALIGNMENT_FLOAT32_IEEE 4 ALIGNMENT_FLOAT64_IEEE 8 /end MOD_COMMON
/begin IF_DATA ASAP1B_CCP
 /begin SOURCE "10ms" 0x4 0x1
  /begin QP_BLOB 0x0 LENGTH 0x14 CAN_ID_FIXED 0x101 RASTER 0x0 FIRST_PID 0x0 /end QP_BLOB
 /end SOURCE
 /begin SOURCE "100ms" 0x4 0xA
  /begin QP_BLOB 0x1 LENGTH 0x14 CAN_ID_FIXED 0x101 RASTER 0x1 FIRST_PID 0x14 /end QP_BLOB
 /end SOURCE
 /begin RASTER "10ms" "10ms" 0x0 0x4 0x1 /end RASTER
 /begin RASTER "100ms" "100ms" 0x1 0x4 0xA /end RASTER
 /begin TP_BLOB 0x201 0x206 0x100 0x101 0x100 0x1 BAUDRATE 0x3D090 SAMPLE_POINT 0x4B SAMPLE_RATE 0x1 BTL_CYCLES 0x8 SJW 0x2 SYNC_EDGE SINGLE DAQ_MODE BURST CONSISTENCY ODT ADDRESS_EXTENSION DAQ /begin CHECKSUM_PARAM 0xFFFF8007 0x10000 CHECKSUM_CALCULATION ACTIVE_PAGE /end CHECKSUM_PARAM /begin DEFINED_PAGES 0x1 "ROM_PAGE" 0x0 0x7D0000 0x4000 ROM /end DEFINED_PAGES /begin DEFINED_PAGES 0x2 "RAM" 0x0 0xF0000 0x4000 RAM RAM_INIT_BY_ECU /end DEFINED_PAGES OPTIONAL_CMD 0x9 OPTIONAL_CMD 0xE OPTIONAL_CMD 0x11 OPTIONAL_CMD 0xC OPTIONAL_CMD 0xD OPTIONAL_CMD 0xF OPTIONAL_CMD 0x23 OPTIONAL_CMD 0x8 /end TP_BLOB
/end IF_DATA
/begin MOD_PAR "整车控制器105E" ADDR_EPK 0x13F6A7 NO_OF_INTERFACES 1
 /begin MEMORY_SEGMENT EFLASHDATA "" DATA FLASH EXTERN 0x7D0000 0x4000 -1 -1 -1 -1 -1 /end MEMORY_SEGMENT
 /begin MEMORY_SEGMENT ERAMDATA "" DATA RAM EXTERN 0xF0000 0x4000 -1 -1 -1 -1 -1 /end MEMORY_SEGMENT
/end MOD_PAR
/begin COMPU_VTAB EGR_NOX "" TAB_VERB 5 0 "OK" 1 "Below3" 2 "Over3Below5" 3 "Over5Below7" 4 "Over7" /end COMPU_VTAB
/begin COMPU_VTAB EGR_OBD "" TAB_VERB 2 0 "OK" 1 "STUCK" /end COMPU_VTAB
/begin COMPU_VTAB EGR_VALVE "" TAB_VERB 2 0 "OK" 1 "STUCK" /end COMPU_VTAB
/begin COMPU_VTAB bCondition "" TAB_VERB 2 0 "否(No)" 1 "是(Yes)" DEFAULT_VALUE "0" /end COMPU_VTAB
/begin COMPU_VTAB bFunctionActive "" TAB_VERB 2 0 "功能禁止(Inactive)" 1 "功能启用(Active)" /end COMPU_VTAB
/begin COMPU_VTAB bSwitch "开关" TAB_VERB 2 0 "关(Close)" 1 "开(Open)" /end COMPU_VTAB
/begin COMPU_VTAB idxAccPedType "油门类型" TAB_VERB 4 0 "不配备(Without)" 1 "双油门(Dual Analog)" 2 "带怠速开关(With Idle Switch)" 3 "单油门(Single Analog)" /end COMPU_VTAB
/begin COMPU_VTAB idxAirHeaterTempSel "进气加热温度选择情况" TAB_VERB 6 0 "机油温度(Oil Temperature)" 1 "进气温度(Intake Air Temperature)" 2 "燃油温度(Fuel Temperature)" 3 "环境温度(Environment Temperature)" 4 "冷却水温(Coolant Temperature)" 255 "没有选中(None)" /end COMPU_VTAB
/begin COMPU_VTAB idxDDRCType "" TAB_VERB 4 0 "TimeInRow" 1 "EventInRow" 2 "TimeUpDown" 3 "EventUpDown" DEFAULT_VALUE "TimeInRow" /end COMPU_VTAB
/begin COMPU_VTAB idxDFC "" TAB_VERB 151 0 "无故障(None)" 1 "曲轴信号缺失(Crankshaft No Sig)" 2 "曲轴信号错误(Crankshaft Err Sig)" 3 "凸轮轴信号缺失(Camshaft No Sig)" 4 "凸轮轴信号错误(Camshaft Err Sig)" 5 "未知名故障(Unkown)" 6 "未知名故障(Unkown)" 7 "未知名故障(Unkown)" 8 "未知名故障(Unkown)" 9 "未知名故障(Unkown)" 10 "未知名故障(Unkown)" 11 "大气压力SRC高(APS SRC High)" 12 "大气压力SRC低(APS SRC Low)" 13 "大气压力合理性故障(APS Npl)" 14 "增压压力SRC高(BPS SRC High)" 15 "增压压力SRC低(BPS SRC Low)" 16 "增压压力合理性故障(BPS Npl)" 17 "增压温度SRC高(IATS SRC High)" 18 "增压温度SRC低(IATS SRC Low)" 19 "冷却水温SRC高(CTS SRC High)" 20 "冷却水温SRC低(CTS SRC Low)" 21 "冷却水温合理性故障(CTS Npl )" 22 "冷却水温动态测试故障(CTS DynTest Err)" 23 "燃油温度SRC高(FTS SRC High)" 24 "燃油温度SRC低(FTS SRC Low)" 25 "油门踏板1SRC高(AccPed1 SRC High)" 26 "油门踏板1SRC低(AccPed1 SRC Low)" 27 "油门踏板1合理性故障(AccPed1 Npl)" 28 "油门踏板2SRC高(AccPed2 SRC High)'" 29 "油门踏板2SRC低(AccPed2 SRC Low)" 30 "油门踏板2合理性故障(AccPed2 Npl)" 31 "环境温度SRC高(ETS SRC High)" 32 "环境温度SRC低(ETS SRC Low)" 33 "机油压力SRC高(OPS SRC High)" 34 "机油压力SRC低(OPS SRC Low)" 35 "机油压力合理性低故障(OPS LNpl)" 36 "机油压力合理性高故障(OPS HNpl)" 37 "机油温度SRC高(OTS SRC Sigh)" 38 "机油温度SRC低(OTS SRC Low)" 39 "机油温度合理性故障(OTS Npl)" 40 "机油温度超过最大值(OTS SIGMax)" 41 "EGR位置传感器SRC高" 42 "EGR位置传感器SRC低" 43 "POC压差传感器SRC高" 44 "POC压差传感器SRC低" 45 "轨压传感器SRC高" 46 "轨压传感器SRC低" 47 "未知名故障(Unkown)" 48 "未知名故障(Unkown)" 49 "未知名故障(Unkown)" 50 "未知名故障(Unkown)" 51 "第一缸短路(Cyl1 ShortCircuit)" 52 "第一缸断路(Cyl1 OpenLoad)" 53 "第一缸不合理(Cyl1 Npl)" 54 "第二缸短路(Cyl2 ShortCircuit)" 55 "第二缸断路(Cyl2 OpenLoad)" 56 "第二缸不合理(Cyl2 Npl)" 57 "第三缸短路(Cyl3 ShortCircuit)" 58 "第三缸断路(Cyl3 OpenLoad)" 59 "第三缸不合理(Cyl3 Npl)" 60 "第四缸短路(Cyl4 ShortCircuit)" 61 "第四缸断路(Cyl4 OpenLoad)" 62 "第四缸不合理(Cyl4 Npl)" 63 "第五缸短路(Cyl5 ShortCircuit)" 64 "第五缸断路(Cyl5 OpenLoad)" 65 "第五缸不合理(Cyl5 Npl)" 66 "第六缸短路(Cyl6 ShortCircuit)" 67 "第六缸断路(Cyl6 OpenLoad)" 68 "第六缸不合理(Cyl6 Npl)" 69 "第一缸无始点(Cyl1 BIT No)" 70 "第一缸无始点(Cyl1 BIT Npl)" 71 "第二缸无始点(Cy12 BIT No)" 72 "第二缸始点不合理(Cy12 BIT Err)" 73 "第三缸无始点(Cy13 BIT No)" 74 "第三缸始点不合理(Cy13 BIT Npl)" 75 "第四缸无始点(Cy14 BIT No)" 76 "第四缸始点不合理(Cy14 BIT Err)" 77 "第五缸无始点(Cy15 BIT No)" 78 "第五缸始点不合理(Cy15 BIT Err)" 79 "第六缸无始点(Cy16 BIT No)" 80 "第六缸始点不合理(Cy16 BIT Err)" 81 "空调继电器短路(AC Relay ShortCircuit)" 82 "空调继电器断路(AC Relay OpenLoad)" 83 "排气制动阀短路(EB Realy ShortCircuit)" 84 "排气制动阀断路(EB Relay OpenLoad)" 85 "排气制动指示灯短路(EB Lamp ShortCircuit)" 86 "排气制动指示灯断路(EB Lamp OpenLoad)" 87 "进气加热继电器短路(CS Realy ShortCircuit)" 88 "进气加热继电器断路(CS Realy Openload)" 89 "进气加热指示灯短路(CS Lamp ShortCircuit)" 90 "进气加热指示灯断路(CS Lamp OpenLoad)" 91 "OBD故障灯短路(OBD Lamp ShortCircuit)" 92 "OBD故障灯断路(OBD Lamp OpenLoad)" 93 "SVS灯短路(SVS Lamp ShortCircuit)" 94 "SVS灯断路(SVS Lamp OpenLoad)" 95 "主继电器短路(MainRelay ShortCircuit)" 96 "主继电器断路(MainRelay OpenCircuit)" 97 "EGR电机供电故障" 98 "EGR电机短路到电源" 99 "EGR电机短路到地" 100 "EGR电机开路" 101 "EGR电机过热" 102 "EGR阀流量过大" 103 "EGR阀NOx限值1超标" 104 "EGR阀NOx限值2超标" 105 "DOC/POC压差故障" 106 "轨压控制器正偏差超过上限" 107 "轨压控制器负偏差超过下限" 108 "高压油泵油量过大" 109 "油压低于下限" 110 "油压高于上限" 111 "怠速时轨压控制器开度不合适" 112 "未知名故障(Unkown)" 113 "未知名故障(Unkown)" 114 "未知名故障(Unkown)" 115 "未知名故障(Unkown)" 116 "未知名故障(Unkown)" 117 "未知名故障(Unkown)" 118 "未知名故障(Unkown)" 119 "未知名故障(Unkown)" 120 "未知名故障(Unkown)" 121 "EEPROM不可用(EEPROM Defect)" 122 "部分EEPROM不可用(EEPROM Preliminary Defect)" 123 "AD参考电压过高(AD Reference High)" 124 "AD参考电压过低(AD Reference Low)" 125 "未知名故障(Unkown)" 126 "未知名故障(Unkown)" 127 "未知名故障(Unkown)" 128 "未知名故障(Unkown)" 129 "未知名故障(Unkown)" 130 "未知名故障(Unkown)" 131 "未知名故障(Unkown)" 132 "未知名故障(Unkown)" 133 "未知名故障(Unkown)" 134 "未知名故障(Unkown)" 135 "未知名故障(Unkown)" 136 "未知名故障(Unkown)" 137 "未知名故障(Unkown)" 138 "未知名故障(Unkown)" 139 "未知名故障(Unkown)" 140 "未知名故障(Unkown)" 141 "电池电压高(Battery Voltage High)" 142 "电池电压低(Battery Voltage Low)" 143 "DCDC电压高(DCDC Voltage High)" 144 "DCDC电压低(DCDC Voltage Low)" 145 "DCDC电压不合理(DCDC Voltage Npl)" 146 "未知名故障(Unkown)" 147 "未知名故障(Unkown)" 148 "未知名故障(Unkown)" 149 "未知名故障(Unkown)" 150 "未知名故障(Unkown)" DEFAULT_VALUE "未知名故障(Unkown)" /end COMPU_VTAB
/begin COMPU_VTAB idxDFC2 "" TAB_VERB 151 0 "曲轴信号缺失(Crankshaft No Sig)" 1 "曲轴信号错误(Crankshaft Err Sig)" 2 "凸轮轴信号缺失(Camshaft No Sig)" 3 "凸轮轴信号错误(Camshaft Err Sig)" 4 "未知名故障(Unkown)" 5 "未知名故障(Unkown)" 6 "未知名故障(Unkown)" 7 "未知名故障(Unkown)" 8 "未知名故障(Unkown)" 9 "未知名故障(Unkown)" 10 "大气压力SRC高(APS SRC High)" 11 "大气压力SRC低(APS SRC Low)" 12 "大气压力合理性故障(APS Npl)" 13 "增压压力SRC高(BPS SRC High)" 14 "增压压力SRC低(BPS SRC Low)" 15 "增压压力合理性故障(BPS Npl)" 16 "增压温度SRC高(IATS SRC High)" 17 "增压温度SRC低(IATS SRC Low)" 18 "冷却水温SRC高(CTS SRC High)" 19 "冷却水温SRC低(CTS SRC Low)" 20 "冷却水温合理性故障(CTS Npl )" 21 "冷却水温动态测试故障(CTS DynTest Err)" 22 "燃油温度SRC高(FTS SRC High)" 23 "燃油温度SRC低(FTS SRC Low)" 24 "油门踏板1SRC高(AccPed1 SRC High)" 25 "油门踏板1SRC低(AccPed1 SRC Low)" 26 "油门踏板1合理性故障(AccPed1 Npl)" 27 "油门踏板2SRC高(AccPed2 SRC High)'" 28 "油门踏板2SRC低(AccPed2 SRC Low)" 29 "油门踏板2合理性故障(AccPed2 Npl)" 30 "环境温度SRC高(ETS SRC High)" 31 "环境温度SRC低(ETS SRC Low)" 32 "机油压力SRC高(OPS SRC High)" 33 "机油压力SRC低(OPS SRC Low)" 34 "机油压力合理性低故障(OPS LNpl)" 35 "机油压力合理性高故障(OPS HNpl)" 36 "机油温度SRC高(OTS SRC Sigh)" 37 "机油温度SRC低(OTS SRC Low)" 38 "机油温度合理性故障(OTS Npl)" 39 "机油温度超过最大值(OTS SIGMax)" 40 "EGR位置传感器SRC高" 41 "EGR位置传感器SRC低" 42 "POC压差传感器SRC高" 43 "POC压差传感器SRC低" 44 "轨压传感器SRC高" 45 "轨压传感器SRC低" 46 "未知名故障(Unkown)" 47 "未知名故障(Unkown)" 48 "未知名故障(Unkown)" 49 "未知名故障(Unkown)" 50 "第一缸短路(Cyl1 ShortCircuit)" 51 "第一缸断路(Cyl1 OpenLoad)" 52 "第一缸不合理(Cyl1 Npl)" 53 "第二缸短路(Cyl2 ShortCircuit)" 54 "第二缸断路(Cyl2 OpenLoad)" 55 "第二缸不合理(Cyl2 Npl)" 56 "第三缸短路(Cyl3 ShortCircuit)" 57 "第三缸断路(Cyl3 OpenLoad)" 58 "第三缸不合理(Cyl3 Npl)" 59 "第四缸短路(Cyl4 ShortCircuit)" 60 "第四缸断路(Cyl4 OpenLoad)" 61 "第四缸不合理(Cyl4 Npl)" 62 "第五缸短路(Cyl5 ShortCircuit)" 63 "第五缸断路(Cyl5 OpenLoad)" 64 "第五缸不合理(Cyl5 Npl)" 65 "第六缸短路(Cyl6 ShortCircuit)" 66 "第六缸断路(Cyl6 OpenLoad)" 67 "第六缸不合理(Cyl6 Npl)" 68 "第一缸无始点(Cyl1 BIT No)" 69 "第一缸无始点(Cyl1 BIT Npl)" 70 "第二缸无始点(Cy12 BIT No)" 71 "第二缸始点不合理(Cy12 BIT Err)" 72 "第三缸无始点(Cy13 BIT No)" 73 "第三缸始点不合理(Cy13 BIT Npl)" 74 "第四缸无始点(Cy14 BIT No)" 75 "第四缸始点不合理(Cy14 BIT Err)" 76 "第五缸无始点(Cy15 BIT No)" 77 "第五缸始点不合理(Cy15 BIT Err)" 78 "第六缸无始点(Cy16 BIT No)" 79 "第六缸始点不合理(Cy16 BIT Err)" 80 "空调继电器短路(AC Relay ShortCircuit)" 81 "空调继电器断路(AC Relay OpenLoad)" 82 "排气制动阀短路(EB Realy ShortCircuit)" 83 "排气制动阀断路(EB Relay OpenLoad)" 84 "排气制动指示灯短路(EB Lamp ShortCircuit)" 85 "排气制动指示灯断路(EB Lamp OpenLoad)" 86 "进气加热继电器短路(CS Realy ShortCircuit)" 87 "进气加热继电器断路(CS Realy Openload)" 88 "进气加热指示灯短路(CS Lamp ShortCircuit)" 89 "进气加热指示灯断路(CS Lamp OpenLoad)" 90 "OBD故障灯短路(OBD Lamp ShortCircuit)" 91 "OBD故障灯断路(OBD Lamp OpenLoad)" 92 "SVS灯短路(SVS Lamp ShortCircuit)" 93 "SVS灯断路(SVS Lamp OpenLoad)" 94 "主继电器短路(MainRelay ShortCircuit)" 95 "主继电器断路(MainRelay OpenCircuit)" 96 "EGR电机供电故障" 97 "EGR电机短路到电源" 98 "EGR电机短路到地" 99 "EGR电机开路" 100 "EGR电机过热" 101 "EGR阀流量过大" 102 "EGR阀NOx限值1超标" 103 "EGR阀NOx限值2超标" 104 "DOC/POC压差故障" 105 "轨压控制器正偏差超过上限" 106 "轨压控制器负偏差超过下限" 107 "高压油泵油量过大" 108 "油压低于下限" 109 "油压高于上限" 110 "怠速时轨压控制器开度不合适" 111 "未知名故障(Unkown)" 112 "未知名故障(Unkown)" 113 "未知名故障(Unkown)" 114 "未知名故障(Unkown)" 115 "未知名故障(Unkown)" 116 "未知名故障(Unkown)" 117 "未知名故障(Unkown)" 118 "未知名故障(Unkown)" 119 "未知名故障(Unkown)" 120 "EEPROM不可用(EEPROM Defect)" 121 "部分EEPROM不可用(EEPROM Preliminary Defect)" 122 "AD参考电压过高(AD Reference High)" 123 "AD参考电压过低(AD Reference Low)" 124 "未知名故障(Unkown)" 125 "未知名故障(Unkown)" 126 "未知名故障(Unkown)" 127 "未知名故障(Unkown)" 128 "未知名故障(Unkown)" 129 "未知名故障(Unkown)" 130 "未知名故障(Unkown)" 131 "未知名故障(Unkown)" 132 "未知名故障(Unkown)" 133 "未知名故障(Unkown)" 134 "未知名故障(Unkown)" 135 "未知名故障(Unkown)" 136 "未知名故障(Unkown)" 137 "未知名故障(Unkown)" 138 "未知名故障(Unkown)" 139 "未知名故障(Unkown)" 140 "电池电压高(Battery Voltage High)" 141 "电池电压低(Battery Voltage Low)" 142 "DCDC电压高(DCDC Voltage High)" 143 "DCDC电压低(DCDC Voltage Low)" 144 "DCDC电压不合理(DCDC Voltage Npl)" 145 "未知名故障(Unkown)" 146 "未知名故障(Unkown)" 147 "未知名故障(Unkown)" 148 "未知名故障(Unkown)" 149 "未知名故障(Unkown)" 65535 "DFC_Notused" DEFAULT_VALUE "DFC_Notused" /end COMPU_VTAB
/begin COMPU_VTAB idxDINHLevel "" TAB_VERB 21 0 "LevlNotUsed" 1 "Tested" 2 "NotTested" 3 "Def0Deb0" 4 "Def25Deb0" 5 "Def50Deb0" 6 "Def50Deb25" 7 "Def50Deb50" 8 "Def50Deb75" 9 "Def50Deb100" 10 "Def75Deb0" 11 "Def75Deb25" 12 "Def75Deb50" 13 "Def75Deb75" 14 "Def75Deb100" 15 "Def1000Deb0" 16 "Def100Deb25" 17 "Def100Deb50" 18 "Def100Deb75" 19 "Def100Deb100" 20 "MemoryEntryStatus" DEFAULT_VALUE "LevlNotUsed" /end COMPU_VTAB
/begin COMPU_VTAB idxDSMSigList "" TAB_VERB 14 1 "冷却水温(Coolant Temperature)" 2 "增压压力(Boost Pressure)" 3 "发动机转速(Engine Speed)" 4 "车速(Vehicle Speed)" 5 "进气温度(Intake Air Temperature)" 6 "环境温度(Abmient Temperature)" 7 "发动机起动后时间(Engine Running Time)" 8 "轨压(Rail Pressure)" 9 "控制模块电压(Battery Voltage)" 16 "油门位置1" 19 "目标EGR率(Target EGR Rate)" 20 "EGR率差别(EGR Rate Err)" 21 "大气压力(Ambient Pressure)" 255 "没有信号(None)" DEFAULT_VALUE "没有信号" /end COMPU_VTAB
/begin COMPU_VTAB stDFCDisblMsk "" TAB_VERB 2 0 "允许" 128 "禁止" /end COMPU_VTAB
/begin COMPU_VTAB stDFCDisblMsk2 "" TAB_VERB 2 0 "允许" 128 "禁止" /end COMPU_VTAB
/begin COMPU_VTAB idxDFESClsMIL "" TAB_VERB 2 0 "OBD灯不相关" 1 "OBD灯需要点亮" /end COMPU_VTAB
/begin COMPU_VTAB idxDFESClsSvs "" TAB_VERB 2 0 "Svs灯不相关" 1 "Svs灯点亮" /end COMPU_VTAB
/begin COMPU_VTAB idxDFESClsPrio "" TAB_VERB 8 4 "Invisible" 32 "ServiceLow" 40 "ServiceHigh" 96 "OBDLow" 104 "OBDHigh" 168 "ServiceHigh_Max" 224 "ServiceHigh_OBDLow_Max" 232 "ServiceHigh_OBDHigh_Max" /end COMPU_VTAB
/begin COMPU_VTAB idxDurationType "" TAB_VERB 2 0 "角度表示(Time Duration)" 1 "时间表示(Angle Duration)" DEFAULT_VALUE "0" /end COMPU_VTAB
/begin COMPU_VTAB idxEGRCleanProcessing "" TAB_VERB 3 0 "Waiting" 1 "Processing" 2 "Processed" /end COMPU_VTAB
/begin COMPU_VTAB idxEGRControlState "EGR控制状态" TAB_VERB 3 0 "KeyOn" 1 "Normal" 2 "KeyOff" DEFAULT_VALUE "1" /end COMPU_VTAB
/begin COMPU_VTAB idxEGRLearnProcess "EGR学习状态" TAB_VERB 3 0 "Waiting" 1 "Processing" 2 "Processed" DEFAULT_VALUE "1" /end COMPU_VTAB
/begin COMPU_VTAB idxEGRPositionControl "EGR位置控制方式" TAB_VERB 2 0 "PositionPID" 1 "OpenLoop" /end COMPU_VTAB
/begin COMPU_VTAB idxEISGovFunction "" TAB_VERB 4 0 "低怠速(Low Idle)" 1 "高怠速(High Idle)" 2 "保留(Reserved)" 255 "没有活跃的功能(None)" /end COMPU_VTAB
/begin COMPU_VTAB idxEdgeType "边沿捕捉" TAB_VERB 4 0 "不捕捉(None)" 1 "上升沿(Rising Edge)" 2 "下降沿(Falling Edge)" 3 "所有边沿(All)" DEFAULT_VALUE "0" /end COMPU_VTAB
/begin COMPU_VTAB idxFID "" TAB_VERB 21 0 "使用机油温度计算水温(OTS Replace CTS Enable)" 1 "使用水温来诊断油温(CTS OTS Diag Enable)" 2 "水温动态测试(CTS DynTest Enable)" 3 "机油压力合理性检测(OPS Npl Enable)" 4 "空调允许被打开(AirCondition Enable)" 5 "空调控制允许干预油量(AirConditon Fuel Predef Enable)" 6 "油门1与油门2 合理性检测(Accped Npl Diag Enable)" 7 "系统错误油量限制1(Err1 Limit)" 8 "系统错误油量限制2(Err2 Limit)" 9 "系统错误油量限制3(Err3 Limit)" 10 "系统错误油量限制4(Err4 Limit)" 11 "DCDC电压与蓄电池电压差异诊断(Batt DCDC NPL Diag Enable)" 12 "第一缸始点诊断(Cyl1 BIT Enable)" 13 "第二缸始点诊断(Cyl2 BIT Enable)" 14 "第三缸始点诊断(Cyl3 BIT Enable)" 15 "第四缸始点诊断(Cyl4 BIT Enable)" 16 "第五缸始点诊断(Cyl5 BIT Enable)" 17 "第六缸始点诊断(Cyl6 BIT Enable)" 18 "电池电压怠速转速修正(Batt Idle Speed Correction Enable)" 19 "油门故障怠速修正(AccPed Err Idle Speed Correction Enable)" 255 "FID_Notused" DEFAULT_VALUE "FID_Notused" /end COMPU_VTAB
/begin COMPU_VTAB idxFaultEntryType "" TAB_VERB 16 0 "NoEntry" 1 "Erased" 2 "PrivateTemp" 3 "FreeFramOnly" 4 "DelayActiveDefect" 5 "DelayActiveNoDefect" 6 "ServiceNoDefect" 7 "ServiceDefect" 8 "ServiceHistoryDefect" 9 "ServiceHistoryNoDefect" 10 "PendingDefect" 11 "DebouncedDefect" 12 "DealingNoDefect" 13 "HistoryNoDefect" 14 "HistoryPending" 15 "NotUsed" /end COMPU_VTAB
/begin COMPU_VTAB idxGrpDSMRdy "" TAB_VERB 11 0 "Misfire" 1 "FuelSystem" 2 "ComprehensiveComponent" 3 "Catalyst" 4 "HeatedCatalyst" 5 "EvaporativeSystem" 6 "SecondaryAirSystem" 7 "ACSystemRefrigerant" 8 "OxygenSensor" 9 "OxygenSensorHeater" 10 "EGRSystem" DEFAULT_VALUE "Misfire" /end COMPU_VTAB
/begin COMPU_VTAB idxHIGovSetPoint "高怠速目标转速选择" TAB_VERB 2 0 "正常转速选择(Normal)" 1 "档位转速选择(Gear)" /end COMPU_VTAB
/begin COMPU_VTAB idxManualResetType "" TAB_VERB 15 0 "非自动复位(Not Manual)" 1 "RAM测试(RAM Test Err)" 10 "PLL丢失同步(PLL Lost)" 11 "CRG时钟错误(CRG Err)" 12 "PIT时钟错误(PIT Err)" 20 "EEPROM ACCERR错误(EEPROM ACCERR)" 21 "EEPROM GSTAT错误(EEPROM GSTAT)" 22 "EEPROM Partition错误(EEPROM Parition Err)" 23 "Flash双位错误(Flash DoubleBit Err)" 30 "KWP2000复位(KWP2000 Reset)" 31 "Flash编程复位(FlashProgram Reset)" 40 "ATD队列错误(ATD Queue Err)" 50 "不可识别中断源(Unimplemented)" 60 "XGATE软件错误(XGATE Software Err)" 70 "MPU错误(MPU Err)" DEFAULT_VALUE "0" /end COMPU_VTAB
/begin COMPU_VTAB idxResetType "" TAB_VERB 7 1 "上电复位(PowerUp)" 2 "低电压(LowVoltage)" 3 "时钟(ClockMonitor)" 4 "看门狗(WatchDog)" 5 "非法地址(IllegalAddress)" 6 "系统复位(SystemReset)" 7 "不可识别(Unimplemented)" /end COMPU_VTAB
/begin COMPU_VTAB idxSOIMode "" TAB_VERB 3 0 "始点反馈禁止(Disable)" 1 "始点反馈使能，而且补偿(Enable,w/o Correction)" 2 "始点反馈使能，不补偿(Enable,with Correction)" /end COMPU_VTAB
/begin COMPU_VTAB idxSOIZeroQMode "小油量修正" TAB_VERB 2 0 "小油量下不修正(No Correction)" 1 "统一按照50us修正(Using 50us)" /end COMPU_VTAB
/begin COMPU_VTAB idxSwitchType "开关类型" TAB_VERB 4 0 "接电源常开(Power Open)" 1 "接电源常闭(Power Close)" 2 "接地常开(Ground Open)" 3 "接地常闭(Ground Close)" DEFAULT_VALUE "0" /end COMPU_VTAB
/begin COMPU_VTAB idxTestBenchMode "" TAB_VERB 2 0 "指定油量(Fuel Quantity)" 1 "指定脉宽(Injection Duration)" /end COMPU_VTAB
/begin COMPU_VTAB idxToothType "曲轴齿形" TAB_VERB 2 1 "多齿(Add Tooth)" 2 "缺齿(Miss Tooth)" DEFAULT_VALUE "2" /end COMPU_VTAB
/begin COMPU_VTAB idxTriggerType "" TAB_VERB 10 0 "AlwaysTrue" 1 "NoTrigger" 2 "Time" 3 "WarmUpCycle" 4 "DrivingCycleFLC" 5 "DrivingCycleHLC" 6 "SimilarCondition" 7 "Project1" 8 "Project2" 9 "OneHour" DEFAULT_VALUE "1" /end COMPU_VTAB
/begin COMPU_VTAB idxVREGAcq "" TAB_VERB 3 0 "不采集(None)" 1 "采集CPU温度(CPU Temperature Acq)" 2 "采集1.2V参考电压(1.2V Acq)" /end COMPU_VTAB
/begin COMPU_VTAB stAirCondition "" TAB_VERB 6 0 "关闭(ShutOff)" 1 "等待开启(WaitForSwitchOn)" 2 "关闭锁止(SwitchOffLock)" 3 "等待关闭(WaitForShutOff)" 4 "开启(SwitchOn)" 5 "开启禁止(SwitchOnDisable)" /end COMPU_VTAB
/begin COMPU_VTAB stAirHeater "进气加热状态" TAB_VERB 9 0 "读取数据(Reading)" 1 "前预热(PreHeating)" 2 "停机预热(StandbyHeating)" 3 "停机(Standby)" 4 "起动预热(CrankingHeating)" 5 "起动(Cranking)" 6 "后预热(PostHeating)" 7 "预热结束(End)" 8 "停机后处理(Afterrun)" /end COMPU_VTAB
/begin COMPU_VTAB stAirHeaterTempSel "" TAB_VERB 32 0 "没有选中(None)" 1 "机油温度(OTS)" 2 "进气温度(IATS)" 3 "进气温度，机油温度(IATS,OTS)" 4 "燃油温度(FTS)" 5 "燃油温度，机油温度(FTS,OTS)" 6 "燃油温度，进气温度(FTS,IATS)" 7 "燃油温度，进气温度，机油温度(FTS,IATS,OTS)" 8 "环境温度(ETS)" 9 "环境温度，机油温度(ETS,OTS)" 10 "环境温度，进气温度(ETS,IATS)" 11 "环境温度，进气温度，机油温度(ETS,IATS,OTS)" 12 "环境温度，燃油温度(ETS,FTS)" 13 "环境温度，燃油温度，机油温度(ETS,FTS,OTS)" 14 "环境温度，燃油温度，进气温度(ETS,FTS,IATS)" 15 "环境温度，燃油温度，进气温度，机油温度(ETS,FTS,IATS,OTS)" 16 "冷却水温(CTS)" 17 "冷却水温，机油温度(CTS,OTS)" 18 "冷却水温，进气温度(CTS,IATS)" 19 "冷却水温，进气温度，机油温度(CTS,IATS,OTS)" 20 "冷却水温，燃油温度(CTS,FTS)" 21 "冷却水温，燃油温度，机油温度(CTS,FTS,OTS)" 22 "冷却水温，燃油温度，进气温度(CTS,FTS,IATS)" 23 "冷却水温，燃油温度，进气温度，机油温度(CTS,FTS,IATS,OTS)" 24 "冷却水温，环境温度(CTS,ETS)" 25 "冷却水温，环境温度，机油温度(CTS,ETS,OTS)" 26 "冷却水温，环境温度，进气温度(CTS,ETS,IATS)" 27 "冷却水温，环境温度，进气温度，机油温度(CTS,ETS,IATS,OTS)" 28 "冷却水温，环境温度，燃油温度(CTS,ETS,FTS)" 29 "冷却水温，环境温度，燃油温度，机油温度(CTS,ETS,FTS,OTS)" 30 "冷却水温，环境温度，燃油温度，进气温度(CTS,ETS,FTS,IATS)" 31 "冷却水温，环境温度，燃油温度，进气温度，机油温度(CTS,ETS,FTS,IATS,OTS)" /end COMPU_VTAB
/begin COMPU_VTAB stCamNoCrk "" TAB_VERB 7 0 "Init" 4 "OneTooth" 5 "MatchTooth" 6 "WaitForSyn" 8 "Syn" 10 "Tooth" 11 "LastTooth" /end COMPU_VTAB
/begin COMPU_VTAB stCamshaft "" TAB_VERB 5 1 "Cam_NoCrk" 2 "Cam_Search" 4 "Cam_Verify" 8 "Cam_Switchoff" 16 "Cam_Diag" /end COMPU_VTAB
/begin COMPU_VTAB stCrankshaft "" TAB_VERB 7 0 "Crk_Init" 4 "Crk_OneTooth" 5 "Crk_MatchTooth" 6 "Crk_WaitForSyn" 8 "Crk_Syn" 10 "Crk_Tooth" 11 "Crk_LastTooth" /end COMPU_VTAB
/begin COMPU_VTAB stDFC "" TAB_VERB 5 0 "诊断未开始(None)" 1 "部分错误(Preliminary Err)" 2 "完全错误(Err)" 3 "部分正常(Preliminary Heal)" 4 "完全正常(Heal)" /end COMPU_VTAB
/begin COMPU_VTAB stEGRRationSetPointRampState "EGR控制目标开度ramp状态" TAB_VERB 3 0 "PT1" 1 "PosRamp" 2 "NegRamp" /end COMPU_VTAB
/begin COMPU_VTAB stEngErrLim "" TAB_VERB 5 0 "没有限制(None)" 1 "90%功率限制(90% Limit)" 2 "85%功率限制(85% Limit)" 4 "80%功率限制(80% Limit)" 8 "70%功率限制(70% Limit)" DEFAULT_VALUE "0" /end COMPU_VTAB
/begin COMPU_VTAB stEngFuelLim "" TAB_VERB 6 0 "无限制(None)" 1 "冒烟限制(Air System Limit)" 2 "发动机保护限制(Engine Protect Limit)" 4 "发动机故障限制(Engine Err Limit)" 8 "最大油量限制(Fuel System Max Limit)" 16 "最小油量限制(Fuel System Min Limit)" DEFAULT_VALUE "0" /end COMPU_VTAB
/begin COMPU_VTAB stEngPrtLim "" TAB_VERB 3 0 "没有限制(None)" 1 "发动机过热保护(OverHeat Protect)" 2 "发动机机械保护(Mechanic Protect)" DEFAULT_VALUE "0" /end COMPU_VTAB
/begin COMPU_VTAB stEngine "" TAB_VERB 7 0 "初始化(Eng_Init)" 1 "停机(Eng_StandBy)" 2 "等待起动(Eng_Ready)" 3 "起动(Eng_Cranking)" 4 "正常运转(Eng_Running)" 5 "Eng_Stopping" 6 "Eng_Finish" /end COMPU_VTAB
/begin COMPU_VTAB stEpm "" TAB_VERB 4 0 "没有同步(Epm_NoSyn)" 2 "凸轮轴同步(Epm_CamSyn)" 8 "曲轴同步(Epm_CrkSyn)" 32 "完全同步(Epm_FullSyn)" /end COMPU_VTAB
/begin COMPU_VTAB stHIGovIFreeze "高怠速I冻结转速状态" TAB_VERB 2 0 "转速低于起始转速" 1 "转速大于或等于起始转速" /end COMPU_VTAB
/begin COMPU_VTAB stInjection "" TAB_VERB 6 0 "Inj_Wait" 1 "Inj_Verify" 2 "Inj_OK" 4 "Inj_BackCrk" 8 "Inj_BackCam" 16 "Inj_Err" /end COMPU_VTAB
/begin COMPU_VTAB stLIGovPreDef "低怠速前馈油量锁状态" TAB_VERB 2 0 "锁(Lock)" 1 "解锁(Unlock)" /end COMPU_VTAB
/begin COMPU_VTAB stLowIdleSetPoint "" TAB_VERB 5 1 "蓄电池电压低怠速(Battery Voltage Low)" 2 "空调怠速(Air Condition)" 4 "油门踏板故障怠速(Accped Defect)" 8 "水温怠速(Coolant)" 16 "档位怠速(Gear)" DEFAULT_VALUE "8" /end COMPU_VTAB
/begin COMPU_VTAB stMechPrtLim "" TAB_VERB 6 0 "没有限制(None)" 1 "增压器保护(Turbine Protect)" 2 "最大车速限制(Vehicle Speed Protect)" 4 "最大发动机转速限制(Engine Speed Protect)" 8 "最大爆发压力限制(Boost Presure Protect)" 16 "OBD限制" DEFAULT_VALUE "0" /end COMPU_VTAB
/begin COMPU_VTAB stOvhtPrtLim "" TAB_VERB 4 0 "没有限制(None)" 1 "水温限制(Coolant Temperature Limit)" 2 "燃油温度限制(Fuel Temperature Limit)" 4 "机油温度限制(Oil Temperature Limit)" DEFAULT_VALUE "0" /end COMPU_VTAB
/begin COMPU_VTAB stPostDrive "" TAB_VERB 9 0 "禁止(Inactive)" 1 "等待(Wait)" 2 "诊断开始(DSMBegin)" 3 "EEPROM开始(EEPBegin)" 4 "等待2(Wait2)" 5 "DSM结束(DSM End)" 6 "EEPROM结束(EEP End)" 7 "最小时间(MinTime)" 8 "结束(Done)" /end COMPU_VTAB
/begin COMPU_VTAB stPreDrive "" TAB_VERB 2 0 "禁止(Inactive)" 1 "结束(Done)" /end COMPU_VTAB
/begin COMPU_VTAB stRamp "" TAB_VERB 2 0 "结束(End)" 1 "正在进行(Begin)" /end COMPU_VTAB
/begin COMPU_VTAB stShutOff "" TAB_VERB 5 0 "禁止(Inactive)" 1 "DSM(DSM)" 2 "EEPROM(EEP)" 3 "主继电器关闭(MainRelay)" 4 " 结束(Done)" /end COMPU_VTAB
/begin COMPU_VTAB stStartSysCtl "起动控制状态" TAB_VERB 3 0 "初始化(Init)" 1 "起动进行中(Begin)" 2 "起动成功(End)" /end COMPU_VTAB
/begin COMPU_VTAB stSysConMon "" TAB_VERB 5 0 "初始化(Init)" 1 "关闭(Off)" 2 "起动(Boot)" 3 "执行(Exec)" 4 "关闭(Shutdown)" /end COMPU_VTAB
/begin COMPU_VTAB stSysConSub "" TAB_VERB 6 0 "初始化(Init)" 1 "硬件初始化(HardwareInit)" 2 "管理系统初始化(ManageInit)" 3 "PreDrive(PreDrive)" 4 "Drive(Drive)" 5 "PostDrive(PostDrive)" /end COMPU_VTAB
/begin COMPU_VTAB stTestInj "" TAB_VERB 5 0 "TestInj_Void" 1 "TestInj_Inj" 2 "TestInj_Calc" 3 "TestInj_Syn" 4 "TestInj_NoSyn" /end COMPU_VTAB
/begin COMPU_VTAB swtComponentInput "输入是否使用，信号来源" TAB_VERB 2 0 "不使用(Inactive)" 1 "使用(Active)" /end COMPU_VTAB
/begin COMPU_VTAB swtComponentOutput "输出设备是否使用" TAB_VERB 2 0 "不使用(Inactive)" 1 "使用(Active)" /end COMPU_VTAB
/begin COMPU_VTAB idxDIType "" TAB_VERB 2 0 "低电平有效" 1 "高电平有效" /end COMPU_VTAB
/begin COMPU_VTAB idxBaudRate "" TAB_VERB 3 0 "125kbps" 1 "250kbps" 2 "500kbps" /end COMPU_VTAB
/begin COMPU_VTAB idxTorque_ModeType "运行模式标识" TAB_VERB 11 0 "自由滑行" 1 "D档蠕动" 2 "D档滑行回馈" 3 "D档制动回馈" 4 "D档坡道驻车" 5 "R档蠕动" 6 "R档滑行回馈" 7 "R档制动回馈" 8 "R档坡道驻车" 9 "前行(油门给定力矩）" 10 "倒车(油门给定力矩）" DEFAULT_VALUE "0" /end COMPU_VTAB
/begin COMPU_VTAB idxVehco_StateType "车辆上下电状态标识" TAB_VERB 11 0 "关机" 1 "ON档,等待STAR信号" 2 "预充阶段" 3 "BMS上电完成,电机使能指令" 4 "电机READY" 5 "ON消失,自动减速中" 6 "下电指令" 7 "主动放电指令" 8 "主动放电中" 9 "放电完成,去使能指令" 10 "关机准备完成，下控制电" DEFAULT_VALUE "0" /end COMPU_VTAB
/begin COMPU_VTAB idxDang_StateType "档位转换表" TAB_VERB 4 0 "N档" 1 "P档" 5 "R档" 10 "D档" DEFAULT_VALUE "0" /end COMPU_VTAB
/begin COMPU_METHOD NO_FORMULA "" RAT_FUNC "%2.0" "" COEFFS 0 1 0 0 0 1 /end COMPU_METHOD
/begin COMPU_METHOD aFactor32 "" RAT_FUNC "%3.2" "米/秒^2" COEFFS 0 32 -0 0 0 1 /end COMPU_METHOD
/begin COMPU_METHOD bCondition "" TAB_VERB "%3.0" "" COMPU_TAB_REF bCondition /end COMPU_METHOD
/begin COMPU_METHOD bFunctionActive "" TAB_VERB "%3.1" "" COMPU_TAB_REF bFunctionActive /end COMPU_METHOD
/begin COMPU_METHOD bSwitch "开关" TAB_VERB "%3.1" "" COMPU_TAB_REF bSwitch /end COMPU_METHOD
/begin COMPU_METHOD ctTimes "计数次数" RAT_FUNC "%3.1" "次" COEFFS 0 1 0 0 0 1 /end COMPU_METHOD
/begin COMPU_METHOD dnFactor1 "" RAT_FUNC "%3.1" "转/分" COEFFS 0 1 0 0 0 1 /end COMPU_METHOD
/begin COMPU_METHOD dpFactor32 "" RAT_FUNC "%3.2" "" COEFFS 0 32 -0 0 0 1 /end COMPU_METHOD
/begin COMPU_METHOD dqFactor128 "" RAT_FUNC "%3.2" "毫克" COEFFS 0 128 -0 0 0 1 /end COMPU_METHOD
/begin COMPU_METHOD drFactor256_AccPed "油门踏板变化率" RAT_FUNC "%3.1" "%/秒" COEFFS 0 256 -0 0 0 1 /end COMPU_METHOD
/begin COMPU_METHOD dtFactor256 "" RAT_FUNC "%3.2" "度" COEFFS 0 256 -0 0 0 1 /end COMPU_METHOD
/begin COMPU_METHOD fFactor1 "9825,9362控制频率" RAT_FUNC "%3.0" "Hz" COEFFS 0 1 0 0 0 1 /end COMPU_METHOD
/begin COMPU_METHOD facFactor1000_Flt "滤波参数" RAT_FUNC "%3.3" "" COEFFS 0 1000 -0 0 0 1 /end COMPU_METHOD
/begin COMPU_METHOD facFactor100_Correction "修正系数" RAT_FUNC "%3.3" "%" COEFFS 0 100 -0 0 0 1 /end COMPU_METHOD
/begin COMPU_METHOD facFactor100_PID "PID参数" RAT_FUNC "%3.3" "" COEFFS 0 100 -0 0 0 1 /end COMPU_METHOD
/begin COMPU_METHOD facFactor256 "" RAT_FUNC "%3.2" "" COEFFS 0 256 -0 0 0 1 /end COMPU_METHOD
/begin COMPU_METHOD idxAccPedType "油门类型" TAB_VERB "%3.1" "" COMPU_TAB_REF idxAccPedType /end COMPU_METHOD
/begin COMPU_METHOD idxBaudRate "" TAB_VERB "%3.0" "" COMPU_TAB_REF idxBaudRate /end COMPU_METHOD
/begin COMPU_METHOD idxDIType "" TAB_VERB "%1.0" "" COMPU_TAB_REF idxDIType /end COMPU_METHOD
/begin COMPU_METHOD idxEdgeType "边沿捕捉" TAB_VERB "%3.1" "" COMPU_TAB_REF idxEdgeType /end COMPU_METHOD
/begin COMPU_METHOD idxManualResetType "" TAB_VERB "%3.2" "" COMPU_TAB_REF idxManualResetType /end COMPU_METHOD
/begin COMPU_METHOD idxResetType "" TAB_VERB "%3.2" "" COMPU_TAB_REF idxResetType /end COMPU_METHOD
/begin COMPU_METHOD idxSwitchType "开关类型" TAB_VERB "%3.1" "" COMPU_TAB_REF idxSwitchType /end COMPU_METHOD
/begin COMPU_METHOD idxTriggerType "" TAB_VERB "%3.1" "" COMPU_TAB_REF idxTriggerType /end COMPU_METHOD
/begin COMPU_METHOD idxVREGAcq "" TAB_VERB "%3.1" "" COMPU_TAB_REF idxVREGAcq /end COMPU_METHOD
/begin COMPU_METHOD nFactor1 "" RAT_FUNC "%3.1" "转/分" COEFFS 0 1 0 0 0 1 /end COMPU_METHOD
/begin COMPU_METHOD numFactor256 "" RAT_FUNC "%3.2" "脉冲" COEFFS 0 256 -0 0 0 1 /end COMPU_METHOD
/begin COMPU_METHOD pFactor32_kPa "" RAT_FUNC "%3.2" "千帕" COEFFS 0 32 -0 0 0 1 /end COMPU_METHOD
/begin COMPU_METHOD phiFactor32 "" RAT_FUNC "%3.2" "度" COEFFS 0 32 -0 0 0 1 /end COMPU_METHOD
/begin COMPU_METHOD qFactor128 "" RAT_FUNC "%3.2" "毫克" COEFFS 0 128 -0 0 0 1 /end COMPU_METHOD
/begin COMPU_METHOD rFactor100_PWM "9825,9362控制占空比" RAT_FUNC "%3.2" "%" COEFFS 0 100 -0 0 0 1 /end COMPU_METHOD
/begin COMPU_METHOD rFactor100_control "阀控制开度" RAT_FUNC "%3.2" "%" COEFFS 0 100 -0 0 0 1 /end COMPU_METHOD
/begin COMPU_METHOD rFactor10_VSSPlaus "车速合理性计算" RAT_FUNC "%3.1" "" COEFFS 0 10 -0 0 0 1 /end COMPU_METHOD
/begin COMPU_METHOD rFactor256_AccPed "" RAT_FUNC "%3.1" "%" COEFFS 0 256 -0 0 0 1 /end COMPU_METHOD
/begin COMPU_METHOD rFactor256_Plaus "" RAT_FUNC "%3.2" "" COEFFS 0 256 -0 0 0 1 /end COMPU_METHOD
/begin COMPU_METHOD rFactor32_GearConv "" RAT_FUNC "%3.2" "" COEFFS 0 32 -0 0 0 1 /end COMPU_METHOD
/begin COMPU_METHOD stPostDrive "" TAB_VERB "%3.1" "" COMPU_TAB_REF stPostDrive /end COMPU_METHOD
/begin COMPU_METHOD stPreDrive "" TAB_VERB "%3.1" "" COMPU_TAB_REF stPreDrive /end COMPU_METHOD
/begin COMPU_METHOD stRamp "" TAB_VERB "%3.1" "" COMPU_TAB_REF stRamp /end COMPU_METHOD
/begin COMPU_METHOD stShutOff "" TAB_VERB "%3.1" "" COMPU_TAB_REF stShutOff /end COMPU_METHOD
/begin COMPU_METHOD stSysConMon "" TAB_VERB "%3.1" "" COMPU_TAB_REF stSysConMon /end COMPU_METHOD
/begin COMPU_METHOD stSysConSub "" TAB_VERB "%3.1" "" COMPU_TAB_REF stSysConSub /end COMPU_METHOD
/begin COMPU_METHOD swtComponentInput "输入是否使用，信号来源" TAB_VERB "%3.1" "" COMPU_TAB_REF swtComponentInput /end COMPU_METHOD
/begin COMPU_METHOD swtComponentOutput "输出设备是否使用" TAB_VERB "%3.1" "" COMPU_TAB_REF swtComponentOutput /end COMPU_METHOD
/begin COMPU_METHOD tFactor256 "" RAT_FUNC "%4.2" "度" COEFFS 0 256 10240 0 0 1 /end COMPU_METHOD
/begin COMPU_METHOD tiFactor1000_1ms "" RAT_FUNC "%3.3" "秒" COEFFS 0 1000 -0 0 0 1 /end COMPU_METHOD
/begin COMPU_METHOD tiFactor100_10ms "" RAT_FUNC "%3.2" "秒" COEFFS 0 100 -0 0 0 1 /end COMPU_METHOD
/begin COMPU_METHOD tiFactor1_1us "" RAT_FUNC "%3.2" "微秒" COEFFS 0 1 0 0 0 1 /end COMPU_METHOD
/begin COMPU_METHOD tiFactor20_50ms "50ms数的时间" RAT_FUNC "%3.3" "秒" COEFFS 0 20 -0 0 0 1 /end COMPU_METHOD
/begin COMPU_METHOD tiFactor25_25MHz "ECT时钟" RAT_FUNC "%3.3" "" COEFFS 0 25 -0 0 0 1 /end COMPU_METHOD
/begin COMPU_METHOD uFactor100_Batt "" RAT_FUNC "%3.2" "伏" COEFFS 0 100 -0 0 0 1 /end COMPU_METHOD
/begin COMPU_METHOD uFactor4095 "4095->5V" RAT_FUNC "%3.3" "伏特" COEFFS 0 4095 -0 0 0 1 /end COMPU_METHOD
/begin COMPU_METHOD vFactor32 "" RAT_FUNC "%3.2" "千米/小时" COEFFS 0 32 -0 0 0 1 /end COMPU_METHOD
/begin COMPU_METHOD volFactor16 "" RAT_FUNC "%3.2" "毫克/缸" COEFFS 0 16 -0 0 0 1 /end COMPU_METHOD
/begin COMPU_METHOD fFactor256 "" RAT_FUNC "%.2" "Hz" COEFFS 0 1 -1 0 0 0.003906 /end COMPU_METHOD
/begin COMPU_METHOD u5V "AD采样电压" RAT_FUNC "%.3" "伏" COEFFS 0 819 0 0 0 1 /end COMPU_METHOD
/begin COMPU_METHOD PWM_Hz100 "" RAT_FUNC "%.2" "Hz" COEFFS 0 100 0 0 0 1 /end COMPU_METHOD
/begin COMPU_METHOD rpm1-1 "转速1：1转换" RAT_FUNC "%.0" "rpm" COEFFS 0 1 0 0 0 1 /end COMPU_METHOD
/begin COMPU_METHOD Vmh10ms "车速变化率 每10ms车速变化量 米/小时/10ms " RAT_FUNC "%.0" "mh10ms" COEFFS 0 1 0 0 0 1 /end COMPU_METHOD
/begin COMPU_METHOD idxTorque_ModeType "运行模式标识" TAB_VERB "" "" COMPU_TAB_REF idxTorque_ModeType /end COMPU_METHOD
/begin COMPU_METHOD idxVehco_StateType "车辆上下电状态标识" TAB_VERB "" "" COMPU_TAB_REF idxVehco_StateType /end COMPU_METHOD
/begin COMPU_METHOD rr100 "" RAT_FUNC "%.2" "" COEFFS 0 100 0 0 0 1 /end COMPU_METHOD
/begin COMPU_METHOD idxDang_StateType "档位状态 0 N 1 P 5 R 10 D" TAB_VERB "" "" COMPU_TAB_REF idxDang_StateType /end COMPU_METHOD
/begin COMPU_METHOD SOC "" RAT_FUNC "%.1" "%" COEFFS 0 2 0 0 0 1 /end COMPU_METHOD
/begin COMPU_METHOD Speed "" RAT_FUNC "" "km/h" COEFFS 0 1 50 0 0 1 /end COMPU_METHOD
/begin COMPU_METHOD Avg_Cell_Voltage "F=X * 0.002" RAT_FUNC "%.3" "V" COEFFS 0 1 -0 0 0 0.002 /end COMPU_METHOD
/begin COMPU_METHOD Cell_Voltage "y=x * 0.0015" RAT_FUNC "%.4" "V" COEFFS 0 1 -0 0 0 0.0015 /end COMPU_METHOD
/begin COMPU_METHOD TEMP-40 "" RAT_FUNC "" "℃" COEFFS 0 1 40 0 0 1 /end COMPU_METHOD
/begin COMPU_METHOD Temp "线性温度转换 1：1" RAT_FUNC "%.0" "℃" COEFFS 0 1 0 0 0 1 /end COMPU_METHOD
/begin COMPU_METHOD rFactor100_VSSPlaus "" RAT_FUNC "%.2" "" COEFFS 0 100 -0 0 0 1 /end COMPU_METHOD
/begin COMPU_METHOD Current_100 "" RAT_FUNC "%.2" "A" COEFFS 0 100 0 0 0 1 /end COMPU_METHOD
/begin MEASUREMENT BattCD_uUW "" UWORD uFactor100_Batt 0 0 0 65535 ECU_ADDRESS 0x2740 /end MEASUREMENT
/begin MEASUREMENT VehCo_ctTestUW "" UWORD NO_FORMULA 0 0 0 65535 ECU_ADDRESS 0xFD881 /end MEASUREMENT
/begin MEASUREMENT VehCo_stAfterrunUB "" UBYTE facFactor256 -1 -1 0 255 ECU_ADDRESS 0x2335 /end MEASUREMENT
/begin MEASUREMENT bDiSatus._0_ "" UBYTE NO_FORMULA -1 -1 0 0 ECU_ADDRESS 0x22B4 /end MEASUREMENT
/begin MEASUREMENT bDiSatus._1_ "" UBYTE NO_FORMULA -1 -1 0 0 ECU_ADDRESS 0x22B5 /end MEASUREMENT
/begin MEASUREMENT bDiSatus._2_ "" UBYTE NO_FORMULA -1 -1 0 0 ECU_ADDRESS 0x22B6 /end MEASUREMENT
/begin MEASUREMENT bDiSatus._3_ "" UBYTE NO_FORMULA -1 -1 0 0 ECU_ADDRESS 0x22B7 /end MEASUREMENT
/begin MEASUREMENT bDiSatus._4_ "" UBYTE NO_FORMULA -1 -1 0 0 ECU_ADDRESS 0x22B8 /end MEASUREMENT
/begin MEASUREMENT bDiSatus._5_ "" UBYTE NO_FORMULA -1 -1 0 0 ECU_ADDRESS 0x22B9 /end MEASUREMENT
/begin MEASUREMENT bDiSatus._6_ "" UBYTE NO_FORMULA -1 -1 0 0 ECU_ADDRESS 0x22BA /end MEASUREMENT
/begin MEASUREMENT bDiSatus._7_ "" UBYTE NO_FORMULA -1 -1 0 0 ECU_ADDRESS 0x22BB /end MEASUREMENT
/begin MEASUREMENT bDiSatus._8_ "" UBYTE NO_FORMULA -1 -1 0 0 ECU_ADDRESS 0x22BC /end MEASUREMENT
/begin MEASUREMENT bDiSatus._9_ "" UBYTE NO_FORMULA -1 -1 0 0 ECU_ADDRESS 0x22BD /end MEASUREMENT
/begin MEASUREMENT bDoSatus._00 "" UBYTE NO_FORMULA -1 -1 0 0 ECU_ADDRESS 0x22FE /end MEASUREMENT
/begin MEASUREMENT bDoSatus._01 "" UBYTE NO_FORMULA -1 -1 0 0 ECU_ADDRESS 0x22FF /end MEASUREMENT
/begin MEASUREMENT bDoSatus._02 "" UBYTE NO_FORMULA -1 -1 0 0 ECU_ADDRESS 0x2300 /end MEASUREMENT
/begin MEASUREMENT bDoSatus._03 "" UBYTE NO_FORMULA -1 -1 0 0 ECU_ADDRESS 0x2301 /end MEASUREMENT
/begin MEASUREMENT bDoSatus._04 "" UBYTE NO_FORMULA -1 -1 0 0 ECU_ADDRESS 0x2302 /end MEASUREMENT
/begin MEASUREMENT bDoSatus._05 "" UBYTE NO_FORMULA -1 -1 0 0 ECU_ADDRESS 0x2303 /end MEASUREMENT
/begin MEASUREMENT bDoSatus._06 "" UBYTE NO_FORMULA -1 -1 0 0 ECU_ADDRESS 0x2304 /end MEASUREMENT
/begin MEASUREMENT bDoSatus._07 "" UBYTE NO_FORMULA -1 -1 0 0 ECU_ADDRESS 0x2305 /end MEASUREMENT
/begin MEASUREMENT bDoSatus._08 "" UBYTE NO_FORMULA -1 -1 0 0 ECU_ADDRESS 0x2306 /end MEASUREMENT
/begin MEASUREMENT bDoSatus._09 "" UBYTE NO_FORMULA -1 -1 0 0 ECU_ADDRESS 0x2307 /end MEASUREMENT
/begin MEASUREMENT bDoSatus._10 "" UBYTE NO_FORMULA -1 -1 0 0 ECU_ADDRESS 0x2308 /end MEASUREMENT
/begin MEASUREMENT bDoSatus._11 "" UBYTE NO_FORMULA -1 -1 0 0 ECU_ADDRESS 0x2309 /end MEASUREMENT
/begin MEASUREMENT bDoSatus._12 "" UBYTE NO_FORMULA -1 -1 0 0 ECU_ADDRESS 0x230A /end MEASUREMENT
/begin MEASUREMENT bDoSatus._13 "" UBYTE NO_FORMULA -1 -1 0 0 ECU_ADDRESS 0x230B /end MEASUREMENT
/begin MEASUREMENT bDoSatus._14 "" UBYTE NO_FORMULA -1 -1 0 0 ECU_ADDRESS 0x230C /end MEASUREMENT
/begin MEASUREMENT bDoSatus._15 "" UBYTE NO_FORMULA -1 -1 0 0 ECU_ADDRESS 0x230D /end MEASUREMENT
/begin MEASUREMENT uAD1 "" UWORD u5V -1 -1 0 0 ECU_ADDRESS 0x2340 /end MEASUREMENT
/begin MEASUREMENT uAD2 "" UWORD u5V -1 -1 0 0 ECU_ADDRESS 0x2342 /end MEASUREMENT
/begin MEASUREMENT AccPed1 "油门开度1" UWORD rFactor100_PWM -1 -1 0 100 ECU_ADDRESS 0x2350 /end MEASUREMENT
/begin MEASUREMENT AccPed2 "油门开度2" UWORD rFactor100_PWM -1 -1 0 100 ECU_ADDRESS 0x2352 /end MEASUREMENT
/begin MEASUREMENT bDiSatus._10_ "" UBYTE NO_FORMULA -1 -1 0 0 ECU_ADDRESS 0x22BE /end MEASUREMENT
/begin MEASUREMENT bDiSatus._11_ "" UBYTE NO_FORMULA -1 -1 0 0 ECU_ADDRESS 0x22BF /end MEASUREMENT
/begin MEASUREMENT bDiSatus._12_ "" UBYTE NO_FORMULA -1 -1 0 0 ECU_ADDRESS 0x22C0 /end MEASUREMENT
/begin MEASUREMENT bDiSatus._13_ "" UBYTE NO_FORMULA -1 -1 0 0 ECU_ADDRESS 0x22C1 /end MEASUREMENT
/begin MEASUREMENT bDiSatus._14_ "" UBYTE NO_FORMULA -1 -1 0 0 ECU_ADDRESS 0x22C2 /end MEASUREMENT
/begin MEASUREMENT bDiSatus._15_ "" UBYTE NO_FORMULA -1 -1 0 0 ECU_ADDRESS 0x22C3 /end MEASUREMENT
/begin MEASUREMENT bDiSatus._16_ "" UBYTE NO_FORMULA -1 -1 0 0 ECU_ADDRESS 0x22C4 /end MEASUREMENT
/begin MEASUREMENT bDiSatus._17_ "" UBYTE NO_FORMULA -1 -1 0 0 ECU_ADDRESS 0x22C5 /end MEASUREMENT
/begin MEASUREMENT AccPed_Differ "" UWORD NO_FORMULA -1 -1 0 0 ECU_ADDRESS 0x2358 /end MEASUREMENT
/begin MEASUREMENT uAD4Satus._0_ "" UWORD NO_COMPU_METHOD -1 -1 0 0 ECU_ADDRESS 0x2312 /end MEASUREMENT
/begin MEASUREMENT uAD4Satus._1_ "" UWORD NO_COMPU_METHOD -1 -1 0 0 ECU_ADDRESS 0x2314 /end MEASUREMENT
/begin MEASUREMENT uAD4Satus._2_ "" UWORD NO_COMPU_METHOD -1 -1 0 0 ECU_ADDRESS 0x2316 /end MEASUREMENT
/begin MEASUREMENT uAD4Satus._3_ "" UWORD NO_COMPU_METHOD -1 -1 0 0 ECU_ADDRESS 0x2318 /end MEASUREMENT
/begin MEASUREMENT BattCD_bLogicOnUB "" UBYTE NO_FORMULA -1 -1 0 0 ECU_ADDRESS 0x2744 /end MEASUREMENT
/begin MEASUREMENT PowOn_Times "" UWORD NO_COMPU_METHOD -1 -1 0 0 ECU_ADDRESS 0x13F000 /end MEASUREMENT
/begin MEASUREMENT SC_CAN0_Baudrat "波特率选择 0=125K 1=250K 2=500K 其他=250K ACES 调试CAN" UBYTE NO_COMPU_METHOD -1 -1 0 0 ECU_ADDRESS 0x78003D /end MEASUREMENT
/begin MEASUREMENT SC_CAN1_Baudrat "波特率选择 0=125K 1=250K 2=500K 其他=250K ACES 整车CAN " UBYTE NO_COMPU_METHOD -1 -1 0 0 ECU_ADDRESS 0x78003E /end MEASUREMENT
/begin MEASUREMENT SC_CAN2_Baudrat "波特率选择 0=125K 1=250K 2=500K 其他=250K ACES 充电CAN A9设置为125K " UBYTE NO_COMPU_METHOD -1 -1 0 0 ECU_ADDRESS 0x78003F /end MEASUREMENT
/begin MEASUREMENT DoErr_0 "" UBYTE NO_COMPU_METHOD 0 0 0 0 ECU_ADDRESS 0x231C /end MEASUREMENT
/begin MEASUREMENT DoErr_1 "" UBYTE NO_COMPU_METHOD 0 0 0 0 ECU_ADDRESS 0x231D /end MEASUREMENT
/begin MEASUREMENT DoErr_2 "" UBYTE NO_COMPU_METHOD 0 0 0 0 ECU_ADDRESS 0x231E /end MEASUREMENT
/begin MEASUREMENT DoErr_3 "" UBYTE NO_COMPU_METHOD 0 0 0 0 ECU_ADDRESS 0x231F /end MEASUREMENT
/begin MEASUREMENT DoErr_4 "" UBYTE NO_COMPU_METHOD 0 0 0 0 ECU_ADDRESS 0x2320 /end MEASUREMENT
/begin MEASUREMENT DoErr_5 "" UBYTE NO_COMPU_METHOD 0 0 0 0 ECU_ADDRESS 0x2321 /end MEASUREMENT
/begin MEASUREMENT DoErr_6 "" UBYTE NO_COMPU_METHOD 0 0 0 0 ECU_ADDRESS 0x2322 /end MEASUREMENT
/begin MEASUREMENT DoErr_7 "" UBYTE NO_COMPU_METHOD 0 0 0 0 ECU_ADDRESS 0x2323 /end MEASUREMENT
/begin MEASUREMENT DoErr_8 "" UBYTE NO_COMPU_METHOD 0 0 0 0 ECU_ADDRESS 0x2324 /end MEASUREMENT
/begin MEASUREMENT DoErr_9 "" UBYTE NO_COMPU_METHOD 0 0 0 0 ECU_ADDRESS 0x2325 /end MEASUREMENT
/begin MEASUREMENT DoErr_10 "" UBYTE NO_COMPU_METHOD 0 0 0 0 ECU_ADDRESS 0x2326 /end MEASUREMENT
/begin MEASUREMENT DoErr_11 "" UBYTE NO_COMPU_METHOD 0 0 0 0 ECU_ADDRESS 0x2327 /end MEASUREMENT
/begin MEASUREMENT DoErr_12 "" UBYTE NO_COMPU_METHOD 0 0 0 0 ECU_ADDRESS 0x2328 /end MEASUREMENT
/begin MEASUREMENT DoErr_13 "" UBYTE NO_COMPU_METHOD 0 0 0 0 ECU_ADDRESS 0x2329 /end MEASUREMENT
/begin MEASUREMENT DoErr_14 "" UBYTE NO_COMPU_METHOD 0 0 0 0 ECU_ADDRESS 0x232A /end MEASUREMENT
/begin MEASUREMENT DoErr_15 "" UBYTE NO_COMPU_METHOD 0 0 0 0 ECU_ADDRESS 0x232B /end MEASUREMENT
/begin MEASUREMENT uAD3 "" UWORD u5V 0 0 0 65535 ECU_ADDRESS 0x234C /end MEASUREMENT
/begin MEASUREMENT uAD4 "" UWORD u5V 0 0 0 65535 ECU_ADDRESS 0x234E /end MEASUREMENT
/begin MEASUREMENT Breakk "制动踏板行程" UWORD rFactor100_PWM 0 0 0 100 ECU_ADDRESS 0x2356 /end MEASUREMENT
/begin MEASUREMENT Dang_Command "档位指令 0 N 1 D 2 R 3 保留" UBYTE NO_FORMULA 0 0 0 255 ECU_ADDRESS 0x228F /end MEASUREMENT
/begin MEASUREMENT Dang_State "" UBYTE NO_FORMULA 0 0 0 255 ECU_ADDRESS 0x2299 /end MEASUREMENT
/begin MEASUREMENT Steering_Wheel_Angle_Code "方向盘旋转编码" SWORD NO_FORMULA 0 0 0 65535 ECU_ADDRESS 0x227E /end MEASUREMENT
/begin MEASUREMENT Steering_Wheel_Angle_ZeroMark "方向盘是否经过0点校正 " UBYTE NO_FORMULA 0 0 0 255 ECU_ADDRESS 0x2280 /end MEASUREMENT
/begin MEASUREMENT LostEPSCom_Index "" UWORD NO_FORMULA 0 0 0 65535 ECU_ADDRESS 0x226C /end MEASUREMENT
/begin MEASUREMENT LostEPSCommunication "EPS通讯丢失 1802" UBYTE NO_FORMULA 0 0 0 255 ECU_ADDRESS 0x226A /end MEASUREMENT
/begin MEASUREMENT LostVehcoBreakCom_Index "" UWORD NO_FORMULA 0 0 0 65535 ECU_ADDRESS 0x2278 /end MEASUREMENT
/begin MEASUREMENT LostVehcoBreakCommunication "车辆制动状态通讯丢失 602" UBYTE NO_FORMULA 0 0 0 255 ECU_ADDRESS 0x2276 /end MEASUREMENT
/begin MEASUREMENT LostVehcoCom_Index "" UWORD NO_FORMULA 0 0 0 65535 ECU_ADDRESS 0x2270 /end MEASUREMENT
/begin MEASUREMENT LostVehcoCommunication "行车通讯丢失 1804" UBYTE NO_FORMULA 0 0 0 255 ECU_ADDRESS 0x226E /end MEASUREMENT
/begin MEASUREMENT LostVehcoStateCom_Index "" UWORD NO_FORMULA 0 0 0 65535 ECU_ADDRESS 0x2274 /end MEASUREMENT
/begin MEASUREMENT LostVehcoStateCommunication "车辆状态通讯丢失 1806" UBYTE NO_FORMULA 0 0 0 255 ECU_ADDRESS 0x2272 /end MEASUREMENT
/begin MEASUREMENT R_Control_Switch "远程驾驶激活开关" UBYTE NO_FORMULA 0 0 0 255 ECU_ADDRESS 0x222B /end MEASUREMENT
/begin MEASUREMENT EPS_Angle "EPS当前角度" SWORD rFactor10_VSSPlaus 0 0 0 65535 ECU_ADDRESS 0x27FE /end MEASUREMENT
/begin MEASUREMENT EPS_Contral_Mode "EPS控制模式指令" UBYTE NO_FORMULA 0 0 0 255 ECU_ADDRESS 0x2289 /end MEASUREMENT
/begin MEASUREMENT EPS_Demand_Angle "EPS角度命令" SWORD rFactor10_VSSPlaus 0 0 0 65535 ECU_ADDRESS 0x228A /end MEASUREMENT
/begin MEASUREMENT EPS_Run_Mode "EPS当前控制模式" UBYTE NO_FORMULA 0 0 0 255 ECU_ADDRESS 0x27F8 /end MEASUREMENT
/begin MEASUREMENT EPS_Driver_Torque "驾驶员方向盘力矩" SWORD rFactor10_VSSPlaus 0 0 0 65535 ECU_ADDRESS 0x27FA /end MEASUREMENT
/begin MEASUREMENT EPS_ERR_Level "EPS故障级别" UBYTE NO_FORMULA 0 0 0 255 ECU_ADDRESS 0x2801 /end MEASUREMENT
/begin MEASUREMENT EPS_Life "EPS心跳" UBYTE NO_FORMULA 0 0 0 255 ECU_ADDRESS 0x220A /end MEASUREMENT
/begin MEASUREMENT EPS_Temp "EPS控制器温度 2℃/bit" UBYTE NO_FORMULA 0 0 0 255 ECU_ADDRESS 0x2800 /end MEASUREMENT
/begin MEASUREMENT EPS_Torque "EPS输出力矩 0.3Nm/bit" SWORD NO_FORMULA 0 0 0 65535 ECU_ADDRESS 0x27FC /end MEASUREMENT
/begin MEASUREMENT EPB_State "EPB状态" UBYTE NO_FORMULA 0 0 0 255 ECU_ADDRESS 0x2298 /end MEASUREMENT
/begin MEASUREMENT Motor_Speed "电机转速" SWORD rpm1-1 0 0 0 65535 ECU_ADDRESS 0x229A /end MEASUREMENT
/begin MEASUREMENT Motor_Torque "电机扭矩" SWORD NO_FORMULA 0 0 0 65535 ECU_ADDRESS 0x229C /end MEASUREMENT
/begin MEASUREMENT Vehco_Acceleration_Back "车辆当前上报加速度" SBYTE rFactor10_VSSPlaus 0 0 0 255 ECU_ADDRESS 0x229E /end MEASUREMENT
/begin MEASUREMENT DriverMode_State "自驾模式状态 0 手动 1 自动 2 遥控 3 远程" UBYTE NO_FORMULA 0 0 0 255 ECU_ADDRESS 0x229F /end MEASUREMENT
/begin MEASUREMENT DoorState "车门状态" UBYTE NO_FORMULA 0 0 0 255 ECU_ADDRESS 0x22A0 /end MEASUREMENT
/begin MEASUREMENT Vehco_Speed "车速 " SWORD NO_FORMULA 0 0 0 65535 ECU_ADDRESS 0x22A2 /end MEASUREMENT
/begin MEASUREMENT SOC "SOC 精度0.5%" UBYTE SOC 0 0 0 255 ECU_ADDRESS 0x22A4 /end MEASUREMENT
/begin MEASUREMENT SmartPowerCommand "智能系统电源指令 00 启动 01 关机" UBYTE NO_FORMULA 0 0 0 255 ECU_ADDRESS 0x22A5 /end MEASUREMENT
/begin MEASUREMENT Change_State "充电状态 00 无需充电 01充电完成 02 充电中 03 电量低需要充电" UBYTE NO_FORMULA 0 0 0 255 ECU_ADDRESS 0x22A6 /end MEASUREMENT
/begin MEASUREMENT Change_Connect_State "充电连接状态 0 未连接 1 充电枪已插入" UBYTE NO_FORMULA 0 0 0 255 ECU_ADDRESS 0x22A7 /end MEASUREMENT
/begin MEASUREMENT Vehco_Fault_Level "整车故障级别" UBYTE NO_FORMULA 0 0 0 255 ECU_ADDRESS 0x22A8 /end MEASUREMENT
/begin MEASUREMENT VehcoState_Live "整车故障级别" UBYTE NO_FORMULA 0 0 0 255 ECU_ADDRESS 0x220B /end MEASUREMENT
/begin MEASUREMENT B_Current "电池电流" SWORD rFactor10_VSSPlaus 0 0 0 65535 ECU_ADDRESS 0x22AC /end MEASUREMENT
/begin MEASUREMENT B_Voltage "电池电压" UWORD rFactor10_VSSPlaus 0 0 0 65535 ECU_ADDRESS 0x22AA /end MEASUREMENT
/begin MEASUREMENT Vehco_Power_State "整车动力状态 00 INIT ON档 01 READY 02 跛行 03 故障无高压" UBYTE NO_FORMULA 0 0 0 255 ECU_ADDRESS 0x22AE /end MEASUREMENT
/begin MEASUREMENT Isolation_Level "" UBYTE NO_FORMULA 0 0 0 255 ECU_ADDRESS 0x22AF /end MEASUREMENT
/begin MEASUREMENT MCU_Fault_Level "" UBYTE NO_FORMULA 0 0 0 255 ECU_ADDRESS 0x22B0 /end MEASUREMENT
/begin MEASUREMENT BMS_Fault_Level "" UBYTE NO_FORMULA 0 0 0 255 ECU_ADDRESS 0x22B1 /end MEASUREMENT
/begin MEASUREMENT Vehco_Break_Mode "制动控制器模式 0x00：未激活 0x01：激活 0x02：融合激活" UBYTE NO_FORMULA 0 0 0 255 ECU_ADDRESS 0x22B2 /end MEASUREMENT
/begin MEASUREMENT Vehco_Break_Rang "制动力状态 0~100%" UBYTE NO_FORMULA 0 0 0 255 ECU_ADDRESS 0x22B3 /end MEASUREMENT
/begin MEASUREMENT Vehco_Break_Life "" UBYTE NO_FORMULA 0 0 0 255 ECU_ADDRESS 0x220C /end MEASUREMENT
/begin MEASUREMENT R_Break_Mode "远程制动激活" UBYTE NO_FORMULA 0 0 0 255 ECU_ADDRESS 0x2296 /end MEASUREMENT
/begin MEASUREMENT R_Break_Rang "远程制动力请求" UBYTE NO_FORMULA 0 0 0 255 ECU_ADDRESS 0x2297 /end MEASUREMENT
/begin MEASUREMENT Vehco_Acceleration_Command "加速度指令 -12.8~12.7" SBYTE rFactor10_VSSPlaus 0 0 0 255 ECU_ADDRESS 0x228D /end MEASUREMENT
/begin MEASUREMENT EPB_Command "电子手刹指令 0 无动作 1 拉起 2 释放 3 行进中制动" UBYTE NO_FORMULA 0 0 0 255 ECU_ADDRESS 0x228E /end MEASUREMENT
/begin MEASUREMENT Emergency_Braking "紧急制动指令 " UBYTE NO_FORMULA 0 0 0 255 ECU_ADDRESS 0x2290 /end MEASUREMENT
/begin MEASUREMENT DriverMode_Command "自驾模式状态 0 手动 1 保留 2 保留 3 远程" UBYTE NO_FORMULA 0 0 0 255 ECU_ADDRESS 0x2291 /end MEASUREMENT
/begin MEASUREMENT Door_Command "车门控制命令 0 无动作 1 开门 2 关门 3 保留" UBYTE NO_FORMULA 0 0 0 255 ECU_ADDRESS 0x2292 /end MEASUREMENT
/begin MEASUREMENT Beep_Command "喇叭控制 0 无动作 1 开启 2 关闭 3 保留" UBYTE NO_FORMULA 0 0 0 255 ECU_ADDRESS 0x2293 /end MEASUREMENT
/begin MEASUREMENT R_DriverSystem_State "远程驾驶系统状态 0 连接中 1 连接完成 2 断开中 3 断开" UBYTE NO_FORMULA 0 0 0 255 ECU_ADDRESS 0x2294 /end MEASUREMENT
/begin MEASUREMENT R_DriverSystem_Level "远程驾驶系统可信级别 0 不可信，立刻接管 1 低质量 ，人工监视 2 最佳状态，完全控制" UBYTE NO_FORMULA 0 0 0 255 ECU_ADDRESS 0x2208 /end MEASUREMENT
/begin MEASUREMENT R_DriverSystem_Fault_Level "远程驾驶系统故障级别 0 无故障 1 轻微 提示 2 一般故障 跛行 3 严重故障 退出远程驾驶状态" UBYTE NO_FORMULA 0 0 0 255 ECU_ADDRESS 0x2295 /end MEASUREMENT
/begin MEASUREMENT AC_Mode "车辆冷暖空调控制 0 关机 1 制冷 2 制热 3 自动" UBYTE NO_FORMULA 0 0 0 255 ECU_ADDRESS 0x2207 /end MEASUREMENT
/begin MEASUREMENT AC_Temperature "车辆冷暖空调设置温度 0.5 偏移16" UBYTE NO_FORMULA 0 0 0 255 ECU_ADDRESS 0x2209 /end MEASUREMENT
/begin MEASUREMENT AccPed "油门开度" UWORD rFactor100_PWM 0 0 0 65535 ECU_ADDRESS 0x2354 /end MEASUREMENT
/begin MEASUREMENT Vehco_Speed_Calc "计算车速" SWORD rFactor10_VSSPlaus 0 0 0 65535 ECU_ADDRESS 0x222E /end MEASUREMENT
/begin MEASUREMENT Steering_Wheel_Angle_BaseCAN "" SWORD rFactor10_VSSPlaus 0 0 0 65535 ECU_ADDRESS 0x2282 /end MEASUREMENT
/begin MEASUREMENT Steering_Wheel_Angle_BaseCAN_Max "" SWORD rFactor10_VSSPlaus 0 0 0 65535 ECU_ADDRESS 0x223A /end MEASUREMENT
/begin MEASUREMENT Steering_Wheel_Angle_BaseCAN_Min "" SWORD rFactor10_VSSPlaus 0 0 0 65535 ECU_ADDRESS 0x223C /end MEASUREMENT
/begin MEASUREMENT Steering_Wheel_Angle_Life "" UBYTE NO_FORMULA 0 0 0 255 ECU_ADDRESS 0x2288 /end MEASUREMENT
/begin MEASUREMENT AccPed_AD255 "" UBYTE NO_FORMULA 0 0 0 255 ECU_ADDRESS 0x2284 /end MEASUREMENT
/begin MEASUREMENT Breakk_AD255 "" UBYTE NO_FORMULA 0 0 0 255 ECU_ADDRESS 0x2285 /end MEASUREMENT
/begin MEASUREMENT Clutch_AD255 "" UBYTE NO_FORMULA 0 0 0 255 ECU_ADDRESS 0x2286 /end MEASUREMENT
/begin MEASUREMENT LostVehcoSteering_Wheel_AngleCommunication "" UBYTE NO_FORMULA 0 0 0 255 ECU_ADDRESS 0x227A /end MEASUREMENT
/begin MEASUREMENT LostVehcoSteering_Wheel_AngleCom_Index "" UWORD NO_FORMULA 0 0 0 65535 ECU_ADDRESS 0x227C /end MEASUREMENT
/begin MEASUREMENT Auto_Hold_Delay "" UBYTE NO_FORMULA 0 0 0 255 ECU_ADDRESS 0x2232 /end MEASUREMENT
/begin MEASUREMENT Dang_D "" UBYTE NO_FORMULA 0 0 0 255 ECU_ADDRESS 0x2234 /end MEASUREMENT
/begin MEASUREMENT Dang_N "" UBYTE NO_FORMULA 0 0 0 255 ECU_ADDRESS 0x2235 /end MEASUREMENT
/begin MEASUREMENT Dang_R "" UBYTE NO_FORMULA 0 0 0 255 ECU_ADDRESS 0x2233 /end MEASUREMENT
/begin MEASUREMENT EPB_Switch_HL "" UBYTE NO_FORMULA 0 0 0 255 ECU_ADDRESS 0x224B /end MEASUREMENT
/begin MEASUREMENT EPB_Switch_LH "" UBYTE NO_FORMULA 0 0 0 255 ECU_ADDRESS 0x224A /end MEASUREMENT
/begin MEASUREMENT Steering_Wheel_IN1 "" UBYTE NO_FORMULA 0 0 0 255 ECU_ADDRESS 0x2237 /end MEASUREMENT
/begin MEASUREMENT Steering_Wheel_IN2 "" UBYTE NO_FORMULA 0 0 0 255 ECU_ADDRESS 0x2238 /end MEASUREMENT
/begin MEASUREMENT Steering_Wheel_PWM_Out "" UWORD rFactor100_PWM 0 0 0 65535 ECU_ADDRESS 0x2202 /end MEASUREMENT
/begin MEASUREMENT Wheel_Offset_Auto "" SWORD rFactor10_VSSPlaus 0 0 0 65535 ECU_ADDRESS 0x223E /end MEASUREMENT
/begin MEASUREMENT Steering_Whee_Auto_Check_Mark "" UBYTE NO_FORMULA 0 0 0 255 ECU_ADDRESS 0x2240 /end MEASUREMENT
/begin MEASUREMENT Steering_Whee_Auto_Check_Slow_Index "" UBYTE NO_FORMULA 0 0 0 255 ECU_ADDRESS 0x2242 /end MEASUREMENT
/begin MEASUREMENT Steering_Whee_Auto_Check_Step "" UBYTE NO_FORMULA 0 0 0 255 ECU_ADDRESS 0x235E /end MEASUREMENT
/begin MEASUREMENT Steering_Whee_Auto_Check_Still_Time "" UBYTE NO_FORMULA 0 0 0 255 ECU_ADDRESS 0x2241 /end MEASUREMENT
/begin MEASUREMENT AccPed_CAN "" UWORD rFactor100_PWM 0 0 0 65535 ECU_ADDRESS 0x2244 /end MEASUREMENT
/begin MEASUREMENT Breakk_CAN "" UWORD rFactor100_PWM 0 0 0 65535 ECU_ADDRESS 0x2246 /end MEASUREMENT
/begin MEASUREMENT Clutch_CAN "" UWORD rFactor100_PWM 0 0 0 65535 ECU_ADDRESS 0x2248 /end MEASUREMENT
/begin MEASUREMENT Steering_Whee_Check_Powon_Delay "" UWORD NO_FORMULA 0 0 0 65535 ECU_ADDRESS 0x224C /end MEASUREMENT
/begin MEASUREMENT Steering_Wheel_Speed "" SWORD NO_FORMULA 0 0 0 65535 ECU_ADDRESS 0x224E /end MEASUREMENT
/begin MEASUREMENT Pwm_Add "" SWORD rFactor100_PWM 0 0 0 65535 ECU_ADDRESS 0x2252 /end MEASUREMENT
/begin MEASUREMENT Steering_Wheel_Angle_Mot_Temp "" UBYTE NO_FORMULA 0 0 0 255 ECU_ADDRESS 0x2287 /end MEASUREMENT
/begin MEASUREMENT BackZeroForce_PWM "归正力" UWORD rFactor100_control 0 0 0 65535 ECU_ADDRESS 0x2254 /end MEASUREMENT
/begin CHARACTERISTIC DataSet_idxVerUB_CA "底层数据版本" ASCII 0xF0002 ECTEK_AscII32 0 NO_COMPU_METHOD 0 255 FORMAT "%.2" NUMBER 32 /end CHARACTERISTIC
/begin CHARACTERISTIC DataSet_idxUserVerUB_CA "用户数据版本" ASCII 0xF0022 ECTEK_AscII16 0 NO_COMPU_METHOD -4294967296 4294967296 FORMAT "%.2" NUMBER 16 /end CHARACTERISTIC
/begin CHARACTERISTIC ATDDrv_infoChanUB_CA "ATDDrv_infoChanUB_CA，16个通道的AD配置情况" VAL_BLK 0xF0032 ECTEK_ValueBlock24_u8 0 NO_FORMULA 0 255 FORMAT "%.2" NUMBER 24 /end CHARACTERISTIC
/begin CHARACTERISTIC ATDDrv_idxChanSigConfUB_CA "ATDDrv_idxChanSigConfUB_CA，各个信号的通道配置" VAL_BLK 0xF004A ECTEK_ValueBlock24_u8 0 NO_FORMULA 0 32 FORMAT "%.2" NUMBER 24 /end CHARACTERISTIC
/begin CHARACTERISTIC DIODrv_idxChanSigConfUB_CA "DIODrv_idxChanSigConfUB_CA，各个数字量输入的通道配置" VAL_BLK 0xF0062 ECTEK_ValueBlock18_u8 0 NO_FORMULA 0 32 FORMAT "%.2" NUMBER 18 /end CHARACTERISTIC
/begin CHARACTERISTIC DIODrv_idxChanSwtTypeUW_CA "高低有效软件可配置数字量输入通道高低有效配置" VAL_BLK 0xF0074 ECTEK_ValueBlock18_u16 0 idxDIType 0 1 FORMAT "%.2" NUMBER 18 /end CHARACTERISTIC
/begin CHARACTERISTIC DIODrv_uLevelHighThresUW_C "高低有效软件可配通道的高电平电压门限" VALUE 0xF0098 ECTEK_Value_u16 0 uFactor4095 0 5 FORMAT "%.2" /end CHARACTERISTIC
/begin CHARACTERISTIC DIODrv_uLevelLowThresUW_C "高低有效软件可配置通道的低电平电压门限" VALUE 0xF009A ECTEK_Value_u16 0 uFactor4095 0 5 FORMAT "%.2" /end CHARACTERISTIC
/begin CHARACTERISTIC PWMDrv_idxScaleAUB_C "PWMDrv_idxScaleAUB_C, PWM模块中时钟源A的分频数" VALUE 0xF009C ECTEK_Value_u8 0 NO_COMPU_METHOD -4294967296 4294967296 FORMAT "%.2" /end CHARACTERISTIC
/begin CHARACTERISTIC PWMDrv_idxScaleBUB_C "PWMDrv_idxScaleBUB_C, PWM模块中时钟源B的分频数" VALUE 0xF009D ECTEK_Value_u8 0 NO_COMPU_METHOD -4294967296 4294967296 FORMAT "%.2" /end CHARACTERISTIC
/begin CHARACTERISTIC PWMDrv_idxScaleSAUB_C "PWMDrv_idxScaleSAUB_C, PWM模块中时钟源SA的分频数, fSA=fA/(2*N)" VALUE 0xF009E ECTEK_Value_u8 0 NO_COMPU_METHOD -4294967296 4294967296 FORMAT "%.2" /end CHARACTERISTIC
/begin CHARACTERISTIC PWMDrv_idxScaleSBUB_C "PWMDrv_idxScaleSBUB_C, PWM模块中时钟源SB的分频数, fSB=fB/(2*N)" VALUE 0xF009F ECTEK_Value_u8 0 NO_COMPU_METHOD -4294967296 4294967296 FORMAT "%.2" /end CHARACTERISTIC
/begin CHARACTERISTIC PWMDrv_idxChanTimerConfUB_CA "PWMDrv_idxChanTimerConfUB_CA, PWM各通道所用时钟源, X0(PWM1)与X2(PWM5)使用A或SA, X1(PWM3)和X3(PWM7)使用B或SB" VAL_BLK 0xF00A0 ECTEK_ValueBlock4_u8 0 NO_COMPU_METHOD -4294967296 4294967296 FORMAT "%.2" NUMBER 4 /end CHARACTERISTIC
/begin CHARACTERISTIC PWMDrv_stChanPrecTypeUB_CA "PWM通道的精度类型，0为要求宽频率范围,1为要求宽占空比范围" VAL_BLK 0xF00A4 ECTEK_ValueBlock4_u8 0 NO_COMPU_METHOD -4294967296 4294967296 FORMAT "%.2" NUMBER 4 /end CHARACTERISTIC
/begin CHARACTERISTIC PWMDrv_idxFuncConfUB_CA "PWMDrv_idxFuncConfUB_CA, PWM模块中各功能所对应PWM管脚配置" VAL_BLK 0xF00A8 ECTEK_ValueBlock4_u8 0 NO_FORMULA 0 255 FORMAT "%.2" NUMBER 4 /end CHARACTERISTIC
/begin CHARACTERISTIC LSPWMDrv_idxChanSigConfUB_CA "PWM型低边驱动各任务通道配置" VAL_BLK 0xF00AC ECTEK_ValueBlock4_u8 0 NO_FORMULA 0 255 FORMAT "%.2" NUMBER 4 /end CHARACTERISTIC
/begin CHARACTERISTIC L9825Drv_swtUseUB_CA "L9825Drv_swtUseUB_CA, L9825两块芯片的使能配置" VAL_BLK 0xF00B0 ECTEK_ValueBlock2_u8 0 bFunctionActive 0 1 FORMAT "%.2" NUMBER 2 /end CHARACTERISTIC
/begin CHARACTERISTIC PSWTDrv_idxChanSigConfUB_CA "PSWTDrv_idxChanSigConfUB_CA, 高低边驱动任务号配置，0~7为低边驱动，8~15为高边驱动" VAL_BLK 0xF00B2 ECTEK_ValueBlock16_u8 0 NO_FORMULA 0 255 FORMAT "%.2" NUMBER 16 /end CHARACTERISTIC
/begin CHARACTERISTIC SysCon_stIRevShuOffMskUI_C "SysCon_stIRevShuOffMaskUI_C" VALUE 0xF00C2 ECTEK_Value_u32 0 NO_COMPU_METHOD -4294967296 4294967296 FORMAT "%.2" /end CHARACTERISTIC
/begin CHARACTERISTIC SysCon_stRevShuOffMskUI_C "SysCon_stRevShuOffMaskUI_C" VALUE 0xF00C6 ECTEK_Value_u32 0 NO_COMPU_METHOD -4294967296 4294967296 FORMAT "%.2" /end CHARACTERISTIC
/begin CHARACTERISTIC SysCon_stExtWaitMskUW_C "SysCon_stExtWaitMskUW_C，PostDrive状态等待结束的事件Mask" VALUE 0xF00CA ECTEK_Value_u16 0 NO_COMPU_METHOD -4294967296 4294967296 FORMAT "%.2" /end CHARACTERISTIC
/begin CHARACTERISTIC SysCon_stExtWait2MskUW_C "SysCon_stExtWait2MskUW_C，PostDrive状态等待结束的事件Mask" VALUE 0xF00CC ECTEK_Value_u16 0 NO_COMPU_METHOD -4294967296 4294967296 FORMAT "%.2" /end CHARACTERISTIC
/begin CHARACTERISTIC SysCon_tiPostDriveMaxUI_C "SysCon_tiPostDriveMaxUI_C，PostDrive最长时间，s" VALUE 0xF00CE ECTEK_Value_u32 0 NO_COMPU_METHOD -4294967296 4294967296 FORMAT "%.2" /end CHARACTERISTIC
/begin CHARACTERISTIC SysCon_tiShutdownMaxUI_C "SysCon_tiShutdownMaxUI_C，shutdown状态最长执行时间，s" VALUE 0xF00D2 ECTEK_Value_u32 0 NO_COMPU_METHOD -4294967296 4294967296 FORMAT "%.2" /end CHARACTERISTIC
/begin CHARACTERISTIC SysCon_tiPostDriveMinUI_C "SysCon_tiPostDriveMinUI_C，PostDrive最短时间，s" VALUE 0xF00D6 ECTEK_Value_u32 0 NO_COMPU_METHOD -4294967296 4294967296 FORMAT "%.2" /end CHARACTERISTIC
/begin CHARACTERISTIC MSCANDrv_infoBaudrateUW_CA "MSCANDrv_infoBaudrateUW_CA" VAL_BLK 0xF00DA ECTEK_ValueBlock3_u16 0 idxBaudRate 0 3 FORMAT "%.2" NUMBER 3 /end CHARACTERISTIC
/begin CHARACTERISTIC KWPCAN_tiToBMaxUW_C "KWPCAN_tiToBMaxUW_C,ToB 最长时间50*100ms" VALUE 0xF00E0 ECTEK_Value_u16 0 tiFactor20_50ms 0 500 FORMAT "%.2" /end CHARACTERISTIC
/begin CHARACTERISTIC KWPCAN_tiToCMaxUW_C "KWPCAN_tiToCMaxUW_C,ToC 最长时间50*100ms" VALUE 0xF00E2 ECTEK_Value_u16 0 tiFactor20_50ms 0 500 FORMAT "%.2" /end CHARACTERISTIC
/begin CHARACTERISTIC KWPCAN_numFCWMaxUW_C "KWPCAN_numFCWMaxUW_C,最多的Flow Control Wait Frame数目16" VALUE 0xF00E4 ECTEK_Value_u16 0 NO_FORMULA 0 1000 FORMAT "%.2" /end CHARACTERISTIC
/begin CHARACTERISTIC CCP_StationIdUB_CA "" ASCII 0xF00E6 ECTEK_AscII10 0 NO_COMPU_METHOD 0 255 FORMAT "%.2" NUMBER 10 /end CHARACTERISTIC
/begin CHARACTERISTIC SigTst_bEnUW_C "SigTst_bEnUW_C，是否直接控制9825和9362" VALUE 0xF00F0 ECTEK_Value_u16 0 bFunctionActive 0 1 FORMAT "%.2" /end CHARACTERISTIC
/begin CHARACTERISTIC SigTst_bChanL9825UB_CA "SigTst_bChanL9825UB_CA，各通道开关" VAL_BLK 0xF00F2 ECTEK_ValueBlock16_u8 0 bSwitch 0 1 FORMAT "%.2" NUMBER 16 /end CHARACTERISTIC
/begin CHARACTERISTIC SigTst_fChanL9825UI_CA "SigTst_fChanL9825UI_CA，L9825各通道的PWM频率" VAL_BLK 0xF0102 ECTEK_ValueBlock4_u32 0 NO_COMPU_METHOD -4294967296 4294967296 FORMAT "%.2" NUMBER 4 /end CHARACTERISTIC
/begin CHARACTERISTIC SigTst_rChanL9825UW_CA "SigTst_rChanL9825UW_CA，L9825各通道的占空比" VAL_BLK 0xF0112 ECTEK_ValueBlock4_u16 0 rFactor100_PWM 0 100 FORMAT "%.2" NUMBER 4 /end CHARACTERISTIC
/begin CHARACTERISTIC SigTst_bChanBTS724UB_CA "SigTst_bChanBTS724UB_CA，高边驱动开关" VAL_BLK 0xF011A ECTEK_ValueBlock8_u8 0 bSwitch 0 1 FORMAT "%.2" NUMBER 8 /end CHARACTERISTIC
/begin CHARACTERISTIC BattCD_uLogicOnUW_C "逻辑电上电电压限值" VALUE 0xF0122 ECTEK_Value_u16 0 uFactor4095 0 5 FORMAT "%.2" /end CHARACTERISTIC
/begin CHARACTERISTIC BattCD_uUW_CUR "蓄电池电压特性" CURVE 0xF0124 ECTEK_Curve_u16u16 0 uFactor100_Batt 0 60
 /begin AXIS_DESCR STD_AXIS NO_INPUT_QUANTITY uFactor4095 4 0 5 DEPOSIT ABSOLUTE FORMAT "%.2" /end AXIS_DESCR
 FORMAT "%.2" /end CHARACTERISTIC
/begin CHARACTERISTIC VehDataSet_idxSupervisorVerUB_CA "标准数据版本号" ASCII 0xF0136 ECTEK_AscII16 0 NO_COMPU_METHOD -4294967296 4294967296 FORMAT "%.2" NUMBER 16 /end CHARACTERISTIC
/begin CHARACTERISTIC VehDataSet_idxUserVerUB_CA "用户数据版本号" ASCII 0xF0146 ECTEK_AscII16 0 NO_COMPU_METHOD -4294967296 4294967296 FORMAT "%.2" NUMBER 16 /end CHARACTERISTIC
/begin CHARACTERISTIC Test_bSaveCmdUW_C "单值标定变量示例 触发EEPROM的存储" VALUE 0xF0156 ECTEK_Value_u8 0 NO_COMPU_METHOD 0 255 FORMAT "%.2" /end CHARACTERISTIC
/begin CHARACTERISTIC Test_tTempUW_CUR "曲线标定变量示例" CURVE 0xF0157 ECTEK_Curve_u16u16 0 tFactor256 -40 125
 /begin AXIS_DESCR STD_AXIS NO_INPUT_QUANTITY uFactor4095 8 0 5 DEPOSIT ABSOLUTE FORMAT "%.2" /end AXIS_DESCR
 FORMAT "%.2" /end CHARACTERISTIC
/begin CHARACTERISTIC Test_tiTimeUW_MAP "曲面标定变量示例" MAP 0xF0179 ECTEK_Map_u16u16u16 0 tiFactor1_1us 0 65535
 /begin AXIS_DESCR STD_AXIS NO_INPUT_QUANTITY nFactor1 8 0 6000 DEPOSIT ABSOLUTE FORMAT "%.2" /end AXIS_DESCR
 /begin AXIS_DESCR STD_AXIS NO_INPUT_QUANTITY vFactor32 4 0 300 DEPOSIT ABSOLUTE FORMAT "%.2" /end AXIS_DESCR
 FORMAT "%.2" /end CHARACTERISTIC
/begin CHARACTERISTIC Test_strVersionUB_CA "字符串标定变量示例" ASCII 0xF01D5 ECTEK_AscII16 0 NO_COMPU_METHOD -0 255 FORMAT "%.2" NUMBER 16 /end CHARACTERISTIC
/begin CHARACTERISTIC Percent_Filter_And_All "油门滤波百分比-0总数-1增量占比-2减量占比" VAL_BLK 0xF01E5 ECTEK_ValueBlock4_u16 0 NO_FORMULA 0 1000 FORMAT "%.2" NUMBER 4 /end CHARACTERISTIC
/begin CHARACTERISTIC VCU_C_1 "整车控制帧-版本-日期-型号H渣土车" VAL_BLK 0xF01ED ECTEK_ValueBlock7_u8 0 NO_FORMULA 0 255 FORMAT "%.2" NUMBER 7 /end CHARACTERISTIC
/begin CHARACTERISTIC Vehicle_Type "车型定义 1 实验室驾驶舱 2 钢架驾驶舱" VALUE 0xF01F4 ECTEK_Value_u8 0 NO_FORMULA 1 255 FORMAT "%.2" /end CHARACTERISTIC
/begin CHARACTERISTIC AccPed_Differ_Limit "双油门差值极限 100倍 %" VALUE 0xF01F5 ECTEK_Value_u16 0 rFactor100_control 0 10000 FORMAT "%.2" /end CHARACTERISTIC
/begin CHARACTERISTIC AccPed_BreakErr_Max "油门刹车同时踩故障 最大油门值 0~100.00%" VALUE 0xF01F7 ECTEK_Value_u16 0 rFactor100_PWM 0 100 FORMAT "%.2" /end CHARACTERISTIC
/begin CHARACTERISTIC Error_PowOn_Delay_Max "上电故障检测延迟 *10ms" VALUE 0xF01F9 ECTEK_Value_u16 0 NO_FORMULA 0 65535 FORMAT "%.2" /end CHARACTERISTIC
/begin CHARACTERISTIC Err_AccPed_Index_Max "油门故障检测延迟 *10ms" VALUE 0xF01FB ECTEK_Value_u8 0 NO_COMPU_METHOD 1 255 FORMAT "%.2" /end CHARACTERISTIC
/begin CHARACTERISTIC LostEPSCom_Index_Max "EPS通讯丢失超时 *10ms" VALUE 0xF01FC ECTEK_Value_u8 0 NO_FORMULA 1 255 FORMAT "%.2" /end CHARACTERISTIC
/begin CHARACTERISTIC LostVehcoCom_Index_Max "行车状态通讯丢失超时 *10ms" VALUE 0xF01FD ECTEK_Value_u8 0 NO_FORMULA 1 255 FORMAT "%.2" /end CHARACTERISTIC
/begin CHARACTERISTIC LostVehcoStateCom_Index_Max "车辆状态通讯丢失超时 *10ms" VALUE 0xF01FE ECTEK_Value_u8 0 NO_FORMULA 1 255 FORMAT "%.2" /end CHARACTERISTIC
/begin CHARACTERISTIC LostVehcoBreakCom_Index_Max "车辆制动状态通讯丢失超时 *10ms" VALUE 0xF01FF ECTEK_Value_u8 0 NO_FORMULA 1 255 FORMAT "%.2" /end CHARACTERISTIC
/begin CHARACTERISTIC LostVehcoSteering_Wheel_AngleCom_Index_Max "模拟方向盘通讯丢失超时 *10ms" VALUE 0xF0200 ECTEK_Value_u8 0 NO_FORMULA 1 255 FORMAT "%.2" /end CHARACTERISTIC
/begin CHARACTERISTIC EPS_Angle_Max "EPS角度命令最大值 0.1°" VALUE 0xF0201 ECTEK_Value_s16 0 rFactor10_VSSPlaus -32768 32767 FORMAT "%.2" /end CHARACTERISTIC
/begin CHARACTERISTIC EPS_Angle_Min "EPS角度命令最小值 0.1°" VALUE 0xF0203 ECTEK_Value_s16 0 rFactor10_VSSPlaus -32768 32767 FORMAT "%.2" /end CHARACTERISTIC
/begin CHARACTERISTIC R_Break_Min "远程制动j激活最小开度" VALUE 0xF0205 ECTEK_Value_u16 0 rFactor100_PWM 0 100 FORMAT "%.2" /end CHARACTERISTIC
/begin CHARACTERISTIC Wheel_Offset "方向盘编码器偏移" VALUE 0xF0207 ECTEK_Value_s16 0 NO_FORMULA -32768 32767 FORMAT "%.2" /end CHARACTERISTIC
/begin CHARACTERISTIC EPS_Offset "EPS角度偏移" VALUE 0xF0209 ECTEK_Value_s16 0 rFactor10_VSSPlaus -32768 32767 FORMAT "%.2" /end CHARACTERISTIC
/begin CHARACTERISTIC DriveModeDebug "远程驾驶模式DEBUG激活" VALUE 0xF020B ECTEK_Value_u8 0 NO_FORMULA 0 255 FORMAT "%.2" /end CHARACTERISTIC
/begin CHARACTERISTIC D_Dang_Change_Delay_Index_Max "" VALUE 0xF020C ECTEK_Value_u16 0 NO_FORMULA 1 65535 FORMAT "%.2" /end CHARACTERISTIC
/begin CHARACTERISTIC Break_Acceleration_Min_Step "制动控制最小步进" VALUE 0xF020E ECTEK_Value_u8 0 NO_FORMULA 1 255 FORMAT "%.2" /end CHARACTERISTIC
/begin CHARACTERISTIC Eps_AngleMaxSpeed "" VALUE 0xF020F ECTEK_Value_u8 0 NO_FORMULA 0 255 FORMAT "%.2" /end CHARACTERISTIC
/begin CHARACTERISTIC Auto_Hold_Delay_Max "Auto_Hold_Delay_Max" VALUE 0xF0210 ECTEK_Value_u16 0 NO_FORMULA 1 65535 FORMAT "%.2" /end CHARACTERISTIC
/begin CHARACTERISTIC Auto_Hold_Release_Torque "" VALUE 0xF0212 ECTEK_Value_s16 0 NO_FORMULA -32768 32767 FORMAT "%.2" /end CHARACTERISTIC
/begin CHARACTERISTIC Motor_Vehicle_Speed_Scale_T01 "车辆速比" VALUE 0xF0214 ECTEK_Value_u16 0 NO_FORMULA 0 65535 BIT_MASK 0xFF FORMAT "%.2" /end CHARACTERISTIC
/begin CHARACTERISTIC AccPedCD_TYPE_T01 "油门类型 1 双线 2 单线" VALUE 0xF0216 ECTEK_Value_u8 0 NO_FORMULA 1 2 FORMAT "%.2" /end CHARACTERISTIC
/begin CHARACTERISTIC Breakk_Type_T01 "制动类型 0：单路开关量 1：双路互反开关量 2：单路模拟量 3：双路模拟量" VALUE 0xF0217 ECTEK_Value_u8 0 NO_FORMULA 0 255 FORMAT "%.2" /end CHARACTERISTIC
/begin CHARACTERISTIC AccPedCD_rUW_CUR_T01 "油门开度" CURVE 0xF0218 ECTEK_Curve_u16u16 0 rFactor100_PWM 0 100
 /begin AXIS_DESCR STD_AXIS NO_INPUT_QUANTITY u5V 7 0 5 DEPOSIT ABSOLUTE FORMAT "%.2" /end AXIS_DESCR
 FORMAT "%.2" /end CHARACTERISTIC
/begin CHARACTERISTIC AccPedCD_rUW_CUR2_T01 "油门开度2" CURVE 0xF0236 ECTEK_Curve_u16u16 0 rFactor100_PWM 0 100
 /begin AXIS_DESCR STD_AXIS NO_INPUT_QUANTITY u5V 7 0 5 DEPOSIT ABSOLUTE FORMAT "%.2" /end AXIS_DESCR
 FORMAT "%.2" /end CHARACTERISTIC
/begin CHARACTERISTIC AccPed_Rip_T01 "油门曲线" CURVE 0xF0254 ECTEK_Curve_u16u16 0 rFactor100_PWM 0 100
 /begin AXIS_DESCR STD_AXIS NO_INPUT_QUANTITY rFactor100_PWM 11 0 100 DEPOSIT ABSOLUTE FORMAT "%.2" /end AXIS_DESCR
 FORMAT "%.2" /end CHARACTERISTIC
/begin CHARACTERISTIC Breakk_rUW_CUR_T01 "制动踏板深度" CURVE 0xF0282 ECTEK_Curve_u16u16 0 rFactor100_PWM 0 100
 /begin AXIS_DESCR STD_AXIS NO_INPUT_QUANTITY u5V 7 0 5 DEPOSIT ABSOLUTE FORMAT "%.2" /end AXIS_DESCR
 FORMAT "%.2" /end CHARACTERISTIC
/begin CHARACTERISTIC AccPed_Acceleration_T01 "油门开度-加速度" CURVE 0xF02A0 ECTEK_Curve_s16u16 0 rFactor10_VSSPlaus -12.8 12.7
 /begin AXIS_DESCR STD_AXIS NO_INPUT_QUANTITY rFactor100_PWM 11 0 100 DEPOSIT ABSOLUTE FORMAT "%.2" /end AXIS_DESCR
 FORMAT "%.2" /end CHARACTERISTIC
/begin CHARACTERISTIC Break_Acceleration_T01 "制动深度-制动力给定%" CURVE 0xF02CE ECTEK_Curve_s16u16 0 NO_FORMULA 0 100
 /begin AXIS_DESCR STD_AXIS NO_INPUT_QUANTITY rFactor100_PWM 11 0 100 DEPOSIT ABSOLUTE FORMAT "%.2" /end AXIS_DESCR
 FORMAT "%.2" /end CHARACTERISTIC
/begin CHARACTERISTIC Steering_Whee_Auto_Check_Pwm "方向盘自检PWM占空比" VALUE 0xF02FC ECTEK_Value_u16 0 rFactor100_PWM 1 98 FORMAT "%.2" /end CHARACTERISTIC
/begin CHARACTERISTIC Steering_Whee_Auto_Check_Still_Time_Max "方向盘自检堵转时间上限 10ms" VALUE 0xF02FE ECTEK_Value_u8 0 NO_FORMULA 1 255 FORMAT "%.2" /end CHARACTERISTIC
/begin CHARACTERISTIC Die_Angle "方向盘死区角度" VALUE 0xF02FF ECTEK_Value_u8 0 rFactor10_VSSPlaus 0 255 FORMAT "%.2" /end CHARACTERISTIC
/begin CHARACTERISTIC Motor_Vehicle_Speed_Scale_T02 "车辆速比" VALUE 0xF0300 ECTEK_Value_u16 0 NO_FORMULA 0 65535 FORMAT "%.2" /end CHARACTERISTIC
/begin CHARACTERISTIC AccPedCD_TYPE_T02 "油门类型 1 双线 2 单线 4 CAN" VALUE 0xF0302 ECTEK_Value_u8 0 NO_FORMULA 1 4 FORMAT "%.2" /end CHARACTERISTIC
/begin CHARACTERISTIC Breakk_Type_T02 "制动类型 0：单路开关量 1：双路互反开关量 2：单路模拟量 3：双路模拟量 4:CAN" VALUE 0xF0303 ECTEK_Value_u8 0 NO_FORMULA 0 255 FORMAT "%.2" /end CHARACTERISTIC
/begin CHARACTERISTIC AccPed_Rip_T02 "油门曲线" CURVE 0xF0304 ECTEK_Curve_u16u16 0 rFactor100_PWM 0 100
 /begin AXIS_DESCR STD_AXIS NO_INPUT_QUANTITY rFactor100_PWM 11 0 100 DEPOSIT ABSOLUTE FORMAT "%.2" /end AXIS_DESCR
 FORMAT "%.2" /end CHARACTERISTIC
/begin CHARACTERISTIC AccPed_Acceleration_T02 "油门开度-加速度" CURVE 0xF0332 ECTEK_Curve_s16u16 0 rFactor10_VSSPlaus -12.8 12.7
 /begin AXIS_DESCR STD_AXIS NO_INPUT_QUANTITY rFactor100_PWM 11 0 100 DEPOSIT ABSOLUTE FORMAT "%.2" /end AXIS_DESCR
 FORMAT "%.2" /end CHARACTERISTIC
/begin CHARACTERISTIC Break_Acceleration_T02 "制动深度-制动力给定%" CURVE 0xF0360 ECTEK_Curve_s16u16 0 rFactor10_VSSPlaus -12.8 12.7
 /begin AXIS_DESCR STD_AXIS NO_INPUT_QUANTITY rFactor100_PWM 11 0 100 DEPOSIT ABSOLUTE FORMAT "%.2" /end AXIS_DESCR
 FORMAT "%.2" /end CHARACTERISTIC
/begin CHARACTERISTIC AccPedCD_CUR_T02 "油门曲线" CURVE 0xF038E ECTEK_Curve_u16u16 0 rFactor100_PWM 0 100
 /begin AXIS_DESCR STD_AXIS NO_INPUT_QUANTITY NO_FORMULA 7 0 255 DEPOSIT ABSOLUTE FORMAT "%.2" /end AXIS_DESCR
 FORMAT "%.2" /end CHARACTERISTIC
/begin CHARACTERISTIC Breakk_CUR_T02 "制动踏板曲线" CURVE 0xF03AC ECTEK_Curve_u16u16 0 rFactor100_PWM 0 100
 /begin AXIS_DESCR STD_AXIS NO_INPUT_QUANTITY NO_FORMULA 7 0 255 DEPOSIT ABSOLUTE FORMAT "%.2" /end AXIS_DESCR
 FORMAT "%.2" /end CHARACTERISTIC
/begin CHARACTERISTIC Clutch_CUR_T02 "离合踏板曲线" CURVE 0xF03CA ECTEK_Curve_u16u16 0 rFactor100_PWM 0 100
 /begin AXIS_DESCR STD_AXIS NO_INPUT_QUANTITY NO_FORMULA 7 0 255 DEPOSIT ABSOLUTE FORMAT "%.2" /end AXIS_DESCR
 FORMAT "%.2" /end CHARACTERISTIC
/begin CHARACTERISTIC Level_Low "低门限" VALUE 0xF03E8 ECTEK_Value_u16 0 rFactor100_PWM 0 100 FORMAT "%.2" /end CHARACTERISTIC
/begin CHARACTERISTIC Level_High "高门限" VALUE 0xF03EA ECTEK_Value_u16 0 rFactor100_PWM 0 100 FORMAT "%.2" /end CHARACTERISTIC
/begin CHARACTERISTIC Rtest_whee "" VALUE 0xF03EC ECTEK_Value_u8 0 NO_FORMULA 0 255 FORMAT "%.2" /end CHARACTERISTIC
/begin CHARACTERISTIC Tag_Speed "" VALUE 0xF03ED ECTEK_Value_s16 0 NO_FORMULA -32768 32767 FORMAT "%.2" /end CHARACTERISTIC
/begin CHARACTERISTIC Speed_To_Pwm_Add "Speed_To_Pwm_Add" CURVE 0xF03EF ECTEK_Curve_s16s16 0 rFactor100_PWM -32768 32767
 /begin AXIS_DESCR STD_AXIS NO_INPUT_QUANTITY NO_FORMULA 9 -32768 32767 DEPOSIT ABSOLUTE FORMAT "%.2" /end AXIS_DESCR
 FORMAT "%.2" /end CHARACTERISTIC
/begin CHARACTERISTIC Fsetpwm "Fsetpwm" VALUE 0xF0415 ECTEK_Value_u32 0 PWM_Hz100 0 4294967295 /end CHARACTERISTIC
/begin CHARACTERISTIC BackZeroForce_Angle "回正力曲线" CURVE 0xF0419 ECTEK_Curve_u16s16 0 rFactor100_PWM 0 100
 /begin AXIS_DESCR STD_AXIS NO_INPUT_QUANTITY rFactor10_VSSPlaus 13 -540 540 DEPOSIT ABSOLUTE FORMAT "%.2" /end AXIS_DESCR
 FORMAT "%.2" /end CHARACTERISTIC
/begin MEASUREMENT Cloud_Takeover_Cmd "" UBYTE NO_COMPU_METHOD 0 0 0 255 ECU_ADDRESS 0x2802 /end MEASUREMENT
/begin GROUP ECUTest "Comment" /begin REF_CHARACTERISTIC /end REF_CHARACTERISTIC
 /begin REF_MEASUREMENT AccPed1 AccPed2 BattCD_bLogicOnUB AccPed_Differ Breakk B_Current B_Voltage Vehco_Power_State Isolation_Level MCU_Fault_Level BMS_Fault_Level AccPed /end REF_MEASUREMENT
 ROOT
 /begin SUB_GROUP bDiSatus bDoSatus CAN发送处理 CAN接收处理 EEPROM Other R-DRIVER uAD /end SUB_GROUP
/end GROUP
/begin GROUP bDiSatus "" /begin REF_CHARACTERISTIC /end REF_CHARACTERISTIC
 /begin REF_MEASUREMENT bDiSatus._0_ bDiSatus._1_ bDiSatus._2_ bDiSatus._3_ bDiSatus._4_ bDiSatus._5_ bDiSatus._6_ bDiSatus._7_ bDiSatus._8_ bDiSatus._9_ bDiSatus._10_ bDiSatus._11_ bDiSatus._12_ bDiSatus._13_ bDiSatus._14_ bDiSatus._15_ bDiSatus._16_ bDiSatus._17_ /end REF_MEASUREMENT
/end GROUP
/begin GROUP bDoSatus "" /begin REF_CHARACTERISTIC /end REF_CHARACTERISTIC
 /begin REF_MEASUREMENT bDoSatus._00 bDoSatus._01 bDoSatus._02 bDoSatus._03 bDoSatus._04 bDoSatus._05 bDoSatus._06 bDoSatus._07 bDoSatus._08 bDoSatus._09 bDoSatus._10 bDoSatus._11 bDoSatus._12 bDoSatus._13 bDoSatus._14 bDoSatus._15 /end REF_MEASUREMENT
/end GROUP
/begin GROUP CAN发送处理 "" /begin REF_CHARACTERISTIC /end REF_CHARACTERISTIC /begin REF_MEASUREMENT /end REF_MEASUREMENT /end GROUP
/begin GROUP CAN接收处理 "" /begin REF_CHARACTERISTIC /end REF_CHARACTERISTIC /begin REF_MEASUREMENT /end REF_MEASUREMENT /end GROUP
/begin GROUP EEPROM "" /begin REF_CHARACTERISTIC /end REF_CHARACTERISTIC /begin REF_MEASUREMENT PowOn_Times /end REF_MEASUREMENT /end GROUP
/begin GROUP Other "从MAP中导入" /begin REF_CHARACTERISTIC /end REF_CHARACTERISTIC /begin REF_MEASUREMENT SC_CAN0_Baudrat SC_CAN1_Baudrat SC_CAN2_Baudrat /end REF_MEASUREMENT /end GROUP
/begin GROUP R-DRIVER "" /begin REF_CHARACTERISTIC /end REF_CHARACTERISTIC
 /begin REF_MEASUREMENT Dang_Command Steering_Wheel_Angle_Code Steering_Wheel_Angle_ZeroMark R_Control_Switch Vehco_Acceleration_Command EPB_Command Emergency_Braking DriverMode_Command Door_Command Beep_Command R_DriverSystem_State R_DriverSystem_Level R_DriverSystem_Fault_Level AC_Mode AC_Temperature Vehco_Speed_Calc BackZeroForce_PWM /end REF_MEASUREMENT
 /begin SUB_GROUP AutoHold EPS_1801_1802 LostCommunication R_BREAK_601_602 Steering_Wheel_Angle_Base Vehco_1804 VehcoState_1806 /end SUB_GROUP
/end GROUP
/begin GROUP AutoHold "" /begin REF_CHARACTERISTIC /end REF_CHARACTERISTIC
 /begin REF_MEASUREMENT Auto_Hold_Delay Dang_D Dang_N Dang_R EPB_Switch_HL EPB_Switch_LH /end REF_MEASUREMENT
/end GROUP
/begin GROUP EPS_1801_1802 "" /begin REF_CHARACTERISTIC /end REF_CHARACTERISTIC
 /begin REF_MEASUREMENT EPS_Angle EPS_Contral_Mode EPS_Demand_Angle EPS_Run_Mode EPS_Driver_Torque EPS_ERR_Level EPS_Life EPS_Temp EPS_Torque /end REF_MEASUREMENT
/end GROUP
/begin GROUP LostCommunication "" /begin REF_CHARACTERISTIC /end REF_CHARACTERISTIC
 /begin REF_MEASUREMENT LostEPSCom_Index LostEPSCommunication LostVehcoBreakCom_Index LostVehcoBreakCommunication LostVehcoCom_Index LostVehcoCommunication LostVehcoStateCom_Index LostVehcoStateCommunication /end REF_MEASUREMENT
/end GROUP
/begin GROUP R_BREAK_601_602 "" /begin REF_CHARACTERISTIC /end REF_CHARACTERISTIC
 /begin REF_MEASUREMENT Vehco_Break_Mode Vehco_Break_Rang Vehco_Break_Life R_Break_Mode R_Break_Rang /end REF_MEASUREMENT
/end GROUP
/begin GROUP Steering_Wheel_Angle_Base "" /begin REF_CHARACTERISTIC /end REF_CHARACTERISTIC
 /begin REF_MEASUREMENT Steering_Wheel_Angle_BaseCAN Steering_Wheel_Angle_BaseCAN_Max Steering_Wheel_Angle_BaseCAN_Min Steering_Wheel_Angle_Life AccPed_AD255 Breakk_AD255 Clutch_AD255 LostVehcoSteering_Wheel_AngleCommunication LostVehcoSteering_Wheel_AngleCom_Index Steering_Wheel_IN1 Steering_Wheel_IN2 Steering_Wheel_PWM_Out Wheel_Offset_Auto Steering_Whee_Auto_Check_Mark Steering_Whee_Auto_Check_Slow_Index Steering_Whee_Auto_Check_Step Steering_Whee_Auto_Check_Still_Time AccPed_CAN Breakk_CAN Clutch_CAN Steering_Whee_Check_Powon_Delay Steering_Wheel_Speed Pwm_Add Steering_Wheel_Angle_Mot_Temp /end REF_MEASUREMENT
/end GROUP
/begin GROUP Vehco_1804 "行车状态" /begin REF_CHARACTERISTIC /end REF_CHARACTERISTIC
 /begin REF_MEASUREMENT EPB_State Motor_Speed Motor_Torque Vehco_Acceleration_Back Dang_State /end REF_MEASUREMENT
/end GROUP
/begin GROUP VehcoState_1806 "车辆状态1" /begin REF_CHARACTERISTIC /end REF_CHARACTERISTIC
 /begin REF_MEASUREMENT DriverMode_State DoorState Vehco_Speed SOC SmartPowerCommand Change_State Change_Connect_State Vehco_Fault_Level VehcoState_Live /end REF_MEASUREMENT
/end GROUP
/begin GROUP uAD "" /begin REF_CHARACTERISTIC /end REF_CHARACTERISTIC
 /begin REF_MEASUREMENT uAD1 uAD2 uAD4Satus._0_ uAD4Satus._1_ uAD4Satus._2_ uAD4Satus._3_ uAD3 uAD4 /end REF_MEASUREMENT
/end GROUP
/begin GROUP HardwareDrv "Comment" /begin REF_CHARACTERISTIC /end REF_CHARACTERISTIC /begin REF_MEASUREMENT /end REF_MEASUREMENT ROOT /begin SUB_GROUP AD AO DIO ICs Interface PulseAcq Timer VREG /end SUB_GROUP /end GROUP
/begin GROUP AD "Comment" /begin REF_CHARACTERISTIC ATDDrv_idxChanSigConfUB_CA ATDDrv_infoChanUB_CA /end REF_CHARACTERISTIC /begin REF_MEASUREMENT /end REF_MEASUREMENT /end GROUP
/begin GROUP AO "Comment" /begin REF_CHARACTERISTIC /end REF_CHARACTERISTIC /begin REF_MEASUREMENT /end REF_MEASUREMENT /end GROUP
/begin GROUP DIO "Comment"
 /begin REF_CHARACTERISTIC DIODrv_idxChanSigConfUB_CA DIODrv_idxChanSwtTypeUW_CA DIODrv_uLevelHighThresUW_C DIODrv_uLevelLowThresUW_C /end REF_CHARACTERISTIC
 /begin REF_MEASUREMENT /end REF_MEASUREMENT
/end GROUP
/begin GROUP ICs "集成芯片驱动" /begin REF_CHARACTERISTIC SigTst_bEnUW_C /end REF_CHARACTERISTIC /begin REF_MEASUREMENT /end REF_MEASUREMENT /end GROUP
/begin GROUP Interface "Comment"
 /begin REF_CHARACTERISTIC CCP_StationIdUB_CA KWPCAN_numFCWMaxUW_C KWPCAN_tiToBMaxUW_C KWPCAN_tiToCMaxUW_C /end REF_CHARACTERISTIC
 /begin REF_MEASUREMENT /end REF_MEASUREMENT
/end GROUP
/begin GROUP PulseAcq "Comment" /begin REF_CHARACTERISTIC /end REF_CHARACTERISTIC /begin REF_MEASUREMENT /end REF_MEASUREMENT /end GROUP
/begin GROUP Timer "Comment" /begin REF_CHARACTERISTIC /end REF_CHARACTERISTIC /begin REF_MEASUREMENT /end REF_MEASUREMENT /end GROUP
/begin GROUP VREG "Comment" /begin REF_CHARACTERISTIC /end REF_CHARACTERISTIC /begin REF_MEASUREMENT /end REF_MEASUREMENT /end GROUP
/begin GROUP SysCon "Comment"
 /begin REF_CHARACTERISTIC SysCon_stExtWait2MskUW_C SysCon_stExtWaitMskUW_C SysCon_stIRevShuOffMskUI_C SysCon_stRevShuOffMskUI_C SysCon_tiPostDriveMaxUI_C SysCon_tiPostDriveMinUI_C SysCon_tiShutdownMaxUI_C /end REF_CHARACTERISTIC
 /begin REF_MEASUREMENT /end REF_MEASUREMENT
 ROOT /end GROUP
/begin RECORD_LAYOUT TEST_Cur_u16u16 ALIGNMENT_BYTE 1 ALIGNMENT_FLOAT32_IEEE 4 ALIGNMENT_FLOAT64_IEEE 4 ALIGNMENT_LONG 4 ALIGNMENT_WORD 2 AXIS_PTS_X 2 UWORD INDEX_INCR DIRECT FNC_VALUES 3 UWORD ROW_DIR DIRECT NO_AXIS_PTS_X 1 UWORD /end RECORD_LAYOUT
/begin RECORD_LAYOUT Test_Map_u16u16u16 ALIGNMENT_BYTE 1 ALIGNMENT_FLOAT32_IEEE 4 ALIGNMENT_FLOAT64_IEEE 4 ALIGNMENT_LONG 4 ALIGNMENT_WORD 2 AXIS_PTS_X 3 UWORD INDEX_INCR DIRECT AXIS_PTS_Y 4 UWORD INDEX_INCR DIRECT FNC_VALUES 5 UWORD COLUMN_DIR DIRECT NO_AXIS_PTS_X 1 UWORD NO_AXIS_PTS_Y 2 UWORD /end RECORD_LAYOUT
/begin RECORD_LAYOUT Test_ValueBlock10_16bit ALIGNMENT_BYTE 1 ALIGNMENT_FLOAT32_IEEE 4 ALIGNMENT_FLOAT64_IEEE 4 ALIGNMENT_LONG 4 ALIGNMENT_WORD 2 FIX_NO_AXIS_PTS_X 10 FNC_VALUES 1 UWORD COLUMN_DIR DIRECT /end RECORD_LAYOUT
/begin RECORD_LAYOUT Test_ValueBlock12_16bit ALIGNMENT_FLOAT32_IEEE 4 ALIGNMENT_FLOAT64_IEEE 8 ALIGNMENT_LONG 4 ALIGNMENT_WORD 2 FIX_NO_AXIS_PTS_X 16 FNC_VALUES 1 UWORD COLUMN_DIR DIRECT /end RECORD_LAYOUT
/begin RECORD_LAYOUT Test_ValueBlock12_8bit ALIGNMENT_BYTE 1 ALIGNMENT_FLOAT32_IEEE 4 ALIGNMENT_FLOAT64_IEEE 4 ALIGNMENT_LONG 4 ALIGNMENT_WORD 2 FIX_NO_AXIS_PTS_X 12 FNC_VALUES 1 UBYTE COLUMN_DIR DIRECT /end RECORD_LAYOUT
/begin RECORD_LAYOUT Test_ValueBlock16_16bit ALIGNMENT_BYTE 1 ALIGNMENT_FLOAT32_IEEE 4 ALIGNMENT_FLOAT64_IEEE 4 ALIGNMENT_LONG 4 ALIGNMENT_WORD 2 FIX_NO_AXIS_PTS_X 16 FNC_VALUES 1 UWORD COLUMN_DIR DIRECT /end RECORD_LAYOUT
/begin RECORD_LAYOUT Test_ValueBlock16_8bit ALIGNMENT_BYTE 1 ALIGNMENT_FLOAT32_IEEE 4 ALIGNMENT_FLOAT64_IEEE 4 ALIGNMENT_LONG 4 ALIGNMENT_WORD 2 FIX_NO_AXIS_PTS_X 16 FNC_VALUES 1 UBYTE COLUMN_DIR DIRECT /end RECORD_LAYOUT
/begin RECORD_LAYOUT Test_ValueBlock2_16bit ALIGNMENT_BYTE 1 ALIGNMENT_FLOAT32_IEEE 4 ALIGNMENT_FLOAT64_IEEE 4 ALIGNMENT_LONG 4 ALIGNMENT_WORD 2 FIX_NO_AXIS_PTS_X 2 FNC_VALUES 1 UWORD COLUMN_DIR DIRECT /end RECORD_LAYOUT
/begin RECORD_LAYOUT __UBYTE_Z FNC_VALUES 1 UBYTE ROW_DIR DIRECT /end RECORD_LAYOUT
/begin RECORD_LAYOUT __UWORD_Z FNC_VALUES 1 UWORD ROW_DIR DIRECT /end RECORD_LAYOUT
/begin RECORD_LAYOUT __ULONG_Z FNC_VALUES 1 ULONG ROW_DIR DIRECT /end RECORD_LAYOUT
/begin RECORD_LAYOUT __SBYTE_Z FNC_VALUES 1 SBYTE ROW_DIR DIRECT /end RECORD_LAYOUT
/begin RECORD_LAYOUT __SWORD_Z FNC_VALUES 1 SWORD ROW_DIR DIRECT /end RECORD_LAYOUT
/begin RECORD_LAYOUT __SLONG_Z FNC_VALUES 1 SLONG ROW_DIR DIRECT /end RECORD_LAYOUT
/begin RECORD_LAYOUT __FLOAT32_IEEE_Z FNC_VALUES 1 FLOAT32_IEEE ROW_DIR DIRECT /end RECORD_LAYOUT
/begin RECORD_LAYOUT __FLOAT64_IEEE_Z FNC_VALUES 1 FLOAT32_IEEE ROW_DIR DIRECT /end RECORD_LAYOUT
/begin RECORD_LAYOUT __UBYTE_S FNC_VALUES 1 UBYTE COLUMN_DIR DIRECT /end RECORD_LAYOUT
/begin RECORD_LAYOUT __UWORD_S FNC_VALUES 1 UWORD COLUMN_DIR DIRECT /end RECORD_LAYOUT
/begin RECORD_LAYOUT __ULONG_S FNC_VALUES 1 ULONG COLUMN_DIR DIRECT /end RECORD_LAYOUT
/begin RECORD_LAYOUT __SBYTE_S FNC_VALUES 1 SBYTE COLUMN_DIR DIRECT /end RECORD_LAYOUT
/begin RECORD_LAYOUT __SWORD_S FNC_VALUES 1 SWORD COLUMN_DIR DIRECT /end RECORD_LAYOUT
/begin RECORD_LAYOUT __SLONG_S FNC_VALUES 1 SLONG COLUMN_DIR DIRECT /end RECORD_LAYOUT
/begin RECORD_LAYOUT __FLOAT32_IEEE_S FNC_VALUES 1 FLOAT32_IEEE COLUMN_DIR DIRECT /end RECORD_LAYOUT
/begin RECORD_LAYOUT __FLOAT64_IEEE_S FNC_VALUES 1 FLOAT32_IEEE COLUMN_DIR DIRECT /end RECORD_LAYOUT
/begin RECORD_LAYOUT SSV__UBYTE_S AXIS_PTS_X 1 UBYTE INDEX_INCR DIRECT /end RECORD_LAYOUT
/begin RECORD_LAYOUT SSV__UWORD_S AXIS_PTS_X 1 UWORD INDEX_INCR DIRECT /end RECORD_LAYOUT
/begin RECORD_LAYOUT SSV__ULONG_S AXIS_PTS_X 1 ULONG INDEX_INCR DIRECT /end RECORD_LAYOUT
/begin RECORD_LAYOUT SSV__SBYTE_S AXIS_PTS_X 1 SBYTE INDEX_INCR DIRECT /end RECORD_LAYOUT
/begin RECORD_LAYOUT SSV__SWORD_S AXIS_PTS_X 1 SWORD INDEX_INCR DIRECT /end RECORD_LAYOUT
/begin RECORD_LAYOUT SSV__SLONG_S AXIS_PTS_X 1 SLONG INDEX_INCR DIRECT /end RECORD_LAYOUT
/begin RECORD_LAYOUT SSV__FLOAT32_IEEE_S AXIS_PTS_X 1 FLOAT32_IEEE INDEX_INCR DIRECT /end RECORD_LAYOUT
/begin RECORD_LAYOUT SSV__FLOAT64_IEEE_S AXIS_PTS_X 1 FLOAT32_IEEE INDEX_INCR DIRECT /end RECORD_LAYOUT
/begin RECORD_LAYOUT ECTEK_AscII32 ALIGNMENT_BYTE 1 ALIGNMENT_FLOAT32_IEEE 1 ALIGNMENT_FLOAT64_IEEE 1 ALIGNMENT_LONG 1 ALIGNMENT_WORD 1 FIX_NO_AXIS_PTS_X 32 FNC_VALUES 1 UBYTE COLUMN_DIR DIRECT /end RECORD_LAYOUT
/begin RECORD_LAYOUT ECTEK_AscII16 ALIGNMENT_BYTE 1 ALIGNMENT_FLOAT32_IEEE 1 ALIGNMENT_FLOAT64_IEEE 1 ALIGNMENT_LONG 1 ALIGNMENT_WORD 1 FIX_NO_AXIS_PTS_X 16 FNC_VALUES 1 UBYTE COLUMN_DIR DIRECT /end RECORD_LAYOUT
/begin RECORD_LAYOUT ECTEK_ValueBlock24_u8 ALIGNMENT_BYTE 1 ALIGNMENT_FLOAT32_IEEE 1 ALIGNMENT_FLOAT64_IEEE 1 ALIGNMENT_LONG 1 ALIGNMENT_WORD 1 FIX_NO_AXIS_PTS_X 24 FNC_VALUES 1 UBYTE COLUMN_DIR DIRECT /end RECORD_LAYOUT
/begin RECORD_LAYOUT ECTEK_ValueBlock18_u8 ALIGNMENT_BYTE 1 ALIGNMENT_FLOAT32_IEEE 1 ALIGNMENT_FLOAT64_IEEE 1 ALIGNMENT_LONG 1 ALIGNMENT_WORD 1 FIX_NO_AXIS_PTS_X 18 FNC_VALUES 1 UBYTE COLUMN_DIR DIRECT /end RECORD_LAYOUT
/begin RECORD_LAYOUT ECTEK_ValueBlock18_u16 ALIGNMENT_BYTE 1 ALIGNMENT_FLOAT32_IEEE 1 ALIGNMENT_FLOAT64_IEEE 1 ALIGNMENT_LONG 1 ALIGNMENT_WORD 1 FIX_NO_AXIS_PTS_X 18 FNC_VALUES 1 UWORD COLUMN_DIR DIRECT /end RECORD_LAYOUT
/begin RECORD_LAYOUT ECTEK_Value_u16 ALIGNMENT_BYTE 1 ALIGNMENT_FLOAT32_IEEE 1 ALIGNMENT_FLOAT64_IEEE 1 ALIGNMENT_LONG 1 ALIGNMENT_WORD 1 FNC_VALUES 1 UWORD ROW_DIR DIRECT /end RECORD_LAYOUT
/begin RECORD_LAYOUT ECTEK_Value_u8 ALIGNMENT_BYTE 1 ALIGNMENT_FLOAT32_IEEE 1 ALIGNMENT_FLOAT64_IEEE 1 ALIGNMENT_LONG 1 ALIGNMENT_WORD 1 FNC_VALUES 1 UBYTE ROW_DIR DIRECT /end RECORD_LAYOUT
/begin RECORD_LAYOUT ECTEK_ValueBlock4_u8 ALIGNMENT_BYTE 1 ALIGNMENT_FLOAT32_IEEE 1 ALIGNMENT_FLOAT64_IEEE 1 ALIGNMENT_LONG 1 ALIGNMENT_WORD 1 FIX_NO_AXIS_PTS_X 4 FNC_VALUES 1 UBYTE COLUMN_DIR DIRECT /end RECORD_LAYOUT
/begin RECORD_LAYOUT ECTEK_ValueBlock2_u8 ALIGNMENT_BYTE 1 ALIGNMENT_FLOAT32_IEEE 1 ALIGNMENT_FLOAT64_IEEE 1 ALIGNMENT_LONG 1 ALIGNMENT_WORD 1 FIX_NO_AXIS_PTS_X 2 FNC_VALUES 1 UBYTE COLUMN_DIR DIRECT /end RECORD_LAYOUT
/begin RECORD_LAYOUT ECTEK_ValueBlock16_u8 ALIGNMENT_BYTE 1 ALIGNMENT_FLOAT32_IEEE 1 ALIGNMENT_FLOAT64_IEEE 1 ALIGNMENT_LONG 1 ALIGNMENT_WORD 1 FIX_NO_AXIS_PTS_X 16 FNC_VALUES 1 UBYTE COLUMN_DIR DIRECT /end RECORD_LAYOUT
/begin RECORD_LAYOUT ECTEK_Value_u32 ALIGNMENT_BYTE 1 ALIGNMENT_FLOAT32_IEEE 1 ALIGNMENT_FLOAT64_IEEE 1 ALIGNMENT_LONG 1 ALIGNMENT_WORD 1 FNC_VALUES 1 ULONG ROW_DIR DIRECT /end RECORD_LAYOUT
/begin RECORD_LAYOUT ECTEK_ValueBlock3_u16 ALIGNMENT_BYTE 1 ALIGNMENT_FLOAT32_IEEE 1 ALIGNMENT_FLOAT64_IEEE 1 ALIGNMENT_LONG 1 ALIGNMENT_WORD 1 FIX_NO_AXIS_PTS_X 3 FNC_VALUES 1 UWORD COLUMN_DIR DIRECT /end RECORD_LAYOUT
/begin RECORD_LAYOUT ECTEK_AscII10 ALIGNMENT_BYTE 1 ALIGNMENT_FLOAT32_IEEE 1 ALIGNMENT_FLOAT64_IEEE 1 ALIGNMENT_LONG 1 ALIGNMENT_WORD 1 FIX_NO_AXIS_PTS_X 10 FNC_VALUES 1 UBYTE COLUMN_DIR DIRECT /end RECORD_LAYOUT
/begin RECORD_LAYOUT ECTEK_ValueBlock4_u32 ALIGNMENT_BYTE 1 ALIGNMENT_FLOAT32_IEEE 1 ALIGNMENT_FLOAT64_IEEE 1 ALIGNMENT_LONG 1 ALIGNMENT_WORD 1 FIX_NO_AXIS_PTS_X 4 FNC_VALUES 1 ULONG COLUMN_DIR DIRECT /end RECORD_LAYOUT
/begin RECORD_LAYOUT ECTEK_ValueBlock4_u16 ALIGNMENT_BYTE 1 ALIGNMENT_FLOAT32_IEEE 1 ALIGNMENT_FLOAT64_IEEE 1 ALIGNMENT_LONG 1 ALIGNMENT_WORD 1 FIX_NO_AXIS_PTS_X 4 FNC_VALUES 1 UWORD COLUMN_DIR DIRECT /end RECORD_LAYOUT
/begin RECORD_LAYOUT ECTEK_ValueBlock8_u8 ALIGNMENT_BYTE 1 ALIGNMENT_FLOAT32_IEEE 1 ALIGNMENT_FLOAT64_IEEE 1 ALIGNMENT_LONG 1 ALIGNMENT_WORD 1 FIX_NO_AXIS_PTS_X 8 FNC_VALUES 1 UBYTE COLUMN_DIR DIRECT /end RECORD_LAYOUT
/begin RECORD_LAYOUT ECTEK_Curve_u16u16 ALIGNMENT_BYTE 1 ALIGNMENT_FLOAT32_IEEE 1 ALIGNMENT_FLOAT64_IEEE 1 ALIGNMENT_LONG 1 ALIGNMENT_WORD 1 AXIS_PTS_X 2 UWORD INDEX_INCR DIRECT FNC_VALUES 3 UWORD ROW_DIR DIRECT NO_AXIS_PTS_X 1 UWORD /end RECORD_LAYOUT
/begin RECORD_LAYOUT ECTEK_Map_u16u16u16 ALIGNMENT_BYTE 1 ALIGNMENT_FLOAT32_IEEE 1 ALIGNMENT_FLOAT64_IEEE 1 ALIGNMENT_LONG 1 ALIGNMENT_WORD 1 AXIS_PTS_X 3 UWORD INDEX_INCR DIRECT AXIS_PTS_Y 4 UWORD INDEX_INCR DIRECT FNC_VALUES 5 UWORD COLUMN_DIR DIRECT NO_AXIS_PTS_X 1 UWORD NO_AXIS_PTS_Y 2 UWORD /end RECORD_LAYOUT
/begin RECORD_LAYOUT ECTEK_ValueBlock7_u8 ALIGNMENT_BYTE 1 ALIGNMENT_FLOAT32_IEEE 1 ALIGNMENT_FLOAT64_IEEE 1 ALIGNMENT_LONG 1 ALIGNMENT_WORD 1 FIX_NO_AXIS_PTS_X 7 FNC_VALUES 1 UBYTE COLUMN_DIR DIRECT /end RECORD_LAYOUT
/begin RECORD_LAYOUT ECTEK_Value_s16 ALIGNMENT_BYTE 1 ALIGNMENT_FLOAT32_IEEE 1 ALIGNMENT_FLOAT64_IEEE 1 ALIGNMENT_LONG 1 ALIGNMENT_WORD 1 FNC_VALUES 1 SWORD ROW_DIR DIRECT /end RECORD_LAYOUT
/begin RECORD_LAYOUT ECTEK_Curve_s16u16 ALIGNMENT_BYTE 1 ALIGNMENT_FLOAT32_IEEE 1 ALIGNMENT_FLOAT64_IEEE 1 ALIGNMENT_LONG 1 ALIGNMENT_WORD 1 AXIS_PTS_X 2 UWORD INDEX_INCR DIRECT FNC_VALUES 3 SWORD ROW_DIR DIRECT NO_AXIS_PTS_X 1 UWORD /end RECORD_LAYOUT
/begin RECORD_LAYOUT ECTEK_Curve_s16s16 ALIGNMENT_BYTE 1 ALIGNMENT_FLOAT32_IEEE 1 ALIGNMENT_FLOAT64_IEEE 1 ALIGNMENT_LONG 1 ALIGNMENT_WORD 1 AXIS_PTS_X 2 SWORD INDEX_INCR DIRECT FNC_VALUES 3 SWORD ROW_DIR DIRECT NO_AXIS_PTS_X 1 UWORD /end RECORD_LAYOUT
/begin RECORD_LAYOUT ECTEK_Curve_u16s16 ALIGNMENT_BYTE 1 ALIGNMENT_FLOAT32_IEEE 1 ALIGNMENT_FLOAT64_IEEE 1 ALIGNMENT_LONG 1 ALIGNMENT_WORD 1 AXIS_PTS_X 2 SWORD INDEX_INCR DIRECT FNC_VALUES 3 UWORD ROW_DIR DIRECT NO_AXIS_PTS_X 1 UWORD /end RECORD_LAYOUT
/end MODULE
/end PROJECT
