ASAP2_VERSION 1 60
/begin PROJECT VCU
/*file name*/ "VC Serious VCU"
/begin HEADER "" VERSION "1.0" /end HEADER
/*-->MODULE Info*/
/begin MODULE VC-04
/*-->control unit hardware name*/ ""
/begin MOD_COMMON "" BYTE_ORDER MSB_FIRST ALIGNMENT_LONG 1 ALIGNMENT_WORD 1 ALIGNMENT_BYTE 1 /end MOD_COMMON
/begin IF_DATA ASAP1B_CCP /* Specific definition for CCP */ /*DAQ Define*/
 /begin SOURCE "10ms" /* -->Name */ 4 /* -->Select from P138 Scaling Unit: 4 = 10 ms */ 1 /* -->Rate in Scaling Unit: 1 */ /* Refresh rate = 1 * 10 ms = 10ms */
  /begin QP_BLOB 0 /* -->Number of DAQ-list */ LENGTH 0x14 /* -->Number of ODT's, which can be in- */ CAN_ID_FIXED 0x7D4 /* -->CAN-ID for measuring this DAQ */ RASTER 0 /* -->ECU event-number according to event- */ REDUCTION_ALLOWED FIRST_PID 0x0 /* -->First PID for this DAQ */ /end QP_BLOB
 /end SOURCE
 /begin SOURCE "100ms" 4 10 /* Rate in Scaling Unit: 10 */ /* Refresh rate = 10 * 10 ms = 100 */
  /begin QP_BLOB 1 LENGTH 0x14 CAN_ID_FIXED 0x7D4 RASTER 0x1 REDUCTION_ALLOWED FIRST_PID 0x14 /end QP_BLOB
 /end SOURCE
 /begin SOURCE "200ms" 4 20 /* Rate in Scaling Unit: 20 */ /* Refresh rate = 20 * 10 ms = 200 */
  /begin QP_BLOB 2 LENGTH 0x14 CAN_ID_FIXED 0x7D4 RASTER 0x2 REDUCTION_ALLOWED FIRST_PID 0x28 /end QP_BLOB
 /end SOURCE
 /begin SOURCE "event" 103 /* Scaling Unit: 103 = Cylinder segment */ 1 /* Rate in Scaling Unit: 1 */ /* Refresh rate = every cylinder combustion */ DISPLAY_IDENTIFIER DAQ3
  /begin QP_BLOB 3 LENGTH 0x14 CAN_ID_FIXED 0x7D4 RASTER 0x3 REDUCTION_ALLOWED FIRST_PID 0x3C /end QP_BLOB
 /end SOURCE
 /begin RASTER "10ms Trigger" /* -->Name of the ECU-event */ "10ms" /* -->Shortname */ 0 /* -->Number of ECU-event */ 4 /* -->Scaling Unit: 4 = 10 ms */ 1 /* -->Rate in Scaling Unit: 10 */ /* Refresh rate = 1 * 10 ms = 10ms */ /end RASTER
 /begin RASTER "100ms Trigger" "100ms" 1 4 10 /* Rate in Scaling Unit: 10 */ /* Refresh rate = 10 * 10ms = 100ms */ /end RASTER
 /begin RASTER "200ms Trigger" "200ms" 2 4 20 /* Rate in Scaling Unit: 20 */ /* Refresh rate = 20 * 10 ms = 200ms */ /end RASTER
 /begin RASTER "Cyl Event Trigger" "Cyl" 3 103 /* Scaling Unit: 103 = cylinder segment */ 1 /* Rate in Scaling Unit: 1 */ /* Refresh rate = */ /* every cylinder combustion */ /end RASTER
 /begin SEED_KEY "" "" "" /end SEED_KEY
 /begin TP_BLOB 0x0201 /* -->CCP version */ 0x0202 /* -->Blob version */ 0x7D0 /* -->CAN msg ID - send */ 0x7D4 /* -->CAN msg ID - recv */ 0x0 /* -->station address */ 1 /* -->byte order 1 = high Byte first, 2 = low byte first */ BAUDRATE 250000 SAMPLE_POINT 70 SAMPLE_RATE 1 BTL_CYCLES 16 SJW 1 SYNC_EDGE 0 DAQ_MODE 1 /*--> 1 = one DAQ per cycle */ CONSISTENCY 1 /*--> 1 = ODT consistant */ ADDRESS_EXTENSION 0 /* 0 = 1 extension per DAQ (not supported) */ RESUME_SUPPORTED /* necessary for ResumeBit support */ /* STORE_SUPPORTED */ /* Not supported */ /begin CHECKSUM_PARAM 0x8002 0xFFFF CHECKSUM_CALCULATION ACTIVE_PAGE /end CHECKSUM_PARAM
  /begin DEFINED_PAGES 1 "Working page" 0 0x0F0000 /*-->base address*/ 0xBFFE /*-->page length*/ RAM RAM_INIT_BY_ECU DEFAULT /end DEFINED_PAGES
  /begin DEFINED_PAGES 2 "Reference page" 0 0x780000 /*-->base address*/ 0xBFFE /*-->page length*/ FLASH DEFAULT /end DEFINED_PAGES
  OPTIONAL_CMD 0x9 /* GET_ACTIVE_CAL_PAGE */ OPTIONAL_CMD 0x0C /* SET_S_STATUS */ OPTIONAL_CMD 0x0D /* GET_S_STATUS */ OPTIONAL_CMD 0x0E /* Build Checksum */ OPTIONAL_CMD 0x11 /* SelectCal page */ OPTIONAL_CMD 0x19 /* Move */ /end TP_BLOB
/end IF_DATA
/begin MOD_PAR "" VERSION "" CUSTOMER_NO "" PHONE_NO "" CPU_TYPE "9s12xe" ECU "VC-04" /*/begin MEMORY_SEGMENT */ /* Resrv -->Name*/ /* RESERVED -->Select from CODE/DATA/RESERVED/VARIABLES*/ /* FLASH -->Select from EEPROM/EPROM/FLASH/RAM/ROM/REGISTER*/ /* INTERN -->Select from INTERN/EXTERN*/ /* 0x780000 -->Initial address*/ /* 0x4000 -->Size*/ /*/end MEMORY_SEGMENT*/
 /begin MEMORY_SEGMENT Code0 "B1S_512K" CODE FLASH INTERN 0x700000 0x80000 -1 -1 -1 -1 -1 /end MEMORY_SEGMENT
 /begin MEMORY_SEGMENT Code1 "B1S_80K" CODE FLASH INTERN 0x78C000 0x14000 -1 -1 -1 -1 -1 /end MEMORY_SEGMENT
 /begin MEMORY_SEGMENT Code2 "B1N_128K" CODE FLASH INTERN 0x7A0000 0x20000 -1 -1 -1 -1 -1 /end MEMORY_SEGMENT
 /begin MEMORY_SEGMENT Code3 "B0_256K" CODE FLASH INTERN 0x7C0000 0x40000 -1 -1 -1 -1 -1 /end MEMORY_SEGMENT
 /begin MEMORY_SEGMENT Resrv2 "Check_Sum" RESERVED FLASH INTERN 0x784000 0x2 -1 -1 -1 -1 -1 /end MEMORY_SEGMENT
 /begin MEMORY_SEGMENT Cal1 "" DATA FLASH INTERN 0x780000 0x4000 -1 -1 -1 -1 -1 /end MEMORY_SEGMENT
 /begin MEMORY_SEGMENT Cal2 "" DATA FLASH INTERN 0x784002 0x7FFE -1 -1 -1 -1 -1 /end MEMORY_SEGMENT
 /begin MEMORY_SEGMENT Ram1 "" VARIABLES RAM INTERN 0x0FD000 0x00800 -1 -1 -1 -1 -1 /end MEMORY_SEGMENT
 /begin MEMORY_SEGMENT Ram2 "" VARIABLES RAM INTERN 0x0FD880 0x02680 -1 -1 -1 -1 -1 /end MEMORY_SEGMENT
/end MOD_PAR
/end MODULE
/end PROJECT
