ASAP2_VERSION 1 60
/begin PROJECT VCU "VC Serious VCU"
/begin HEADER "" VERSION "1.0" /end HEADER
/begin MODULE VC-04 ""
/begin MOD_COMMON "" BYTE_ORDER MSB_FIRST ALIGNMENT_LONG 1 ALIGNMENT_WORD 1 ALIGNMENT_BYTE 1 /end MOD_COMMON
/begin COMPU_VTAB bCondition "" TAB_VERB 2 0 "否(No)" 1 "是(Yes)" DEFAULT_VALUE "0" /end COMPU_VTAB
/begin COMPU_VTAB idxAccPedType "油门类型" TAB_VERB 4 0 "不配备(Without)" 1 "双油门(Dual Analog)" 2 "带怠速开关(With Idle Switch)" 3 "单油门(Single Analog)" /end COMPU_VTAB
/begin COMPU_VTAB idxEdgeType "边沿捕捉" TAB_VERB 4 0 "不捕捉(None)" 1 "上升沿(Rising Edge)" 2 "下降沿(Falling Edge)" 3 "所有边沿(All)" DEFAULT_VALUE "0" /end COMPU_VTAB
/begin COMPU_VTAB idxManualResetType "" TAB_VERB 15 0 "非自动复位(Not Manual)" 1 "RAM测试(RAM Test Err)" 10 "PLL丢失同步(PLL Lost)" 11 "CRG时钟错误(CRG Err)" 12 "PIT时钟错误(PIT Err)" 20 "EEPROM ACCERR错误(EEPROM ACCERR)" 21 "EEPROM GSTAT错误(EEPROM GSTAT)" 22 "EEPROM Partition错误(EEPROM Parition Err)" 23 "Flash双位错误(Flash DoubleBit Err)" 30 "KWP2000复位(KWP2000 Reset)" 31 "Flash编程复位(FlashProgram Reset)" 40 "ATD队列错误(ATD Queue Err)" 50 "不可识别中断源(Unimplemented)" 60 "XGATE软件错误(XGATE Software Err)" 70 "MPU错误(MPU Err)" DEFAULT_VALUE "0" /end COMPU_VTAB
/begin COMPU_VTAB idxResetType "" TAB_VERB 7 1 "上电复位(PowerUp)" 2 "低电压(LowVoltage)" 3 "时钟(ClockMonitor)" 4 "看门狗(WatchDog)" 5 "非法地址(IllegalAddress)" 6 "系统复位(SystemReset)" 7 "不可识别(Unimplemented)" /end COMPU_VTAB
/begin COMPU_VTAB idxSwitchType "开关类型" TAB_VERB 4 0 "接电源常开(Power Open)" 1 "接电源常闭(Power Close)" 2 "接地常开(Ground Open)" 3 "接地常闭(Ground Close)" DEFAULT_VALUE "0" /end COMPU_VTAB
/begin COMPU_VTAB idxTriggerType "" TAB_VERB 10 0 "AlwaysTrue" 1 "NoTrigger" 2 "Time" 3 "WarmUpCycle" 4 "DrivingCycleFLC" 5 "DrivingCycleHLC" 6 "SimilarCondition" 7 "Project1" 8 "Project2" 9 "OneHour" DEFAULT_VALUE "1" /end COMPU_VTAB
/begin COMPU_VTAB idxVREGAcq "" TAB_VERB 3 0 "不采集(None)" 1 "采集CPU温度(CPU Temperature Acq)" 2 "采集1.2V参考电压(1.2V Acq)" /end COMPU_VTAB
/begin COMPU_VTAB stCrankshaft "" TAB_VERB 7 0 "Crk_Init" 4 "Crk_OneTooth" 5 "Crk_MatchTooth" 6 "Crk_WaitForSyn" 8 "Crk_Syn" 10 "Crk_Tooth" 11 "Crk_LastTooth" /end COMPU_VTAB
/begin COMPU_VTAB stDFC "" TAB_VERB 5 0 "诊断未开始(None)" 1 "部分错误(Preliminary Err)" 2 "完全错误(Err)" 3 "部分正常(Preliminary Heal)" 4 "完全正常(Heal)" /end COMPU_VTAB
/begin COMPU_VTAB stEGRRationSetPointRampState "EGR控制目标开度ramp状态" TAB_VERB 3 0 "PT1" 1 "PosRamp" 2 "NegRamp" /end COMPU_VTAB
/begin COMPU_VTAB stEngErrLim "" TAB_VERB 5 0 "没有限制(None)" 1 "90%功率限制(90% Limit)" 2 "85%功率限制(85% Limit)" 4 "80%功率限制(80% Limit)" 8 "70%功率限制(70% Limit)" DEFAULT_VALUE "0" /end COMPU_VTAB
/begin COMPU_VTAB stEngFuelLim "" TAB_VERB 6 0 "无限制(None)" 1 "冒烟限制(Air System Limit)" 2 "发动机保护限制(Engine Protect Limit)" 4 "发动机故障限制(Engine Err Limit)" 8 "最大油量限制(Fuel System Max Limit)" 16 "最小油量限制(Fuel System Min Limit)" DEFAULT_VALUE "0" /end COMPU_VTAB
/begin COMPU_VTAB stEngPrtLim "" TAB_VERB 3 0 "没有限制(None)" 1 "发动机过热保护(OverHeat Protect)" 2 "发动机机械保护(Mechanic Protect)" DEFAULT_VALUE "0" /end COMPU_VTAB
/begin COMPU_VTAB stEngine "" TAB_VERB 7 0 "初始化(Eng_Init)" 1 "停机(Eng_StandBy)" 2 "等待起动(Eng_Ready)" 3 "起动(Eng_Cranking)" 4 "正常运转(Eng_Running)" 5 "Eng_Stopping" 6 "Eng_Finish" /end COMPU_VTAB
/begin COMPU_VTAB stEpm "" TAB_VERB 4 0 "没有同步(Epm_NoSyn)" 2 "凸轮轴同步(Epm_CamSyn)" 8 "曲轴同步(Epm_CrkSyn)" 32 "完全同步(Epm_FullSyn)" /end COMPU_VTAB
/begin COMPU_VTAB stHIGovIFreeze "高怠速I冻结转速状态" TAB_VERB 2 0 "转速低于起始转速" 1 "转速大于或等于起始转速" /end COMPU_VTAB
/begin COMPU_VTAB stInjection "" TAB_VERB 6 0 "Inj_Wait" 1 "Inj_Verify" 2 "Inj_OK" 4 "Inj_BackCrk" 8 "Inj_BackCam" 16 "Inj_Err" /end COMPU_VTAB
/begin COMPU_VTAB stLIGovPreDef "低怠速前馈油量锁状态" TAB_VERB 2 0 "锁(Lock)" 1 "解锁(Unlock)" /end COMPU_VTAB
/begin COMPU_VTAB stLowIdleSetPoint "" TAB_VERB 5 1 "蓄电池电压低怠速(Battery Voltage Low)" 2 "空调怠速(Air Condition)" 4 "油门踏板故障怠速(Accped Defect)" 8 "水温怠速(Coolant)" 16 "档位怠速(Gear)" DEFAULT_VALUE "8" /end COMPU_VTAB
/begin COMPU_VTAB stMechPrtLim "" TAB_VERB 6 0 "没有限制(None)" 1 "增压器保护(Turbine Protect)" 2 "最大车速限制(Vehicle Speed Protect)" 4 "最大发动机转速限制(Engine Speed Protect)" 8 "最大爆发压力限制(Boost Presure Protect)" 16 "OBD限制" DEFAULT_VALUE "0" /end COMPU_VTAB
/begin COMPU_VTAB stOvhtPrtLim "" TAB_VERB 4 0 "没有限制(None)" 1 "水温限制(Coolant Temperature Limit)" 2 "燃油温度限制(Fuel Temperature Limit)" 4 "机油温度限制(Oil Temperature Limit)" DEFAULT_VALUE "0" /end COMPU_VTAB
/begin COMPU_VTAB stPostDrive "" TAB_VERB 9 0 "禁止(Inactive)" 1 "等待(Wait)" 2 "诊断开始(DSMBegin)" 3 "EEPROM开始(EEPBegin)" 4 "等待2(Wait2)" 5 "DSM结束(DSM End)" 6 "EEPROM结束(EEP End)" 7 "最小时间(MinTime)" 8 "结束(Done)" /end COMPU_VTAB
/begin COMPU_VTAB stPreDrive "" TAB_VERB 2 0 "禁止(Inactive)" 1 "结束(Done)" /end COMPU_VTAB
/begin COMPU_VTAB stRamp "" TAB_VERB 2 0 "结束(End)" 1 "正在进行(Begin)" /end COMPU_VTAB
/begin COMPU_VTAB stShutOff "" TAB_VERB 5 0 "禁止(Inactive)" 1 "DSM(DSM)" 2 "EEPROM(EEP)" 3 "主继电器关闭(MainRelay)" 4 " 结束(Done)" /end COMPU_VTAB
/begin COMPU_VTAB stStartSysCtl "起动控制状态" TAB_VERB 3 0 "初始化(Init)" 1 "起动进行中(Begin)" 2 "起动成功(End)" /end COMPU_VTAB
/begin COMPU_VTAB stSysConMon "" TAB_VERB 5 0 "初始化(Init)" 1 "关闭(Off)" 2 "起动(Boot)" 3 "执行(Exec)" 4 "关闭(Shutdown)" /end COMPU_VTAB
/begin COMPU_VTAB stSysConSub "" TAB_VERB 6 0 "初始化(Init)" 1 "硬件初始化(HardwareInit)" 2 "管理系统初始化(ManageInit)" 3 "PreDrive(PreDrive)" 4 "Drive(Drive)" 5 "PostDrive(PostDrive)" /end COMPU_VTAB
/begin COMPU_VTAB stTestInj "" TAB_VERB 5 0 "TestInj_Void" 1 "TestInj_Inj" 2 "TestInj_Calc" 3 "TestInj_Syn" 4 "TestInj_NoSyn" /end COMPU_VTAB
/begin COMPU_VTAB swtComponentInput "输入是否使用，信号来源" TAB_VERB 2 0 "不使用(Inactive)" 1 "使用(Active)" /end COMPU_VTAB
/begin COMPU_VTAB swtComponentOutput "输出设备是否使用" TAB_VERB 2 0 "不使用(Inactive)" 1 "使用(Active)" /end COMPU_VTAB
/begin COMPU_METHOD NO_FORMULA "" RAT_FUNC "%2.0" "" COEFFS 0 1 0 0 0 1 /end COMPU_METHOD
/begin COMPU_METHOD aFactor32 "" RAT_FUNC "%3.2" "米/秒^2" COEFFS 0 32 -0 0 0 1 /end COMPU_METHOD
/begin COMPU_METHOD bCondition "" TAB_VERB "%3.0" "" COMPU_TAB_REF bCondition /end COMPU_METHOD
/begin COMPU_METHOD ctTimes "计数次数" RAT_FUNC "%3.1" "次" COEFFS 0 1 0 0 0 1 /end COMPU_METHOD
/begin COMPU_METHOD dnFactor1 "" RAT_FUNC "%3.1" "转/分" COEFFS 0 1 0 0 0 1 /end COMPU_METHOD
/begin COMPU_METHOD dpFactor32 "" RAT_FUNC "%3.2" "" COEFFS 0 32 -0 0 0 1 /end COMPU_METHOD
/begin COMPU_METHOD dqFactor128 "" RAT_FUNC "%3.2" "毫克" COEFFS 0 128 -0 0 0 1 /end COMPU_METHOD
/begin COMPU_METHOD drFactor256_AccPed "油门踏板变化率" RAT_FUNC "%3.1" "%/秒" COEFFS 0 256 -0 0 0 1 /end COMPU_METHOD
/begin COMPU_METHOD dtFactor256 "" RAT_FUNC "%3.2" "度" COEFFS 0 256 -0 0 0 1 /end COMPU_METHOD
/begin COMPU_METHOD fFactor1 "9825,9362控制频率" RAT_FUNC "%3.0" "Hz" COEFFS 0 1 0 0 0 1 /end COMPU_METHOD
/begin COMPU_METHOD facFactor100_Correction "修正系数" RAT_FUNC "%3.3" "%" COEFFS 0 100 -0 0 0 1 /end COMPU_METHOD
/begin COMPU_METHOD facFactor100_PID "PID参数" RAT_FUNC "%3.3" "" COEFFS 0 100 -0 0 0 1 /end COMPU_METHOD
/begin COMPU_METHOD idxAccPedType "油门类型" TAB_VERB "%3.1" "" COMPU_TAB_REF idxAccPedType /end COMPU_METHOD
/begin COMPU_METHOD idxEdgeType "边沿捕捉" TAB_VERB "%3.1" "" COMPU_TAB_REF idxEdgeType /end COMPU_METHOD
/begin COMPU_METHOD idxManualResetType "" TAB_VERB "%3.2" "" COMPU_TAB_REF idxManualResetType /end COMPU_METHOD
/begin COMPU_METHOD idxResetType "" TAB_VERB "%3.2" "" COMPU_TAB_REF idxResetType /end COMPU_METHOD
/begin COMPU_METHOD idxSwitchType "开关类型" TAB_VERB "%3.1" "" COMPU_TAB_REF idxSwitchType /end COMPU_METHOD
/begin COMPU_METHOD idxTriggerType "" TAB_VERB "%3.1" "" COMPU_TAB_REF idxTriggerType /end COMPU_METHOD
/begin COMPU_METHOD idxVREGAcq "" TAB_VERB "%3.1" "" COMPU_TAB_REF idxVREGAcq /end COMPU_METHOD
/begin COMPU_METHOD numFactor256 "" RAT_FUNC "%3.2" "脉冲" COEFFS 0 256 -0 0 0 1 /end COMPU_METHOD
/begin COMPU_METHOD pFactor32_kPa "" RAT_FUNC "%3.2" "千帕" COEFFS 0 32 -0 0 0 1 /end COMPU_METHOD
/begin COMPU_METHOD phiFactor32 "" RAT_FUNC "%3.2" "度" COEFFS 0 32 -0 0 0 1 /end COMPU_METHOD
/begin COMPU_METHOD qFactor128 "" RAT_FUNC "%3.2" "毫克" COEFFS 0 128 -0 0 0 1 /end COMPU_METHOD
/begin COMPU_METHOD rFactor100_PWM "9825,9362控制占空比" RAT_FUNC "%3.2" "%" COEFFS 0 100 -0 0 0 1 /end COMPU_METHOD
/begin COMPU_METHOD rFactor100_control "阀控制开度" RAT_FUNC "%3.2" "%" COEFFS 0 100 -0 0 0 1 /end COMPU_METHOD
/begin COMPU_METHOD rFactor10_VSSPlaus "车速合理性计算" RAT_FUNC "%3.1" "" COEFFS 0 10 -0 0 0 1 /end COMPU_METHOD
/begin COMPU_METHOD rFactor256_AccPed "" RAT_FUNC "%3.1" "%" COEFFS 0 256 -0 0 0 1 /end COMPU_METHOD
/begin COMPU_METHOD rFactor256_Plaus "" RAT_FUNC "%3.2" "" COEFFS 0 256 -0 0 0 1 /end COMPU_METHOD
/begin COMPU_METHOD rFactor32_GearConv "" RAT_FUNC "%3.2" "" COEFFS 0 32 -0 0 0 1 /end COMPU_METHOD
/begin COMPU_METHOD stPostDrive "" TAB_VERB "%3.1" "" COMPU_TAB_REF stPostDrive /end COMPU_METHOD
/begin COMPU_METHOD stPreDrive "" TAB_VERB "%3.1" "" COMPU_TAB_REF stPreDrive /end COMPU_METHOD
/begin COMPU_METHOD stRamp "" TAB_VERB "%3.1" "" COMPU_TAB_REF stRamp /end COMPU_METHOD
/begin COMPU_METHOD stShutOff "" TAB_VERB "%3.1" "" COMPU_TAB_REF stShutOff /end COMPU_METHOD
/begin COMPU_METHOD stSysConMon "" TAB_VERB "%3.1" "" COMPU_TAB_REF stSysConMon /end COMPU_METHOD
/begin COMPU_METHOD stSysConSub "" TAB_VERB "%3.1" "" COMPU_TAB_REF stSysConSub /end COMPU_METHOD
/begin COMPU_METHOD swtComponentInput "输入是否使用，信号来源" TAB_VERB "%3.1" "" COMPU_TAB_REF swtComponentInput /end COMPU_METHOD
/begin COMPU_METHOD swtComponentOutput "输出设备是否使用" TAB_VERB "%3.1" "" COMPU_TAB_REF swtComponentOutput /end COMPU_METHOD
/begin COMPU_METHOD tiFactor1000_1ms "" RAT_FUNC "%3.3" "秒" COEFFS 0 1000 -0 0 0 1 /end COMPU_METHOD
/begin COMPU_METHOD tiFactor100_10ms "" RAT_FUNC "%3.2" "秒" COEFFS 0 100 -0 0 0 1 /end COMPU_METHOD
/begin COMPU_METHOD tiFactor25_25MHz "ECT时钟" RAT_FUNC "%3.3" "" COEFFS 0 25 -0 0 0 1 /end COMPU_METHOD
/begin COMPU_METHOD volFactor16 "" RAT_FUNC "%3.2" "毫克/缸" COEFFS 0 16 -0 0 0 1 /end COMPU_METHOD
/begin COMPU_METHOD fFactor256 "" RAT_FUNC "%.2" "Hz" COEFFS 0 1 -1 0 0 0.003906 /end COMPU_METHOD
/begin COMPU_METHOD u5V "AD采样电压" RAT_FUNC "%.3" "伏" COEFFS 0 819 0 0 0 1 /end COMPU_METHOD
/begin COMPU_METHOD PWM_Hz100 "" RAT_FUNC "%.2" "Hz" COEFFS 0 100 0 0 0 1 /end COMPU_METHOD
/begin COMPU_METHOD rpm1-1 "转速1：1转换" RAT_FUNC "%.0" "rpm" COEFFS 0 1 0 0 0 1 /end COMPU_METHOD
/begin COMPU_METHOD Vmh10ms "车速变化率 每10ms车速变化量 米/小时/10ms " RAT_FUNC "%.0" "mh10ms" COEFFS 0 1 0 0 0 1 /end COMPU_METHOD
/begin COMPU_METHOD Temp "线性温度转换 1：1" RAT_FUNC "%.0" "℃" COEFFS 0 1 0 0 0 1 /end COMPU_METHOD
/begin RECORD_LAYOUT TEST_Cur_u16u16 ALIGNMENT_BYTE 1 ALIGNMENT_FLOAT32_IEEE 4 ALIGNMENT_FLOAT64_IEEE 4 ALIGNMENT_LONG 4 ALIGNMENT_WORD 2 AXIS_PTS_X 2 UWORD INDEX_INCR DIRECT FNC_VALUES 3 UWORD ROW_DIR DIRECT NO_AXIS_PTS_X 1 UWORD /end RECORD_LAYOUT
/begin RECORD_LAYOUT Test_Map_u16u16u16 ALIGNMENT_BYTE 1 ALIGNMENT_FLOAT32_IEEE 4 ALIGNMENT_FLOAT64_IEEE 4 ALIGNMENT_LONG 4 ALIGNMENT_WORD 2 AXIS_PTS_X 3 UWORD INDEX_INCR DIRECT AXIS_PTS_Y 4 UWORD INDEX_INCR DIRECT FNC_VALUES 5 UWORD COLUMN_DIR DIRECT NO_AXIS_PTS_X 1 UWORD NO_AXIS_PTS_Y 2 UWORD /end RECORD_LAYOUT
/begin RECORD_LAYOUT Test_ValueBlock10_16bit ALIGNMENT_BYTE 1 ALIGNMENT_FLOAT32_IEEE 4 ALIGNMENT_FLOAT64_IEEE 4 ALIGNMENT_LONG 4 ALIGNMENT_WORD 2 FIX_NO_AXIS_PTS_X 10 FNC_VALUES 1 UWORD COLUMN_DIR DIRECT /end RECORD_LAYOUT
/begin RECORD_LAYOUT Test_ValueBlock12_16bit ALIGNMENT_FLOAT32_IEEE 4 ALIGNMENT_FLOAT64_IEEE 8 ALIGNMENT_LONG 4 ALIGNMENT_WORD 2 FIX_NO_AXIS_PTS_X 16 FNC_VALUES 1 UWORD COLUMN_DIR DIRECT /end RECORD_LAYOUT
/begin RECORD_LAYOUT Test_ValueBlock12_8bit ALIGNMENT_BYTE 1 ALIGNMENT_FLOAT32_IEEE 4 ALIGNMENT_FLOAT64_IEEE 4 ALIGNMENT_LONG 4 ALIGNMENT_WORD 2 FIX_NO_AXIS_PTS_X 12 FNC_VALUES 1 UBYTE COLUMN_DIR DIRECT /end RECORD_LAYOUT
/begin RECORD_LAYOUT Test_ValueBlock16_16bit ALIGNMENT_BYTE 1 ALIGNMENT_FLOAT32_IEEE 4 ALIGNMENT_FLOAT64_IEEE 4 ALIGNMENT_LONG 4 ALIGNMENT_WORD 2 FIX_NO_AXIS_PTS_X 16 FNC_VALUES 1 UWORD COLUMN_DIR DIRECT /end RECORD_LAYOUT
/begin RECORD_LAYOUT Test_ValueBlock16_8bit ALIGNMENT_BYTE 1 ALIGNMENT_FLOAT32_IEEE 4 ALIGNMENT_FLOAT64_IEEE 4 ALIGNMENT_LONG 4 ALIGNMENT_WORD 2 FIX_NO_AXIS_PTS_X 16 FNC_VALUES 1 UBYTE COLUMN_DIR DIRECT /end RECORD_LAYOUT
/begin RECORD_LAYOUT Test_ValueBlock2_16bit ALIGNMENT_BYTE 1 ALIGNMENT_FLOAT32_IEEE 4 ALIGNMENT_FLOAT64_IEEE 4 ALIGNMENT_LONG 4 ALIGNMENT_WORD 2 FIX_NO_AXIS_PTS_X 2 FNC_VALUES 1 UWORD COLUMN_DIR DIRECT /end RECORD_LAYOUT
/begin RECORD_LAYOUT __UBYTE_Z FNC_VALUES 1 UBYTE ROW_DIR DIRECT /end RECORD_LAYOUT
/begin RECORD_LAYOUT __UWORD_Z FNC_VALUES 1 UWORD ROW_DIR DIRECT /end RECORD_LAYOUT
/begin RECORD_LAYOUT __ULONG_Z FNC_VALUES 1 ULONG ROW_DIR DIRECT /end RECORD_LAYOUT
/begin RECORD_LAYOUT __SBYTE_Z FNC_VALUES 1 SBYTE ROW_DIR DIRECT /end RECORD_LAYOUT
/begin RECORD_LAYOUT __SWORD_Z FNC_VALUES 1 SWORD ROW_DIR DIRECT /end RECORD_LAYOUT
/begin RECORD_LAYOUT __SLONG_Z FNC_VALUES 1 SLONG ROW_DIR DIRECT /end RECORD_LAYOUT
/begin RECORD_LAYOUT __FLOAT32_IEEE_Z FNC_VALUES 1 FLOAT32_IEEE ROW_DIR DIRECT /end RECORD_LAYOUT
/begin RECORD_LAYOUT __FLOAT64_IEEE_Z FNC_VALUES 1 FLOAT32_IEEE ROW_DIR DIRECT /end RECORD_LAYOUT
/begin RECORD_LAYOUT __UBYTE_S FNC_VALUES 1 UBYTE COLUMN_DIR DIRECT /end RECORD_LAYOUT
/begin RECORD_LAYOUT __UWORD_S FNC_VALUES 1 UWORD COLUMN_DIR DIRECT /end RECORD_LAYOUT
/begin RECORD_LAYOUT __ULONG_S FNC_VALUES 1 ULONG COLUMN_DIR DIRECT /end RECORD_LAYOUT
/begin RECORD_LAYOUT __SBYTE_S FNC_VALUES 1 SBYTE COLUMN_DIR DIRECT /end RECORD_LAYOUT
/begin RECORD_LAYOUT __SWORD_S FNC_VALUES 1 SWORD COLUMN_DIR DIRECT /end RECORD_LAYOUT
/begin RECORD_LAYOUT __SLONG_S FNC_VALUES 1 SLONG COLUMN_DIR DIRECT /end RECORD_LAYOUT
/begin RECORD_LAYOUT __FLOAT32_IEEE_S FNC_VALUES 1 FLOAT32_IEEE COLUMN_DIR DIRECT /end RECORD_LAYOUT
/begin RECORD_LAYOUT __FLOAT64_IEEE_S FNC_VALUES 1 FLOAT32_IEEE COLUMN_DIR DIRECT /end RECORD_LAYOUT
/begin RECORD_LAYOUT SSV__UBYTE_S AXIS_PTS_X 1 UBYTE INDEX_INCR DIRECT /end RECORD_LAYOUT
/begin RECORD_LAYOUT SSV__UWORD_S AXIS_PTS_X 1 UWORD INDEX_INCR DIRECT /end RECORD_LAYOUT
/begin RECORD_LAYOUT SSV__ULONG_S AXIS_PTS_X 1 ULONG INDEX_INCR DIRECT /end RECORD_LAYOUT
/begin RECORD_LAYOUT SSV__SBYTE_S AXIS_PTS_X 1 SBYTE INDEX_INCR DIRECT /end RECORD_LAYOUT
/begin RECORD_LAYOUT SSV__SWORD_S AXIS_PTS_X 1 SWORD INDEX_INCR DIRECT /end RECORD_LAYOUT
/begin RECORD_LAYOUT SSV__SLONG_S AXIS_PTS_X 1 SLONG INDEX_INCR DIRECT /end RECORD_LAYOUT
/begin RECORD_LAYOUT SSV__FLOAT32_IEEE_S AXIS_PTS_X 1 FLOAT32_IEEE INDEX_INCR DIRECT /end RECORD_LAYOUT
/begin RECORD_LAYOUT SSV__FLOAT64_IEEE_S AXIS_PTS_X 1 FLOAT32_IEEE INDEX_INCR DIRECT /end RECORD_LAYOUT
/begin CHARACTERISTIC Torque_Increment_D_Park_M02 "D档驻坡AD修正转矩给定每周期增量" CURVE 0x7847A4 ECTEK_Curve_s16s16 0 NO_FORMULA -100.0 100.0 FORMAT "%.2" BIT_MASK 0xFFFF
 /begin AXIS_DESCR STD_AXIS NO_INPUT_QUANTITY Vmh10ms 11 -1000.0 1000.0 DEPOSIT ABSOLUTE FORMAT "%.2" /end AXIS_DESCR
/end CHARACTERISTIC
/begin CHARACTERISTIC Motor_Speed_Torque_Break_M02 "电机最大制动力矩" CURVE 0x7847D2 ECTEK_Curve_s16s16 0 NO_FORMULA 0.0 1000.0 FORMAT "%.2" BIT_MASK 0xFFFF
 /begin AXIS_DESCR STD_AXIS NO_INPUT_QUANTITY rpm1-1 14 -15000.0 15000.0 DEPOSIT ABSOLUTE FORMAT "%.2" /end AXIS_DESCR
/end CHARACTERISTIC
/begin CHARACTERISTIC FeedBack_Coast_D_Torque_M02 "D档滑行回馈 速度-力矩  定点" CURVE 0x78480C ECTEK_Curve_s16s16 0 NO_FORMULA -1000.0 1000.0 FORMAT "%.2" BIT_MASK 0xFFFF
 /begin AXIS_DESCR STD_AXIS NO_INPUT_QUANTITY rpm1-1 8 -15000.0 15000.0 DEPOSIT ABSOLUTE FORMAT "%.2" /end AXIS_DESCR
/end CHARACTERISTIC
/begin CHARACTERISTIC FeedBack_Break_D_Torque_M02 "D档制动回馈 速度-力矩 定点" CURVE 0x78482E ECTEK_Curve_s16s16 0 NO_FORMULA -1000.0 1000.0 FORMAT "%.2" BIT_MASK 0xFFFF
 /begin AXIS_DESCR STD_AXIS NO_INPUT_QUANTITY rpm1-1 8 -15000.0 15000.0 DEPOSIT ABSOLUTE FORMAT "%.2" /end AXIS_DESCR
/end CHARACTERISTIC
/begin CHARACTERISTIC Speed_Efficieny_M02 "电机速度-转换效率曲线" CURVE 0x784850 ECTEK_Curve_u16u16 0 rFactor100_PWM 0.0 100.0 FORMAT "%.2" BIT_MASK 0xFFFF
 /begin AXIS_DESCR STD_AXIS NO_INPUT_QUANTITY rpm1-1 26 0.0 15000.0 DEPOSIT ABSOLUTE FORMAT "%.2" /end AXIS_DESCR
/end CHARACTERISTIC
/begin CHARACTERISTIC AutoPark_Motor_Speed_Torque_M02 "驻坡最大力矩" CURVE 0x7848BA ECTEK_Curve_u16s16 0 NO_FORMULA 0.0 5000.0 FORMAT "%.2" BIT_MASK 0xFFFF
 /begin AXIS_DESCR STD_AXIS NO_INPUT_QUANTITY rpm1-1 8 -15000.0 15000.0 DEPOSIT ABSOLUTE FORMAT "%.2" /end AXIS_DESCR
/end CHARACTERISTIC
/begin CHARACTERISTIC Motor_Vehicle_Speed_Scale_M021 "转速-车速比例， 优优114.411   D11 36.632" VALUE 0x7848DC ECTEK_Value_u8 0 NO_COMPU_METHOD 0.0 255.0 FORMAT "%.2" BIT_MASK 0xFF /end CHARACTERISTIC
/begin CHARACTERISTIC Demand_Limit_High_M021 "速度上限" VALUE 0x7848DD ECTEK_Value_u16 0 NO_COMPU_METHOD 0.0 4095.0 FORMAT "%.2" BIT_MASK 0xFFFF /end CHARACTERISTIC
/begin CHARACTERISTIC Demand_Limit_Low_M021 "速度下限" VALUE 0x7848DF ECTEK_Value_u16 0 NO_COMPU_METHOD 0.0 4095.0 FORMAT "%.2" BIT_MASK 0xFFFF /end CHARACTERISTIC
/begin CHARACTERISTIC Crawl_D_Speed_Max_M021 "D蠕动最大速度  从其他状态进入蠕动的速度" VALUE 0x7848E1 ECTEK_Value_u16 0 NO_COMPU_METHOD 0.0 1000.0 FORMAT "%.2" BIT_MASK 0xFFFF /end CHARACTERISTIC
/begin CHARACTERISTIC Crawl_D_Torque_Delay_Max_M021 "蠕动更新间隔  单位10ms" VALUE 0x7848E3 ECTEK_Value_u8 0 NO_COMPU_METHOD 1.0 255.0 FORMAT "%.2" BIT_MASK 0xFF /end CHARACTERISTIC
/begin CHARACTERISTIC Crawl_D_Torque_Delay_Start_Max_M021 "起步蠕动更新间隔  单位10ms" VALUE 0x7848E4 ECTEK_Value_u8 0 NO_FORMULA 0.0 255.0 FORMAT "%.2" BIT_MASK 0xFF /end CHARACTERISTIC
/begin CHARACTERISTIC Speed_Buffer_Number_M021 "10ms车辆速度采样缓冲次数" VALUE 0x7848E5 ECTEK_Value_u8 0 NO_COMPU_METHOD 1.0 69.0 FORMAT "%.2" BIT_MASK 0xFF /end CHARACTERISTIC
/begin CHARACTERISTIC Speed_Average_Number_M021 "10ms平均车速缓冲次数" VALUE 0x7848E6 ECTEK_Value_u8 0 NO_COMPU_METHOD 1.0 69.0 FORMAT "%.2" BIT_MASK 0xFF /end CHARACTERISTIC
/begin CHARACTERISTIC Torque_Buffer_Number_AutoPark_M021 "10ms车辆平均转矩采样缓冲次数 驻坡" VALUE 0x7848E7 ECTEK_Value_u8 0 NO_COMPU_METHOD 1.0 69.0 FORMAT "%.2" BIT_MASK 0xFF /end CHARACTERISTIC
/begin CHARACTERISTIC D_Park_Start_Speed_M021 "D驻坡触发转速" VALUE 0x7848E8 ECTEK_Value_u8 0 NO_COMPU_METHOD 0.0 255.0 FORMAT "%.2" BIT_MASK 0xFF /end CHARACTERISTIC
/begin CHARACTERISTIC Auto_Park_Speed_Acc_Max_M021 "激活D驻坡最大退行转速累加" VALUE 0x7848E9 ECTEK_Value_s16 0 NO_FORMULA -32768.0 32767.0 FORMAT "%.2" BIT_MASK 0xFFFF /end CHARACTERISTIC
/begin CHARACTERISTIC Auto_Park_Speed_Times_Max_M021 "激活D驻坡最大退行增速时间 单位10ms" VALUE 0x7848EB ECTEK_Value_u16 0 NO_FORMULA 0.0 65535.0 FORMAT "%.2" BIT_MASK 0xFFFF /end CHARACTERISTIC
/begin CHARACTERISTIC Auto_Torque_Min_M021 "自动转矩最小正值" VALUE 0x7848ED ECTEK_Value_s16 0 NO_COMPU_METHOD 0.0 300.0 FORMAT "%.2" BIT_MASK 0xFFFF /end CHARACTERISTIC
/begin CHARACTERISTIC Auto_Torque_Max_M021 "自动转矩最大负值" VALUE 0x7848EF ECTEK_Value_s16 0 NO_FORMULA -300.0 0.0 FORMAT "%.2" BIT_MASK 0xFFFF /end CHARACTERISTIC
/begin CHARACTERISTIC R_Vhms_Average_Ratio_M021 "R档Vhms平均值缓冲比例" VALUE 0x7848F1 ECTEK_Value_u16 0 NO_FORMULA 1.0 500.0 FORMAT "%.2" BIT_MASK 0xFFFF /end CHARACTERISTIC
/begin CHARACTERISTIC D_Vhms_Average_Ratio_M021 "D档Vhms平均值缓冲比例" VALUE 0x7848F3 ECTEK_Value_u16 0 NO_FORMULA 1.0 500.0 FORMAT "%.2" BIT_MASK 0xFFFF /end CHARACTERISTIC
/begin CHARACTERISTIC Motor_Speed_Torque_M021 "转速_最大转矩_大地和350-700Nm 70-100KW  比例36.632" CURVE 0x7848F5 ECTEK_Curve_u16s16 0 NO_FORMULA 0.0 5000.0 FORMAT "%.2" BIT_MASK 0xFFFF
 /begin AXIS_DESCR STD_AXIS NO_INPUT_QUANTITY rpm1-1 19 -15000.0 15000.0 DEPOSIT ABSOLUTE FORMAT "%.2" /end AXIS_DESCR
/end CHARACTERISTIC
/begin CHARACTERISTIC Speed_Vmh10ms_Crawl_D_M021 "D档蠕动 转速-AD曲线 rpm----mh10ms" CURVE 0x784943 ECTEK_Curve_s16s16 0 Vmh10ms -500.0 500.0 FORMAT "%.2" BIT_MASK 0xFFFF
 /begin AXIS_DESCR STD_AXIS NO_INPUT_QUANTITY rpm1-1 10 -15000.0 15000.0 DEPOSIT ABSOLUTE FORMAT "%.2" /end AXIS_DESCR
/end CHARACTERISTIC
/begin CHARACTERISTIC Torque_Increment_Crawl_D_M021 "D档蠕动 AD修正转矩给定每周期增量" CURVE 0x78496D ECTEK_Curve_s16s16 0 NO_FORMULA -100.0 100.0 FORMAT "%.2" BIT_MASK 0xFFFF
 /begin AXIS_DESCR STD_AXIS NO_INPUT_QUANTITY Vmh10ms 11 -1000.0 1000.0 DEPOSIT ABSOLUTE FORMAT "%.2" /end AXIS_DESCR
/end CHARACTERISTIC
/begin CHARACTERISTIC Speed_Max_Torque_Crawl_D_M021 "D档蠕行模式最大力矩" CURVE 0x78499B ECTEK_Curve_u16s16 0 NO_FORMULA 0.0 5000.0 FORMAT "%.2" BIT_MASK 0xFFFF
 /begin AXIS_DESCR STD_AXIS NO_INPUT_QUANTITY rpm1-1 9 -15000.0 15000.0 DEPOSIT ABSOLUTE FORMAT "%.2" /end AXIS_DESCR
/end CHARACTERISTIC
/begin CHARACTERISTIC Speed_Max_Torque_Crawl_D_Break_M021 "D档蠕行制动状态下最大驱动力矩" CURVE 0x7849C1 ECTEK_Curve_u16s16 0 NO_FORMULA 0.0 5000.0 FORMAT "%.2" BIT_MASK 0xFFFF
 /begin AXIS_DESCR STD_AXIS NO_INPUT_QUANTITY rpm1-1 9 -15000.0 15000.0 DEPOSIT ABSOLUTE FORMAT "%.2" /end AXIS_DESCR
/end CHARACTERISTIC
/begin CHARACTERISTIC Speed_Vmh10ms_General_M021 "通用相对转速-AD曲线 rpm----mh10ms" CURVE 0x7849E7 ECTEK_Curve_s16s16 0 Vmh10ms -1000.0 1000.0 FORMAT "%.2" BIT_MASK 0xFFFF
 /begin AXIS_DESCR STD_AXIS NO_INPUT_QUANTITY rpm1-1 11 -30000.0 30000.0 DEPOSIT ABSOLUTE FORMAT "%.2" /end AXIS_DESCR
/end CHARACTERISTIC
/begin CHARACTERISTIC Torque_Increment_General_M021 "通用AD修正转矩给定每周期增量" CURVE 0x784A15 ECTEK_Curve_s16s16 0 NO_FORMULA -100.0 100.0 FORMAT "%.2" BIT_MASK 0xFFFF
 /begin AXIS_DESCR STD_AXIS NO_INPUT_QUANTITY Vmh10ms 11 -1000.0 1000.0 DEPOSIT ABSOLUTE FORMAT "%.2" /end AXIS_DESCR
/end CHARACTERISTIC
/begin CHARACTERISTIC Speed_Vmh10ms_D_Park_M021 "D档驻坡 转速-AD曲线 rpm----mh10ms" CURVE 0x784A43 ECTEK_Curve_s16s16 0 Vmh10ms -1000.0 1000.0 FORMAT "%.2" BIT_MASK 0xFFFF
 /begin AXIS_DESCR STD_AXIS NO_INPUT_QUANTITY rpm1-1 12 -15000.0 15000.0 DEPOSIT ABSOLUTE FORMAT "%.2" /end AXIS_DESCR
/end CHARACTERISTIC
/begin CHARACTERISTIC Torque_Increment_D_Park_M021 "D档驻坡AD修正转矩给定每周期增量" CURVE 0x784A75 ECTEK_Curve_s16s16 0 NO_FORMULA -100.0 100.0 FORMAT "%.2" BIT_MASK 0xFFFF
 /begin AXIS_DESCR STD_AXIS NO_INPUT_QUANTITY Vmh10ms 11 -1000.0 1000.0 DEPOSIT ABSOLUTE FORMAT "%.2" /end AXIS_DESCR
/end CHARACTERISTIC
/begin CHARACTERISTIC Motor_Speed_Torque_Break_M021 "电机最大制动力矩" CURVE 0x784AA3 ECTEK_Curve_s16s16 0 NO_FORMULA 0.0 1000.0 FORMAT "%.2" BIT_MASK 0xFFFF
 /begin AXIS_DESCR STD_AXIS NO_INPUT_QUANTITY rpm1-1 14 -15000.0 15000.0 DEPOSIT ABSOLUTE FORMAT "%.2" /end AXIS_DESCR
/end CHARACTERISTIC
/begin CHARACTERISTIC FeedBack_Coast_D_Torque_M021 "D档滑行回馈 速度-力矩  定点" CURVE 0x784ADD ECTEK_Curve_s16s16 0 NO_FORMULA -1000.0 1000.0 FORMAT "%.2" BIT_MASK 0xFFFF
 /begin AXIS_DESCR STD_AXIS NO_INPUT_QUANTITY rpm1-1 8 -15000.0 15000.0 DEPOSIT ABSOLUTE FORMAT "%.2" /end AXIS_DESCR
/end CHARACTERISTIC
/begin CHARACTERISTIC FeedBack_Break_D_Torque_M021 "D档制动回馈 速度-力矩 定点" CURVE 0x784AFF ECTEK_Curve_s16s16 0 NO_FORMULA -1000.0 1000.0 FORMAT "%.2" BIT_MASK 0xFFFF
 /begin AXIS_DESCR STD_AXIS NO_INPUT_QUANTITY rpm1-1 8 -15000.0 15000.0 DEPOSIT ABSOLUTE FORMAT "%.2" /end AXIS_DESCR
/end CHARACTERISTIC
/begin CHARACTERISTIC Speed_Efficieny_M021 "电机速度-转换效率曲线" CURVE 0x784B21 ECTEK_Curve_u16u16 0 rFactor100_PWM 0.0 100.0 FORMAT "%.2" BIT_MASK 0xFFFF
 /begin AXIS_DESCR STD_AXIS NO_INPUT_QUANTITY rpm1-1 17 0.0 15000.0 DEPOSIT ABSOLUTE FORMAT "%.2" /end AXIS_DESCR
/end CHARACTERISTIC
/begin CHARACTERISTIC AutoPark_Motor_Speed_Torque_M021 "驻坡最大力矩" CURVE 0x784B67 ECTEK_Curve_u16s16 0 NO_FORMULA 0.0 5000.0 FORMAT "%.2" BIT_MASK 0xFFFF
 /begin AXIS_DESCR STD_AXIS NO_INPUT_QUANTITY rpm1-1 9 -15000.0 15000.0 DEPOSIT ABSOLUTE FORMAT "%.2" /end AXIS_DESCR
/end CHARACTERISTIC
/begin CHARACTERISTIC Motor_Vehicle_Speed_Scale_M03 "转速-车速比例， 优优114.411   D11 36.632   D07  62.111" VALUE 0x784B8D ECTEK_Value_u8 0 NO_FORMULA 0.0 255.0 FORMAT "%.2" BIT_MASK 0xFF /end CHARACTERISTIC
/begin CHARACTERISTIC Demand_Limit_High_M03 "转速上线  *4" VALUE 0x784B8E ECTEK_Value_u16 0 NO_FORMULA 0.0 4095.0 FORMAT "%.2" BIT_MASK 0xFFFF /end CHARACTERISTIC
/begin CHARACTERISTIC Demand_Limit_Low_M03 "速度下限" VALUE 0x784B90 ECTEK_Value_u16 0 NO_FORMULA 0.0 4095.0 FORMAT "%.2" BIT_MASK 0xFFFF /end CHARACTERISTIC
/begin CHARACTERISTIC Crawl_D_Speed_Max_M03 "D蠕动最大速度  从其他状态进入蠕动的速度" VALUE 0x784B92 ECTEK_Value_u16 0 rpm1-1 0.0 1000.0 FORMAT "%.2" BIT_MASK 0xFFFF /end CHARACTERISTIC
/begin CHARACTERISTIC Crawl_D_Torque_Delay_Max_M03 "蠕动更新间隔  单位10ms" VALUE 0x784B94 ECTEK_Value_u8 0 NO_FORMULA 0.0 255.0 FORMAT "%.2" BIT_MASK 0xFF /end CHARACTERISTIC
/begin CHARACTERISTIC Crawl_D_Torque_Delay_Start_Max_M03 "起步蠕动更新间隔  单位10ms" VALUE 0x784B95 ECTEK_Value_u8 0 NO_FORMULA 0.0 255.0 FORMAT "%.2" BIT_MASK 0xFF /end CHARACTERISTIC
/begin CHARACTERISTIC Speed_Buffer_Number_M03 "10ms车辆速度采样缓冲次数" VALUE 0x784B96 ECTEK_Value_u8 0 NO_FORMULA 0.0 69.0 FORMAT "%.2" BIT_MASK 0xFF /end CHARACTERISTIC
/begin CHARACTERISTIC Speed_Average_Number_M03 "10ms平均车速缓冲次数" VALUE 0x784B97 ECTEK_Value_u8 0 NO_FORMULA 0.0 69.0 FORMAT "%.2" BIT_MASK 0xFF /end CHARACTERISTIC
/begin CHARACTERISTIC Torque_Buffer_Number_AutoPark_M03 "10ms平均车速缓冲次数" VALUE 0x784B98 ECTEK_Value_u8 0 NO_FORMULA 0.0 69.0 FORMAT "%.2" BIT_MASK 0xFF /end CHARACTERISTIC
/begin CHARACTERISTIC D_Park_Start_Speed_M03 "D驻坡触发转速" VALUE 0x784B99 ECTEK_Value_u8 0 rpm1-1 0.0 255.0 FORMAT "%.2" BIT_MASK 0xFF /end CHARACTERISTIC
/begin CHARACTERISTIC Auto_Park_Speed_Acc_Max_M03 "激活D驻坡最大退行转速累加" VALUE 0x784B9A ECTEK_Value_s16 0 NO_FORMULA -32768.0 32767.0 FORMAT "%.2" BIT_MASK 0xFFFF /end CHARACTERISTIC
/begin CHARACTERISTIC Auto_Park_Speed_Times_Max_M03 "激活D驻坡最大退行增速时间 单位10ms" VALUE 0x784B9C ECTEK_Value_u16 0 NO_FORMULA 0.0 65535.0 FORMAT "%.2" BIT_MASK 0xFFFF /end CHARACTERISTIC
/begin CHARACTERISTIC EPS_Pwm "EPS脉冲信号手工频率" VALUE 0x784B9E ECTEK_Value_u32 0 PWM_Hz100 0.0 5000.0 BIT_MASK 0xFFFFFFFF /end CHARACTERISTIC
/begin CHARACTERISTIC EPS_Vehicle_Speed_Scale "EPS频率-车速比例  100倍" VALUE 0x784BA2 ECTEK_Value_u16 0 NO_COMPU_METHOD 0.0 65535.0 FORMAT "%.2" BIT_MASK 0xFFFF /end CHARACTERISTIC
/begin CHARACTERISTIC AC_Pressure_Max_Times "空调压力开关动作延迟 *50mS" VALUE 0x784BA4 ECTEK_Value_u16 0 NO_FORMULA 0.0 65535.0 FORMAT "%.2" BIT_MASK 0xFFFF /end CHARACTERISTIC
/begin CHARACTERISTIC AC_Condenser_Temp_Low "空调蒸发器温度最低值" VALUE 0x784BA6 ECTEK_Value_s8 0 NO_FORMULA -128.0 127.0 FORMAT "%.2" BIT_MASK 0xFF /end CHARACTERISTIC
/begin CHARACTERISTIC AC_Condenser_Reset_Temp "空调蒸发器复位温度" VALUE 0x784BA7 ECTEK_Value_s8 0 NO_COMPU_METHOD -4294967296.0 4294967296.0 FORMAT "%.2" BIT_MASK 0xFF /end CHARACTERISTIC
/begin CHARACTERISTIC FanStopDelay "空调风机停机延时 *50ms  默认15秒" VALUE 0x784BA8 ECTEK_Value_u16 0 NO_COMPU_METHOD -4294967296.0 4294967296.0 FORMAT "%.2" BIT_MASK 0xFFFF /end CHARACTERISTIC
/begin CHARACTERISTIC Auto_Torque_Min_M03 "自动转矩最小正值" VALUE 0x784BAA ECTEK_Value_s16 0 NO_FORMULA -300.0 300.0 FORMAT "%.2" BIT_MASK 0xFFFF /end CHARACTERISTIC
/begin CHARACTERISTIC Auto_Torque_Max_M03 "自动转矩最大负值" VALUE 0x784BAC ECTEK_Value_s16 0 NO_FORMULA -300.0 300.0 FORMAT "%.2" BIT_MASK 0xFFFF /end CHARACTERISTIC
/begin CHARACTERISTIC R_Vhms_Average_Ratio_M03 "R档Vhms平均值缓冲比例" VALUE 0x784BAE ECTEK_Value_u16 0 NO_FORMULA 1.0 500.0 FORMAT "%.2" BIT_MASK 0xFFFF /end CHARACTERISTIC
/begin CHARACTERISTIC D_Vhms_Average_Ratio_M03 "D档Vhms平均值缓冲比例" VALUE 0x784BB0 ECTEK_Value_u16 0 NO_FORMULA 1.0 500.0 FORMAT "%.2" BIT_MASK 0xFFFF /end CHARACTERISTIC
/begin CHARACTERISTIC Motor_Speed_Torque_M03 "转速_最大转矩 大地和 100KW 300N   62.111" CURVE 0x784BB2 ECTEK_Curve_u16s16 0 NO_FORMULA 0.0 5000.0 FORMAT "%.2" BIT_MASK 0xFFFF
 /begin AXIS_DESCR STD_AXIS NO_INPUT_QUANTITY rpm1-1 19 -15000.0 15000.0 DEPOSIT ABSOLUTE FORMAT "%.2" /end AXIS_DESCR
/end CHARACTERISTIC
/begin CHARACTERISTIC AccPed_Rip_M03 "油门曲线" CURVE 0x784C00 ECTEK_Curve_u16u16 0 rFactor100_PWM 0.0 100.0 FORMAT "%.2" BIT_MASK 0xFFFF
 /begin AXIS_DESCR STD_AXIS NO_INPUT_QUANTITY rFactor100_PWM 11 0.0 100.0 DEPOSIT ABSOLUTE FORMAT "%.2" /end AXIS_DESCR
/end CHARACTERISTIC
/begin CHARACTERISTIC Speed_Vmh10ms_Crawl_D_M03 "D档蠕动 转速-AD曲线 rpm----mh10ms" CURVE 0x784C2E ECTEK_Curve_s16s16 0 Vmh10ms -500.0 500.0 FORMAT "%.2" BIT_MASK 0xFFFF
 /begin AXIS_DESCR STD_AXIS NO_INPUT_QUANTITY rpm1-1 10 -15000.0 15000.0 DEPOSIT ABSOLUTE FORMAT "%.2" /end AXIS_DESCR
/end CHARACTERISTIC
/begin CHARACTERISTIC Torque_Increment_Crawl_D_M03 "D档蠕动 AD修正转矩给定每周期增量" CURVE 0x784C58 ECTEK_Curve_s16s16 0 NO_FORMULA -100.0 100.0 FORMAT "%.2" BIT_MASK 0xFFFF
 /begin AXIS_DESCR STD_AXIS NO_INPUT_QUANTITY NO_COMPU_METHOD 11 -1000.0 1000.0 DEPOSIT ABSOLUTE FORMAT "%.2" /end AXIS_DESCR
/end CHARACTERISTIC
/begin CHARACTERISTIC Speed_Max_Torque_Crawl_D_M03 "D档蠕行模式最大力矩" CURVE 0x784C86 ECTEK_Curve_u16s16 0 NO_FORMULA 0.0 5000.0 FORMAT "%.2" BIT_MASK 0xFFFF
 /begin AXIS_DESCR STD_AXIS NO_INPUT_QUANTITY rpm1-1 10 -15000.0 15000.0 DEPOSIT ABSOLUTE FORMAT "%.2" /end AXIS_DESCR
/end CHARACTERISTIC
/begin CHARACTERISTIC Speed_Max_Torque_Crawl_D_Break_M03 "D档蠕行制动状态下最大驱动力矩" CURVE 0x784CB0 ECTEK_Curve_u16s16 0 NO_COMPU_METHOD 0.0 5000.0 FORMAT "%.2" BIT_MASK 0xFFFF
 /begin AXIS_DESCR STD_AXIS NO_INPUT_QUANTITY NO_COMPU_METHOD 11 -15000.0 15000.0 DEPOSIT ABSOLUTE FORMAT "%.2" /end AXIS_DESCR
/end CHARACTERISTIC
/begin CHARACTERISTIC Speed_Vmh10ms_General_M03 "通用相对转速-AD曲线 rpm----mh10ms" CURVE 0x784CDE ECTEK_Curve_s16s16 0 Vmh10ms -1000.0 1000.0 FORMAT "%.2" BIT_MASK 0xFFFF
 /begin AXIS_DESCR STD_AXIS NO_INPUT_QUANTITY rpm1-1 11 -30000.0 30000.0 DEPOSIT ABSOLUTE FORMAT "%.2" /end AXIS_DESCR
/end CHARACTERISTIC
/begin CHARACTERISTIC Torque_Increment_General_M03 "通用AD修正转矩给定每周期增量" CURVE 0x784D0C ECTEK_Curve_s16s16 0 NO_FORMULA -100.0 100.0 FORMAT "%.2" BIT_MASK 0xFFFF
 /begin AXIS_DESCR STD_AXIS NO_INPUT_QUANTITY Vmh10ms 11 -1000.0 1000.0 DEPOSIT ABSOLUTE FORMAT "%.2" /end AXIS_DESCR
/end CHARACTERISTIC
/begin CHARACTERISTIC Speed_Vmh10ms_D_Park_M03 "D档驻坡 转速-AD曲线 rpm----mh10ms" CURVE 0x784D3A ECTEK_Curve_s16s16 0 Vmh10ms -1000.0 1000.0 FORMAT "%.2" BIT_MASK 0xFFFF
 /begin AXIS_DESCR STD_AXIS NO_INPUT_QUANTITY rpm1-1 12 -15000.0 15000.0 DEPOSIT ABSOLUTE FORMAT "%.2" /end AXIS_DESCR
/end CHARACTERISTIC
/begin CHARACTERISTIC Torque_Increment_D_Park_M03 "D档驻坡AD修正转矩给定每周期增量" CURVE 0x784D6C ECTEK_Curve_s16s16 0 NO_FORMULA -100.0 100.0 FORMAT "%.2" BIT_MASK 0xFFFF
 /begin AXIS_DESCR STD_AXIS NO_INPUT_QUANTITY Vmh10ms 11 -1000.0 1000.0 DEPOSIT ABSOLUTE FORMAT "%.2" /end AXIS_DESCR
/end CHARACTERISTIC
/begin CHARACTERISTIC Motor_Speed_Torque_Break_M03 "电机最大制动力矩" CURVE 0x784D9A ECTEK_Curve_s16s16 0 NO_FORMULA -0.0 5000.0 FORMAT "%.2" BIT_MASK 0xFFFF
 /begin AXIS_DESCR STD_AXIS NO_INPUT_QUANTITY rpm1-1 14 -15000.0 15000.0 DEPOSIT ABSOLUTE FORMAT "%.2" /end AXIS_DESCR
/end CHARACTERISTIC
/begin CHARACTERISTIC FeedBack_Coast_D_Torque_M03 "D档滑行回馈 速度-力矩  定点" CURVE 0x784DD4 ECTEK_Curve_s16s16 0 NO_FORMULA -1000.0 1000.0 FORMAT "%.2" BIT_MASK 0xFFFF
 /begin AXIS_DESCR STD_AXIS NO_INPUT_QUANTITY rpm1-1 8 -15000.0 15000.0 DEPOSIT ABSOLUTE FORMAT "%.2" /end AXIS_DESCR
/end CHARACTERISTIC
/begin CHARACTERISTIC FeedBack_Break_D_Torque_M03 "D档制动回馈 速度-力矩 定点" CURVE 0x784DF6 ECTEK_Curve_s16s16 0 NO_FORMULA -1000.0 1000.0 FORMAT "%.2" BIT_MASK 0xFFFF
 /begin AXIS_DESCR STD_AXIS NO_INPUT_QUANTITY rpm1-1 8 -15000.0 15000.0 DEPOSIT ABSOLUTE FORMAT "%.2" /end AXIS_DESCR
/end CHARACTERISTIC
/begin CHARACTERISTIC Speed_Efficieny_M03 "电机速度-转换效率曲线 驱动" CURVE 0x784E18 ECTEK_Curve_u16u16 0 rFactor100_PWM 0.0 100.0 FORMAT "%.2" BIT_MASK 0xFFFF
 /begin AXIS_DESCR STD_AXIS NO_INPUT_QUANTITY rpm1-1 14 0.0 15000.0 DEPOSIT ABSOLUTE FORMAT "%.2" /end AXIS_DESCR
/end CHARACTERISTIC
/begin CHARACTERISTIC Speed_Efficieny_FeedBack_M03 "电机速度-转换效率曲线 发电" CURVE 0x784E52 ECTEK_Curve_u16u16 0 rFactor100_PWM 0.0 100.0 FORMAT "%.2" BIT_MASK 0xFFFF
 /begin AXIS_DESCR STD_AXIS NO_INPUT_QUANTITY rpm1-1 14 0.0 15000.0 DEPOSIT ABSOLUTE FORMAT "%.2" /end AXIS_DESCR
/end CHARACTERISTIC
/begin CHARACTERISTIC AutoPark_Motor_Speed_Torque_M03 "驻坡最大力矩" CURVE 0x784E8C ECTEK_Curve_u16s16 0 NO_FORMULA 0.0 5000.0 FORMAT "%.2" BIT_MASK 0xFFFF
 /begin AXIS_DESCR STD_AXIS NO_INPUT_QUANTITY rpm1-1 8 -15000.0 15000.0 DEPOSIT ABSOLUTE FORMAT "%.2" /end AXIS_DESCR
/end CHARACTERISTIC
/begin CHARACTERISTIC AccPedCD_rUW_CUR_M03 "油门开度" CURVE 0x784EAE ECTEK_Curve_u16u16 0 rFactor100_PWM 0.0 100.0 FORMAT "%.2" BIT_MASK 0xFFFF
 /begin AXIS_DESCR STD_AXIS NO_INPUT_QUANTITY u5V 7 0.0 5.0 DEPOSIT ABSOLUTE FORMAT "%.2" /end AXIS_DESCR
/end CHARACTERISTIC
/begin CHARACTERISTIC AccPedCD_rUW_CUR2_M03 "油门2开度" CURVE 0x784ECC ECTEK_Curve_u16u16 0 rFactor100_PWM 0.0 100.0 FORMAT "%.2" BIT_MASK 0xFFFF
 /begin AXIS_DESCR STD_AXIS NO_INPUT_QUANTITY u5V 7 0.0 5.0 DEPOSIT ABSOLUTE FORMAT "%.2" /end AXIS_DESCR
/end CHARACTERISTIC
/begin CHARACTERISTIC EPS_Speed "D07 EPS频率与转速对应曲线 33~233.30Hz" CURVE 0x784EEA ECTEK_Curve_u16s16 0 PWM_Hz100 33.0 600.0 BIT_MASK 0xFFFF
 /begin AXIS_DESCR STD_AXIS NO_INPUT_QUANTITY rpm1-1 10 -15000.0 15000.0 DEPOSIT ABSOLUTE FORMAT "%.2" /end AXIS_DESCR
/end CHARACTERISTIC
/begin CHARACTERISTIC AC_Condenser_Temp_M03 "空调蒸发器温度" CURVE 0x784F14 ECTEK_Curve_s16u16 0 NO_FORMULA -100.0 150.0 FORMAT "%.2" BIT_MASK 0xFF
 /begin AXIS_DESCR STD_AXIS NO_INPUT_QUANTITY NO_FORMULA 35 0.0 4095.0 DEPOSIT ABSOLUTE FORMAT "%.2" /end AXIS_DESCR
/end CHARACTERISTIC
/begin CHARACTERISTIC AC_Condenser_Temp_M03_ACES "空调蒸发器温度_奥易克斯" CURVE 0x784FA2 ECTEK_Curve_s16u16 0 NO_FORMULA -100.0 150.0 FORMAT "%.2" BIT_MASK 0xFFFF
 /begin AXIS_DESCR STD_AXIS NO_INPUT_QUANTITY NO_FORMULA 36 0.0 4095.0 DEPOSIT ABSOLUTE FORMAT "%.2" /end AXIS_DESCR
/end CHARACTERISTIC
/begin CHARACTERISTIC APU_DebugMode "増程器手动调试模式开关" VALUE 0x785034 ECTEK_Value_u8 0 NO_FORMULA 0.0 1.0 FORMAT "%.2" BIT_MASK 0xFF /end CHARACTERISTIC
/begin CHARACTERISTIC APU_Debug_CMD "増程器工作命令 0 停 1 工作(启动) 2 发电 3 主动放电" VALUE 0x785035 ECTEK_Value_u8 0 NO_FORMULA 0.0 3.0 FORMAT "%.2" BIT_MASK 0xFF /end CHARACTERISTIC
/begin CHARACTERISTIC APU_Debug_Demand_Power "増程器目标发电功率 1310.7~0.1KW" VALUE 0x785036 ECTEK_Value_u16 0 rFactor10_VSSPlaus 0.0 1310.7 FORMAT "%.2" BIT_MASK 0xFFFF /end CHARACTERISTIC
/begin CHARACTERISTIC APU_Debug_Demand_Speed "増程器目标转速" VALUE 0x785038 ECTEK_Value_u16 0 rpm1-1 0.0 7650.0 FORMAT "%.2" BIT_MASK 0xFFFF /end CHARACTERISTIC
/begin CHARACTERISTIC Motor_Vehicle_Speed_Scale_M04 "转速-车速比例， 优优114.411   D11 36.632   D07  62.111  A9 95.064" VALUE 0x78503A ECTEK_Value_u8 0 NO_FORMULA 0.0 255.0 FORMAT "%.2" BIT_MASK 0xFF /end CHARACTERISTIC
/begin CHARACTERISTIC Demand_Limit_High_M04 "转速上线  *4" VALUE 0x78503B ECTEK_Value_u16 0 NO_FORMULA -0.0 4095.0 FORMAT "%.2" BIT_MASK 0xFFFF /end CHARACTERISTIC
/begin CHARACTERISTIC Demand_Limit_Low_M04 "速度下限" VALUE 0x78503D ECTEK_Value_u16 0 NO_FORMULA -0.0 4095.0 FORMAT "%.2" BIT_MASK 0xFFFF /end CHARACTERISTIC
/begin CHARACTERISTIC Crawl_D_Speed_Max_M04 "D蠕动最大速度  从其他状态进入蠕动的速度" VALUE 0x78503F ECTEK_Value_u16 0 rpm1-1 -0.0 1000.0 FORMAT "%.2" BIT_MASK 0xFFFF /end CHARACTERISTIC
/begin CHARACTERISTIC Crawl_D_Torque_Delay_Max_M04 "蠕动更新间隔  单位10ms" VALUE 0x785041 ECTEK_Value_u8 0 NO_FORMULA -0.0 255.0 FORMAT "%.2" BIT_MASK 0xFF /end CHARACTERISTIC
/begin CHARACTERISTIC Crawl_D_Torque_Delay_Start_Max_M04 "起步蠕动更新间隔  单位10ms" VALUE 0x785042 ECTEK_Value_u8 0 NO_COMPU_METHOD -4294967296.0 4294967296.0 FORMAT "%.2" BIT_MASK 0xFF /end CHARACTERISTIC
/begin CHARACTERISTIC Speed_Buffer_Number_M04 "10ms车辆速度采样缓冲次数" VALUE 0x785043 ECTEK_Value_u8 0 NO_FORMULA -0.0 69.0 FORMAT "%.2" BIT_MASK 0xFF /end CHARACTERISTIC
/begin CHARACTERISTIC Speed_Average_Number_M04 "10ms平均车速缓冲次数" VALUE 0x785044 ECTEK_Value_u8 0 NO_FORMULA -0.0 69.0 FORMAT "%.2" BIT_MASK 0xFF /end CHARACTERISTIC
/begin CHARACTERISTIC Torque_Buffer_Number_AutoPark_M04 "10ms平均转矩缓冲次数" VALUE 0x785045 ECTEK_Value_u8 0 NO_FORMULA -0.0 69.0 FORMAT "%.2" BIT_MASK 0xFF /end CHARACTERISTIC
/begin CHARACTERISTIC D_Park_Start_Speed_M04 "D驻坡触发转速" VALUE 0x785046 ECTEK_Value_u8 0 rpm1-1 -0.0 255.0 FORMAT "%.2" BIT_MASK 0xFF /end CHARACTERISTIC
/begin CHARACTERISTIC Auto_Park_Speed_Acc_Max_M04 "激活D驻坡最大退行转速累加" VALUE 0x785047 ECTEK_Value_s16 0 NO_FORMULA -32767.0 32768.0 FORMAT "%.2" BIT_MASK 0xFFFF /end CHARACTERISTIC
/begin CHARACTERISTIC Auto_Park_Speed_Times_Max_M04 "激活D驻坡最大退行增速时间 单位10ms" VALUE 0x785049 ECTEK_Value_u16 0 NO_FORMULA -0.0 65535.0 FORMAT "%.2" BIT_MASK 0xFFFF /end CHARACTERISTIC
/begin CHARACTERISTIC Auto_Torque_Min_M04 "自动转矩最小正值" VALUE 0x78504B ECTEK_Value_s16 0 NO_FORMULA 0.0 150.0 FORMAT "%.2" BIT_MASK 0xFFFF /end CHARACTERISTIC
/begin CHARACTERISTIC Auto_Torque_Max_M04 "自动转矩最大负值" VALUE 0x78504D ECTEK_Value_s16 0 NO_FORMULA -150.0 0.0 FORMAT "%.2" BIT_MASK 0xFFFF /end CHARACTERISTIC
/begin CHARACTERISTIC R_Vhms_Average_Ratio_M04 "R档Vhms平均值缓冲比例" VALUE 0x78504F ECTEK_Value_u16 0 NO_FORMULA 1.0 500.0 FORMAT "%.2" BIT_MASK 0xFFFF /end CHARACTERISTIC
/begin CHARACTERISTIC D_Vhms_Average_Ratio_M04 "D档Vhms平均值缓冲比例" VALUE 0x785051 ECTEK_Value_u16 0 NO_FORMULA 1.0 500.0 FORMAT "%.2" BIT_MASK 0xFFFF /end CHARACTERISTIC
/begin CHARACTERISTIC Motor_Speed_Torque_M04 "转速_最大转矩 大地和 30KW 150N   95" CURVE 0x785053 ECTEK_Curve_u16s16 0 NO_FORMULA -5000.0 5000.0 FORMAT "%.2" BIT_MASK 0xFFFF
 /begin AXIS_DESCR STD_AXIS NO_INPUT_QUANTITY rpm1-1 29 -15000.0 15000.0 DEPOSIT ABSOLUTE FORMAT "%.2" /end AXIS_DESCR
/end CHARACTERISTIC
/begin CHARACTERISTIC AccPed_Rip_M04 "油门曲线" CURVE 0x7850C9 ECTEK_Curve_u16u16 0 rFactor100_PWM -0.0 100.0 FORMAT "%.2" BIT_MASK 0xFFFF
 /begin AXIS_DESCR STD_AXIS NO_INPUT_QUANTITY rFactor100_PWM 11 -0.0 100.0 DEPOSIT ABSOLUTE FORMAT "%.2" /end AXIS_DESCR
/end CHARACTERISTIC
/begin CHARACTERISTIC Speed_Vmh10ms_Crawl_D_M04 "D档蠕动 转速-AD曲线 rpm----mh10ms" CURVE 0x7850F7 ECTEK_Curve_s16s16 0 Vmh10ms -500.0 500.0 FORMAT "%.2" BIT_MASK 0xFFFF
 /begin AXIS_DESCR STD_AXIS NO_INPUT_QUANTITY rpm1-1 10 -15000.0 15000.0 DEPOSIT ABSOLUTE FORMAT "%.2" /end AXIS_DESCR
/end CHARACTERISTIC
/begin CHARACTERISTIC Torque_Increment_Crawl_D_M04 "D档蠕动 AD修正转矩给定每周期增量" CURVE 0x785121 ECTEK_Curve_s16s16 0 NO_FORMULA -100.0 100.0 FORMAT "%.2" BIT_MASK 0xFFFF
 /begin AXIS_DESCR STD_AXIS NO_INPUT_QUANTITY Vmh10ms 11 -1000.0 1000.0 DEPOSIT ABSOLUTE FORMAT "%.2" /end AXIS_DESCR
/end CHARACTERISTIC
/begin CHARACTERISTIC Speed_Max_Torque_Crawl_D_M04 "D档蠕行模式最大力矩" CURVE 0x78514F ECTEK_Curve_u16s16 0 NO_FORMULA -5000.0 5000.0 FORMAT "%.2" BIT_MASK 0xFFFF
 /begin AXIS_DESCR STD_AXIS NO_INPUT_QUANTITY rpm1-1 9 -15000.0 15000.0 DEPOSIT ABSOLUTE FORMAT "%.2" /end AXIS_DESCR
/end CHARACTERISTIC
/begin CHARACTERISTIC Speed_Max_Torque_Crawl_D_Break_M04 "D档蠕行制动状态下最大驱动力矩" CURVE 0x785175 ECTEK_Curve_u16s16 0 NO_FORMULA -1000.0 1000.0 FORMAT "%.2" BIT_MASK 0xFFFF
 /begin AXIS_DESCR STD_AXIS NO_INPUT_QUANTITY rpm1-1 9 -15000.0 15000.0 DEPOSIT ABSOLUTE FORMAT "%.2" /end AXIS_DESCR
/end CHARACTERISTIC
/begin CHARACTERISTIC Speed_Vmh10ms_General_M04 "通用相对转速-AD曲线 rpm----mh10ms" CURVE 0x78519B ECTEK_Curve_s16s16 0 Vmh10ms -500.0 500.0 FORMAT "%.2" BIT_MASK 0xFFFF
 /begin AXIS_DESCR STD_AXIS NO_INPUT_QUANTITY rpm1-1 11 -30000.0 30000.0 DEPOSIT ABSOLUTE FORMAT "%.2" /end AXIS_DESCR
/end CHARACTERISTIC
/begin CHARACTERISTIC Torque_Increment_General_M04 "通用AD修正转矩给定每周期增量" CURVE 0x7851C9 ECTEK_Curve_s16s16 0 NO_FORMULA -100.0 100.0 FORMAT "%.2" BIT_MASK 0xFFFF
 /begin AXIS_DESCR STD_AXIS NO_INPUT_QUANTITY Vmh10ms 11 -1000.0 1000.0 DEPOSIT ABSOLUTE FORMAT "%.2" /end AXIS_DESCR
/end CHARACTERISTIC
/begin CHARACTERISTIC Speed_Vmh10ms_D_Park_M04 "D档驻坡 转速-AD曲线 rpm----mh10ms" CURVE 0x7851F7 ECTEK_Curve_s16s16 0 Vmh10ms -500.0 500.0 FORMAT "%.2" BIT_MASK 0xFFFF
 /begin AXIS_DESCR STD_AXIS NO_INPUT_QUANTITY rpm1-1 12 -15000.0 15000.0 DEPOSIT ABSOLUTE FORMAT "%.2" /end AXIS_DESCR
/end CHARACTERISTIC
/begin CHARACTERISTIC Torque_Increment_D_Park_M04 "D档驻坡AD修正转矩给定每周期增量" CURVE 0x785229 ECTEK_Curve_s16s16 0 NO_FORMULA -100.0 100.0 FORMAT "%.2" BIT_MASK 0xFFFF
 /begin AXIS_DESCR STD_AXIS NO_INPUT_QUANTITY Vmh10ms 11 -1000.0 1000.0 DEPOSIT ABSOLUTE FORMAT "%.2" /end AXIS_DESCR
/end CHARACTERISTIC
/begin CHARACTERISTIC Motor_Speed_Torque_Break_M04 "电机最大制动力矩" CURVE 0x785257 ECTEK_Curve_s16s16 0 NO_FORMULA -5000.0 5000.0 FORMAT "%.2" BIT_MASK 0xFFFF
 /begin AXIS_DESCR STD_AXIS NO_INPUT_QUANTITY rpm1-1 14 -15000.0 15000.0 DEPOSIT ABSOLUTE FORMAT "%.2" /end AXIS_DESCR
/end CHARACTERISTIC
/begin CHARACTERISTIC FeedBack_Coast_D_Torque_M04 "D档滑行回馈 速度-力矩  定点" CURVE 0x785291 ECTEK_Curve_s16s16 0 NO_FORMULA -5000.0 5000.0 FORMAT "%.2" BIT_MASK 0xFFFF
 /begin AXIS_DESCR STD_AXIS NO_INPUT_QUANTITY rpm1-1 8 -15000.0 15000.0 DEPOSIT ABSOLUTE FORMAT "%.2" /end AXIS_DESCR
/end CHARACTERISTIC
/begin CHARACTERISTIC FeedBack_Break_D_Torque_M04 "D档制动回馈 速度-力矩 定点" CURVE 0x7852B3 ECTEK_Curve_s16s16 0 NO_FORMULA -5000.0 5000.0 FORMAT "%.2" BIT_MASK 0xFFFF
 /begin AXIS_DESCR STD_AXIS NO_INPUT_QUANTITY rpm1-1 8 -15000.0 15000.0 DEPOSIT ABSOLUTE FORMAT "%.2" /end AXIS_DESCR
/end CHARACTERISTIC
/begin CHARACTERISTIC Speed_Efficieny_M04 "电机速度-转换效率曲线 驱动" CURVE 0x7852D5 ECTEK_Curve_u16u16 0 rFactor100_PWM 0.0 100.0 FORMAT "%.2" BIT_MASK 0xFFFF
 /begin AXIS_DESCR STD_AXIS NO_INPUT_QUANTITY rpm1-1 14 0.0 15000.0 DEPOSIT ABSOLUTE FORMAT "%.2" /end AXIS_DESCR
/end CHARACTERISTIC
/begin CHARACTERISTIC Speed_Efficieny_FeedBack_M04 "电机速度-转换效率曲线 发电" CURVE 0x78530F ECTEK_Curve_u16u16 0 rFactor100_PWM 0.0 150.0 FORMAT "%.2" BIT_MASK 0xFFFF
 /begin AXIS_DESCR STD_AXIS NO_INPUT_QUANTITY rpm1-1 14 0.0 15000.0 DEPOSIT ABSOLUTE FORMAT "%.2" /end AXIS_DESCR
/end CHARACTERISTIC
/begin CHARACTERISTIC AutoPark_Motor_Speed_Torque_M04 "驻坡最大力矩" CURVE 0x785349 ECTEK_Curve_u16s16 0 NO_FORMULA 0.0 5000.0 FORMAT "%.2" BIT_MASK 0xFFFF
 /begin AXIS_DESCR STD_AXIS NO_INPUT_QUANTITY rpm1-1 8 -15000.0 15000.0 DEPOSIT ABSOLUTE FORMAT "%.2" /end AXIS_DESCR
/end CHARACTERISTIC
/begin CHARACTERISTIC AccPedCD_rUW_CUR_M04 "油门开度" CURVE 0x78536B ECTEK_Curve_u16u16 0 rFactor100_PWM 0.0 100.0 FORMAT "%.2" BIT_MASK 0xFFFF
 /begin AXIS_DESCR STD_AXIS NO_INPUT_QUANTITY u5V 7 0.0 5.0 DEPOSIT ABSOLUTE FORMAT "%.2" /end AXIS_DESCR
/end CHARACTERISTIC
/begin CHARACTERISTIC AccPedCD_rUW_CUR2_M04 "油门2开度" CURVE 0x785389 ECTEK_Curve_u16u16 0 rFactor100_PWM 0.0 100.0 FORMAT "%.2" BIT_MASK 0xFFFF
 /begin AXIS_DESCR STD_AXIS NO_INPUT_QUANTITY u5V 7 0.0 5.0 DEPOSIT ABSOLUTE FORMAT "%.2" /end AXIS_DESCR
/end CHARACTERISTIC
/begin CHARACTERISTIC Motor_Vehicle_Speed_Scale_M041 "转速-车速比例， 优优114.411   D11 36.632   D07  62.111  A9 95.064" VALUE 0x7853A7 ECTEK_Value_u8 0 NO_FORMULA 0.0 255.0 FORMAT "%.2" BIT_MASK 0xFF /end CHARACTERISTIC
/begin CHARACTERISTIC Demand_Limit_High_M041 "转速上线  *4" VALUE 0x7853A8 ECTEK_Value_u16 0 NO_FORMULA -0.0 4095.0 FORMAT "%.2" BIT_MASK 0xFFFF /end CHARACTERISTIC
/begin CHARACTERISTIC Demand_Limit_Low_M041 "速度下限" VALUE 0x7853AA ECTEK_Value_u16 0 NO_FORMULA -0.0 4095.0 FORMAT "%.2" BIT_MASK 0xFFFF /end CHARACTERISTIC
/begin CHARACTERISTIC Crawl_D_Speed_Max_M041 "D蠕动最大速度  从其他状态进入蠕动的速度" VALUE 0x7853AC ECTEK_Value_u16 0 rpm1-1 -0.0 1000.0 FORMAT "%.2" BIT_MASK 0xFFFF /end CHARACTERISTIC
/begin CHARACTERISTIC Crawl_D_Torque_Delay_Max_M041 "蠕动更新间隔  单位10ms" VALUE 0x7853AE ECTEK_Value_u8 0 NO_FORMULA -0.0 255.0 FORMAT "%.2" BIT_MASK 0xFF /end CHARACTERISTIC
/begin CHARACTERISTIC Crawl_D_Torque_Delay_Start_Max_M041 "起步蠕动更新间隔  单位10ms" VALUE 0x7853AF ECTEK_Value_u8 0 NO_COMPU_METHOD -4294967296.0 4294967296.0 FORMAT "%.2" BIT_MASK 0xFF /end CHARACTERISTIC
/begin CHARACTERISTIC Speed_Buffer_Number_M041 "10ms车辆速度采样缓冲次数" VALUE 0x7853B0 ECTEK_Value_u8 0 NO_FORMULA -0.0 69.0 FORMAT "%.2" BIT_MASK 0xFF /end CHARACTERISTIC
/begin CHARACTERISTIC Speed_Average_Number_M041 "10ms平均车速缓冲次数" VALUE 0x7853B1 ECTEK_Value_u8 0 NO_FORMULA -0.0 69.0 FORMAT "%.2" BIT_MASK 0xFF /end CHARACTERISTIC
/begin CHARACTERISTIC Torque_Buffer_Number_AutoPark_M041 "10ms平均转矩缓冲次数" VALUE 0x7853B2 ECTEK_Value_u8 0 NO_FORMULA -0.0 69.0 FORMAT "%.2" BIT_MASK 0xFF /end CHARACTERISTIC
/begin CHARACTERISTIC D_Park_Start_Speed_M041 "D驻坡触发转速" VALUE 0x7853B3 ECTEK_Value_u8 0 rpm1-1 -0.0 255.0 FORMAT "%.2" BIT_MASK 0xFF /end CHARACTERISTIC
/begin CHARACTERISTIC Auto_Park_Speed_Acc_Max_M041 "激活D驻坡最大退行转速累加" VALUE 0x7853B4 ECTEK_Value_s16 0 NO_FORMULA -32767.0 32768.0 FORMAT "%.2" BIT_MASK 0xFFFF /end CHARACTERISTIC
/begin CHARACTERISTIC Auto_Park_Speed_Times_Max_M041 "激活D驻坡最大退行增速时间 单位10ms" VALUE 0x7853B6 ECTEK_Value_u16 0 NO_FORMULA -0.0 65535.0 FORMAT "%.2" BIT_MASK 0xFFFF /end CHARACTERISTIC
/begin CHARACTERISTIC Auto_Torque_Min_M041 "自动转矩最小正值" VALUE 0x7853B8 ECTEK_Value_s16 0 NO_FORMULA 0.0 150.0 FORMAT "%.2" BIT_MASK 0xFFFF /end CHARACTERISTIC
/begin CHARACTERISTIC Auto_Torque_Max_M041 "自动转矩最大负值" VALUE 0x7853BA ECTEK_Value_s16 0 NO_FORMULA -150.0 0.0 FORMAT "%.2" BIT_MASK 0xFFFF /end CHARACTERISTIC
/begin CHARACTERISTIC R_Vhms_Average_Ratio_M041 "R档Vhms平均值缓冲比例" VALUE 0x7853BC ECTEK_Value_u16 0 NO_FORMULA 1.0 500.0 FORMAT "%.2" BIT_MASK 0xFFFF /end CHARACTERISTIC
/begin CHARACTERISTIC D_Vhms_Average_Ratio_M041 "D档Vhms平均值缓冲比例" VALUE 0x7853BE ECTEK_Value_u16 0 NO_FORMULA 1.0 500.0 FORMAT "%.2" BIT_MASK 0xFFFF /end CHARACTERISTIC
/begin CHARACTERISTIC Motor_Speed_Torque_M041 "转速_最大转矩 大地和 30KW 150N   95" CURVE 0x7853C0 ECTEK_Curve_u16s16 0 NO_FORMULA -5000.0 5000.0 FORMAT "%.2" BIT_MASK 0xFFFF
 /begin AXIS_DESCR STD_AXIS NO_INPUT_QUANTITY rpm1-1 28 -15000.0 15000.0 DEPOSIT ABSOLUTE FORMAT "%.2" /end AXIS_DESCR
/end CHARACTERISTIC
/begin CHARACTERISTIC AccPed_Rip_M041 "油门曲线" CURVE 0x785432 ECTEK_Curve_u16u16 0 rFactor100_PWM -0.0 100.0 FORMAT "%.2" BIT_MASK 0xFFFF
 /begin AXIS_DESCR STD_AXIS NO_INPUT_QUANTITY rFactor100_PWM 11 -0.0 100.0 DEPOSIT ABSOLUTE FORMAT "%.2" /end AXIS_DESCR
/end CHARACTERISTIC
/begin CHARACTERISTIC Speed_Vmh10ms_Crawl_D_M041 "D档蠕动 转速-AD曲线 rpm----mh10ms" CURVE 0x785460 ECTEK_Curve_s16s16 0 Vmh10ms -500.0 500.0 FORMAT "%.2" BIT_MASK 0xFFFF
 /begin AXIS_DESCR STD_AXIS NO_INPUT_QUANTITY rpm1-1 10 -15000.0 15000.0 DEPOSIT ABSOLUTE FORMAT "%.2" /end AXIS_DESCR
/end CHARACTERISTIC
/begin CHARACTERISTIC Torque_Increment_Crawl_D_M041 "D档蠕动 AD修正转矩给定每周期增量" CURVE 0x78548A ECTEK_Curve_s16s16 0 NO_FORMULA -100.0 100.0 FORMAT "%.2" BIT_MASK 0xFFFF
 /begin AXIS_DESCR STD_AXIS NO_INPUT_QUANTITY Vmh10ms 11 -1000.0 1000.0 DEPOSIT ABSOLUTE FORMAT "%.2" /end AXIS_DESCR
/end CHARACTERISTIC
/begin CHARACTERISTIC Speed_Max_Torque_Crawl_D_M041 "D档蠕行模式最大力矩" CURVE 0x7854B8 ECTEK_Curve_u16s16 0 NO_FORMULA -5000.0 5000.0 FORMAT "%.2" BIT_MASK 0xFFFF
 /begin AXIS_DESCR STD_AXIS NO_INPUT_QUANTITY rpm1-1 9 -15000.0 15000.0 DEPOSIT ABSOLUTE FORMAT "%.2" /end AXIS_DESCR
/end CHARACTERISTIC
/begin CHARACTERISTIC Speed_Max_Torque_Crawl_D_Break_M041 "D档蠕行制动状态下最大驱动力矩" CURVE 0x7854DE ECTEK_Curve_u16s16 0 NO_FORMULA -1000.0 1000.0 FORMAT "%.2" BIT_MASK 0xFFFF
 /begin AXIS_DESCR STD_AXIS NO_INPUT_QUANTITY rpm1-1 9 -15000.0 15000.0 DEPOSIT ABSOLUTE FORMAT "%.2" /end AXIS_DESCR
/end CHARACTERISTIC
/begin CHARACTERISTIC Speed_Vmh10ms_General_M041 "通用相对转速-AD曲线 rpm----mh10ms" CURVE 0x785504 ECTEK_Curve_s16s16 0 Vmh10ms -500.0 500.0 FORMAT "%.2" BIT_MASK 0xFFFF
 /begin AXIS_DESCR STD_AXIS NO_INPUT_QUANTITY rpm1-1 11 -30000.0 30000.0 DEPOSIT ABSOLUTE FORMAT "%.2" /end AXIS_DESCR
/end CHARACTERISTIC
/begin CHARACTERISTIC Torque_Increment_General_M041 "通用AD修正转矩给定每周期增量" CURVE 0x785532 ECTEK_Curve_s16s16 0 NO_FORMULA -100.0 100.0 FORMAT "%.2" BIT_MASK 0xFFFF
 /begin AXIS_DESCR STD_AXIS NO_INPUT_QUANTITY Vmh10ms 11 -1000.0 1000.0 DEPOSIT ABSOLUTE FORMAT "%.2" /end AXIS_DESCR
/end CHARACTERISTIC
/begin CHARACTERISTIC Speed_Vmh10ms_D_Park_M041 "D档驻坡 转速-AD曲线 rpm----mh10ms" CURVE 0x785560 ECTEK_Curve_s16s16 0 Vmh10ms -500.0 500.0 FORMAT "%.2" BIT_MASK 0xFFFF
 /begin AXIS_DESCR STD_AXIS NO_INPUT_QUANTITY rpm1-1 12 -15000.0 15000.0 DEPOSIT ABSOLUTE FORMAT "%.2" /end AXIS_DESCR
/end CHARACTERISTIC
/begin CHARACTERISTIC Torque_Increment_D_Park_M041 "D档驻坡AD修正转矩给定每周期增量" CURVE 0x785592 ECTEK_Curve_s16s16 0 NO_FORMULA -100.0 100.0 FORMAT "%.2" BIT_MASK 0xFFFF
 /begin AXIS_DESCR STD_AXIS NO_INPUT_QUANTITY Vmh10ms 11 -1000.0 1000.0 DEPOSIT ABSOLUTE FORMAT "%.2" /end AXIS_DESCR
/end CHARACTERISTIC
/begin CHARACTERISTIC Motor_Speed_Torque_Break_M041 "电机最大制动力矩" CURVE 0x7855C0 ECTEK_Curve_s16s16 0 NO_FORMULA -5000.0 5000.0 FORMAT "%.2" BIT_MASK 0xFFFF
 /begin AXIS_DESCR STD_AXIS NO_INPUT_QUANTITY rpm1-1 14 -15000.0 15000.0 DEPOSIT ABSOLUTE FORMAT "%.2" /end AXIS_DESCR
/end CHARACTERISTIC
/begin CHARACTERISTIC FeedBack_Coast_D_Torque_M041 "D档滑行回馈 速度-力矩  定点" CURVE 0x7855FA ECTEK_Curve_s16s16 0 NO_FORMULA -5000.0 5000.0 FORMAT "%.2" BIT_MASK 0xFFFF
 /begin AXIS_DESCR STD_AXIS NO_INPUT_QUANTITY rpm1-1 8 -15000.0 15000.0 DEPOSIT ABSOLUTE FORMAT "%.2" /end AXIS_DESCR
/end CHARACTERISTIC
/begin CHARACTERISTIC FeedBack_Break_D_Torque_M041 "D档制动回馈 速度-力矩 定点" CURVE 0x78561C ECTEK_Curve_s16s16 0 NO_FORMULA -5000.0 5000.0 FORMAT "%.2" BIT_MASK 0xFFFF
 /begin AXIS_DESCR STD_AXIS NO_INPUT_QUANTITY rpm1-1 8 -15000.0 15000.0 DEPOSIT ABSOLUTE FORMAT "%.2" /end AXIS_DESCR
/end CHARACTERISTIC
/begin CHARACTERISTIC Speed_Efficieny_M041 "电机速度-转换效率曲线 驱动" CURVE 0x78563E ECTEK_Curve_u16u16 0 rFactor100_PWM 0.0 100.0 FORMAT "%.2" BIT_MASK 0xFFFF
 /begin AXIS_DESCR STD_AXIS NO_INPUT_QUANTITY rpm1-1 20 0.0 15000.0 DEPOSIT ABSOLUTE FORMAT "%.2" /end AXIS_DESCR
/end CHARACTERISTIC
/begin CHARACTERISTIC Speed_Efficieny_FeedBack_M041 "电机速度-转换效率曲线 发电" CURVE 0x785690 ECTEK_Curve_u16u16 0 rFactor100_PWM 0.0 150.0 FORMAT "%.2" BIT_MASK 0xFFFF
 /begin AXIS_DESCR STD_AXIS NO_INPUT_QUANTITY rpm1-1 20 0.0 15000.0 DEPOSIT ABSOLUTE FORMAT "%.2" /end AXIS_DESCR
/end CHARACTERISTIC
/begin CHARACTERISTIC AutoPark_Motor_Speed_Torque_M041 "驻坡最大力矩" CURVE 0x7856E2 ECTEK_Curve_u16s16 0 NO_FORMULA 0.0 5000.0 FORMAT "%.2" BIT_MASK 0xFFFF
 /begin AXIS_DESCR STD_AXIS NO_INPUT_QUANTITY rpm1-1 8 -15000.0 15000.0 DEPOSIT ABSOLUTE FORMAT "%.2" /end AXIS_DESCR
/end CHARACTERISTIC
/begin CHARACTERISTIC AccPedCD_rUW_CUR_M041 "油门开度" CURVE 0x785704 ECTEK_Curve_u16u16 0 rFactor100_PWM 0.0 100.0 FORMAT "%.2" BIT_MASK 0xFFFF
 /begin AXIS_DESCR STD_AXIS NO_INPUT_QUANTITY u5V 7 0.0 5.0 DEPOSIT ABSOLUTE FORMAT "%.2" /end AXIS_DESCR
/end CHARACTERISTIC
/begin CHARACTERISTIC AccPedCD_rUW_CUR2_M041 "油门2开度" CURVE 0x785722 ECTEK_Curve_u16u16 0 rFactor100_PWM 0.0 100.0 FORMAT "%.2" BIT_MASK 0xFFFF
 /begin AXIS_DESCR STD_AXIS NO_INPUT_QUANTITY u5V 7 0.0 5.0 DEPOSIT ABSOLUTE FORMAT "%.2" /end AXIS_DESCR
/end CHARACTERISTIC
/begin CHARACTERISTIC Motor_Vehicle_Speed_Scale_M06 "转速-车速比例， D09减速箱9.07  速比：75.89" VALUE 0x785740 ECTEK_Value_u8 0 NO_COMPU_METHOD 0.0 255.0 FORMAT "%.2" BIT_MASK 0xFF /end CHARACTERISTIC
/begin CHARACTERISTIC Demand_Limit_High_M06 "速度上限" VALUE 0x785741 ECTEK_Value_u16 0 NO_COMPU_METHOD 0.0 4095.0 FORMAT "%.2" BIT_MASK 0xFFFF /end CHARACTERISTIC
/begin CHARACTERISTIC Demand_Limit_Low_M06 "速度下限" VALUE 0x785743 ECTEK_Value_u16 0 NO_COMPU_METHOD 0.0 4095.0 FORMAT "%.2" BIT_MASK 0xFFFF /end CHARACTERISTIC
/begin CHARACTERISTIC Crawl_D_Speed_Max_M06 "D蠕动最大速度  从其他状态进入蠕动的速度" VALUE 0x785745 ECTEK_Value_u16 0 NO_COMPU_METHOD 0.0 1000.0 FORMAT "%.2" BIT_MASK 0xFFFF /end CHARACTERISTIC
/begin CHARACTERISTIC Crawl_D_Torque_Delay_Max_M06 "蠕动更新间隔  单位10ms" VALUE 0x785747 ECTEK_Value_u8 0 NO_COMPU_METHOD 1.0 255.0 FORMAT "%.2" BIT_MASK 0xFF /end CHARACTERISTIC
/begin CHARACTERISTIC Crawl_D_Torque_Delay_Start_Max_M06 "起步蠕动更新间隔  单位10ms" VALUE 0x785748 ECTEK_Value_u8 0 NO_FORMULA 0.0 255.0 FORMAT "%.2" BIT_MASK 0xFF /end CHARACTERISTIC
/begin CHARACTERISTIC Speed_Buffer_Number_M06 "10ms车辆速度采样缓冲次数" VALUE 0x785749 ECTEK_Value_u8 0 NO_COMPU_METHOD 1.0 69.0 FORMAT "%.2" BIT_MASK 0xFF /end CHARACTERISTIC
/begin CHARACTERISTIC Speed_Average_Number_M06 "10ms平均车速缓冲次数" VALUE 0x78574A ECTEK_Value_u8 0 NO_COMPU_METHOD 1.0 69.0 FORMAT "%.2" BIT_MASK 0xFF /end CHARACTERISTIC
/begin CHARACTERISTIC Torque_Buffer_Number_AutoPark_M06 "10ms车辆平均转矩采样缓冲次数 驻坡" VALUE 0x78574B ECTEK_Value_u8 0 NO_COMPU_METHOD 1.0 69.0 FORMAT "%.2" BIT_MASK 0xFF /end CHARACTERISTIC
/begin CHARACTERISTIC D_Park_Start_Speed_M06 "D驻坡触发转速" VALUE 0x78574C ECTEK_Value_u8 0 NO_COMPU_METHOD 0.0 255.0 FORMAT "%.2" BIT_MASK 0xFF /end CHARACTERISTIC
/begin CHARACTERISTIC Auto_Park_Speed_Acc_Max_M06 "激活D驻坡最大退行转速累加" VALUE 0x78574D ECTEK_Value_s16 0 NO_FORMULA -32768.0 32767.0 FORMAT "%.2" BIT_MASK 0xFFFF /end CHARACTERISTIC
/begin CHARACTERISTIC Auto_Park_Speed_Times_Max_M06 "" VALUE 0x78574F ECTEK_Value_u16 0 NO_FORMULA 0.0 65535.0 FORMAT "%.2" BIT_MASK 0xFFFF /end CHARACTERISTIC
/begin CHARACTERISTIC Auto_Torque_Min_M06 "自动转矩最小正值" VALUE 0x785751 ECTEK_Value_s16 0 NO_COMPU_METHOD 0.0 300.0 FORMAT "%.2" BIT_MASK 0xFFFF /end CHARACTERISTIC
/begin CHARACTERISTIC Auto_Torque_Max_M06 "自动转矩最大负值" VALUE 0x785753 ECTEK_Value_s16 0 NO_FORMULA -300.0 0.0 FORMAT "%.2" BIT_MASK 0xFFFF /end CHARACTERISTIC
/begin CHARACTERISTIC R_Vhms_Average_Ratio_M06 "R档Vhms平均值缓冲比例" VALUE 0x785755 ECTEK_Value_u16 0 NO_FORMULA 1.0 500.0 FORMAT "%.2" BIT_MASK 0xFFFF /end CHARACTERISTIC
/begin CHARACTERISTIC D_Vhms_Average_Ratio_M06 "D档Vhms平均值缓冲比例" VALUE 0x785757 ECTEK_Value_u16 0 NO_FORMULA 1.0 500.0 FORMAT "%.2" BIT_MASK 0xFFFF /end CHARACTERISTIC
/begin CHARACTERISTIC Motor_Speed_Torque_M06 "转速_最大转矩_旭利、230(500)Nm、50(90)KW、2100(6000)rpm 、比例44.83" CURVE 0x785759 ECTEK_Curve_u16s16 0 NO_FORMULA 0.0 5000.0 FORMAT "%.2" BIT_MASK 0xFFFF
 /begin AXIS_DESCR STD_AXIS NO_INPUT_QUANTITY rpm1-1 27 -15000.0 15000.0 DEPOSIT ABSOLUTE FORMAT "%.2" /end AXIS_DESCR
/end CHARACTERISTIC
/begin CHARACTERISTIC Speed_Vmh10ms_Crawl_D_M06 "D档蠕动 转速-AD曲线 rpm----mh10ms" CURVE 0x7857C7 ECTEK_Curve_s16s16 0 Vmh10ms -500.0 500.0 FORMAT "%.2" BIT_MASK 0xFFFF
 /begin AXIS_DESCR STD_AXIS NO_INPUT_QUANTITY rpm1-1 10 -15000.0 15000.0 DEPOSIT ABSOLUTE FORMAT "%.2" /end AXIS_DESCR
/end CHARACTERISTIC
/begin CHARACTERISTIC Torque_Increment_Crawl_D_M06 "D档蠕动 AD修正转矩给定每周期增量" CURVE 0x7857F1 ECTEK_Curve_s16s16 0 NO_FORMULA -100.0 100.0 FORMAT "%.2" BIT_MASK 0xFFFF
 /begin AXIS_DESCR STD_AXIS NO_INPUT_QUANTITY Vmh10ms 11 -1000.0 1000.0 DEPOSIT ABSOLUTE FORMAT "%.2" /end AXIS_DESCR
/end CHARACTERISTIC
/begin CHARACTERISTIC Speed_Max_Torque_Crawl_D_M06 "D档蠕行模式最大力矩" CURVE 0x78581F ECTEK_Curve_u16s16 0 NO_FORMULA 0.0 5000.0 FORMAT "%.2" BIT_MASK 0xFFFF
 /begin AXIS_DESCR STD_AXIS NO_INPUT_QUANTITY rpm1-1 9 -15000.0 15000.0 DEPOSIT ABSOLUTE FORMAT "%.2" /end AXIS_DESCR
/end CHARACTERISTIC
/begin CHARACTERISTIC Speed_Max_Torque_Crawl_D_Break_M06 "D档蠕行制动状态下最大驱动力矩" CURVE 0x785845 ECTEK_Curve_u16s16 0 NO_FORMULA 0.0 5000.0 FORMAT "%.2" BIT_MASK 0xFFFF
 /begin AXIS_DESCR STD_AXIS NO_INPUT_QUANTITY rpm1-1 9 -15000.0 15000.0 DEPOSIT ABSOLUTE FORMAT "%.2" /end AXIS_DESCR
/end CHARACTERISTIC
/begin CHARACTERISTIC Speed_Vmh10ms_General_M06 "通用相对转速-AD曲线 rpm----mh10ms" CURVE 0x78586B ECTEK_Curve_s16s16 0 Vmh10ms -1000.0 1000.0 FORMAT "%.2" BIT_MASK 0xFFFF
 /begin AXIS_DESCR STD_AXIS NO_INPUT_QUANTITY rpm1-1 11 -30000.0 30000.0 DEPOSIT ABSOLUTE FORMAT "%.2" /end AXIS_DESCR
/end CHARACTERISTIC
/begin CHARACTERISTIC Torque_Increment_General_M06 "通用AD修正转矩给定每周期增量" CURVE 0x785899 ECTEK_Curve_s16s16 0 NO_FORMULA -100.0 100.0 FORMAT "%.2" BIT_MASK 0xFFFF
 /begin AXIS_DESCR STD_AXIS NO_INPUT_QUANTITY Vmh10ms 11 -1000.0 1000.0 DEPOSIT ABSOLUTE FORMAT "%.2" /end AXIS_DESCR
/end CHARACTERISTIC
/begin CHARACTERISTIC Speed_Vmh10ms_D_Park_M06 "D档驻坡 转速-AD曲线 rpm----mh10ms" CURVE 0x7858C7 ECTEK_Curve_s16s16 0 Vmh10ms -1000.0 1000.0 FORMAT "%.2" BIT_MASK 0xFFFF
 /begin AXIS_DESCR STD_AXIS NO_INPUT_QUANTITY rpm1-1 12 -15000.0 15000.0 DEPOSIT ABSOLUTE FORMAT "%.2" /end AXIS_DESCR
/end CHARACTERISTIC
/begin CHARACTERISTIC Torque_Increment_D_Park_M06 "D档驻坡AD修正转矩给定每周期增量" CURVE 0x7858F9 ECTEK_Curve_s16s16 0 NO_FORMULA -100.0 100.0 FORMAT "%.2" BIT_MASK 0xFFFF
 /begin AXIS_DESCR STD_AXIS NO_INPUT_QUANTITY Vmh10ms 11 -1000.0 1000.0 DEPOSIT ABSOLUTE FORMAT "%.2" /end AXIS_DESCR
/end CHARACTERISTIC
/begin CHARACTERISTIC Motor_Speed_Torque_Break_M06 "电机最大制动力矩" CURVE 0x785927 ECTEK_Curve_s16s16 0 NO_FORMULA 0.0 1000.0 FORMAT "%.2" BIT_MASK 0xFFFF
 /begin AXIS_DESCR STD_AXIS NO_INPUT_QUANTITY rpm1-1 14 -15000.0 15000.0 DEPOSIT ABSOLUTE FORMAT "%.2" /end AXIS_DESCR
/end CHARACTERISTIC
/begin CHARACTERISTIC FeedBack_Coast_D_Torque_M06 "D档滑行回馈 速度-力矩  定点" CURVE 0x785961 ECTEK_Curve_s16s16 0 NO_FORMULA -1000.0 1000.0 FORMAT "%.2" BIT_MASK 0xFFFF
 /begin AXIS_DESCR STD_AXIS NO_INPUT_QUANTITY rpm1-1 8 -15000.0 15000.0 DEPOSIT ABSOLUTE FORMAT "%.2" /end AXIS_DESCR
/end CHARACTERISTIC
/begin CHARACTERISTIC FeedBack_Break_D_Torque_M06 "D档制动回馈 速度-力矩 定点" CURVE 0x785983 ECTEK_Curve_s16s16 0 NO_FORMULA -1000.0 1000.0 FORMAT "%.2" BIT_MASK 0xFFFF
 /begin AXIS_DESCR STD_AXIS NO_INPUT_QUANTITY rpm1-1 8 -15000.0 15000.0 DEPOSIT ABSOLUTE FORMAT "%.2" /end AXIS_DESCR
/end CHARACTERISTIC
/begin CHARACTERISTIC Speed_Efficieny_M06 "电机速度-转换效率曲线" CURVE 0x7859A5 ECTEK_Curve_u16u16 0 rFactor100_PWM 0.0 100.0 FORMAT "%.2" BIT_MASK 0xFFFF
 /begin AXIS_DESCR STD_AXIS NO_INPUT_QUANTITY rpm1-1 16 0.0 15000.0 DEPOSIT ABSOLUTE FORMAT "%.2" /end AXIS_DESCR
/end CHARACTERISTIC
/begin CHARACTERISTIC Speed_Efficieny_FeedBack_M06 "电机速度-转换效率曲线 发电" CURVE 0x7859E7 ECTEK_Curve_u16u16 0 rFactor100_PWM 0.0 100.0 FORMAT "%.2" BIT_MASK 0xFFFF
 /begin AXIS_DESCR STD_AXIS NO_INPUT_QUANTITY rpm1-1 16 0.0 15000.0 DEPOSIT ABSOLUTE FORMAT "%.2" /end AXIS_DESCR
/end CHARACTERISTIC
/begin CHARACTERISTIC AutoPark_Motor_Speed_Torque_M06 "驻坡最大力矩" CURVE 0x785A29 ECTEK_Curve_u16s16 0 NO_FORMULA 0.0 5000.0 FORMAT "%.2" BIT_MASK 0xFFFF
 /begin AXIS_DESCR STD_AXIS NO_INPUT_QUANTITY rpm1-1 9 -15000.0 15000.0 DEPOSIT ABSOLUTE FORMAT "%.2" /end AXIS_DESCR
/end CHARACTERISTIC
/begin CHARACTERISTIC AccPedCD_rUW_CUR_M06 "油门开度" CURVE 0x785A4F ECTEK_Curve_u16u16 0 rFactor100_PWM 0.0 100.0 FORMAT "%.2" BIT_MASK 0xFFFF
 /begin AXIS_DESCR STD_AXIS NO_INPUT_QUANTITY u5V 7 0.0 5.0 DEPOSIT ABSOLUTE FORMAT "%.2" /end AXIS_DESCR
/end CHARACTERISTIC
/begin CHARACTERISTIC AccPedCD_rUW_CUR2_M06 "油门2开度" CURVE 0x785A6D ECTEK_Curve_u16u16 0 rFactor100_PWM 0.0 100.0 FORMAT "%.2" BIT_MASK 0xFFFF
 /begin AXIS_DESCR STD_AXIS NO_INPUT_QUANTITY u5V 7 0.0 5.0 DEPOSIT ABSOLUTE FORMAT "%.2" /end AXIS_DESCR
/end CHARACTERISTIC
/begin CHARACTERISTIC Motor_Vehicle_Speed_Scale_M061 "转速-车速比例， D09 车速与转速比 1：44.83" VALUE 0x785A8B ECTEK_Value_u8 0 NO_COMPU_METHOD 0.0 255.0 FORMAT "%.2" BIT_MASK 0xFF /end CHARACTERISTIC
/begin CHARACTERISTIC Demand_Limit_High_M061 "速度上限" VALUE 0x785A8C ECTEK_Value_u16 0 NO_COMPU_METHOD 0.0 4095.0 FORMAT "%.2" BIT_MASK 0xFFFF /end CHARACTERISTIC
/begin CHARACTERISTIC Demand_Limit_Low_M061 "速度下限" VALUE 0x785A8E ECTEK_Value_u16 0 NO_COMPU_METHOD 0.0 4095.0 FORMAT "%.2" BIT_MASK 0xFFFF /end CHARACTERISTIC
/begin CHARACTERISTIC Crawl_D_Speed_Max_M061 "D蠕动最大速度  从其他状态进入蠕动的速度" VALUE 0x785A90 ECTEK_Value_u16 0 NO_COMPU_METHOD 0.0 1000.0 FORMAT "%.2" BIT_MASK 0xFFFF /end CHARACTERISTIC
/begin CHARACTERISTIC Crawl_D_Torque_Delay_Max_M061 "蠕动更新间隔  单位10ms" VALUE 0x785A92 ECTEK_Value_u8 0 NO_COMPU_METHOD 1.0 255.0 FORMAT "%.2" BIT_MASK 0xFF /end CHARACTERISTIC
/begin CHARACTERISTIC Crawl_D_Torque_Delay_Start_Max_M061 "起步蠕动更新间隔  单位10ms" VALUE 0x785A93 ECTEK_Value_u8 0 NO_FORMULA 0.0 255.0 FORMAT "%.2" BIT_MASK 0xFF /end CHARACTERISTIC
/begin CHARACTERISTIC Speed_Buffer_Number_M061 "10ms车辆速度采样缓冲次数" VALUE 0x785A94 ECTEK_Value_u8 0 NO_COMPU_METHOD 1.0 69.0 FORMAT "%.2" BIT_MASK 0xFF /end CHARACTERISTIC
/begin CHARACTERISTIC Speed_Average_Number_M061 "10ms平均车速缓冲次数" VALUE 0x785A95 ECTEK_Value_u8 0 NO_COMPU_METHOD 1.0 69.0 FORMAT "%.2" BIT_MASK 0xFF /end CHARACTERISTIC
/begin CHARACTERISTIC Torque_Buffer_Number_AutoPark_M061 "10ms车辆平均转矩采样缓冲次数 驻坡" VALUE 0x785A96 ECTEK_Value_u8 0 NO_COMPU_METHOD 1.0 69.0 FORMAT "%.2" BIT_MASK 0xFF /end CHARACTERISTIC
/begin CHARACTERISTIC D_Park_Start_Speed_M061 "D驻坡触发转速" VALUE 0x785A97 ECTEK_Value_u8 0 NO_COMPU_METHOD 0.0 255.0 FORMAT "%.2" BIT_MASK 0xFF /end CHARACTERISTIC
/begin CHARACTERISTIC Auto_Park_Speed_Acc_Max_M061 "激活D驻坡最大退行转速累加" VALUE 0x785A98 ECTEK_Value_s16 0 NO_FORMULA -32768.0 32767.0 FORMAT "%.2" BIT_MASK 0xFFFF /end CHARACTERISTIC
/begin CHARACTERISTIC Auto_Park_Speed_Times_Max_M061 "" VALUE 0x785A9A ECTEK_Value_u16 0 NO_FORMULA 0.0 65535.0 FORMAT "%.2" BIT_MASK 0xFFFF /end CHARACTERISTIC
/begin CHARACTERISTIC Auto_Torque_Min_M061 "自动转矩最小正值" VALUE 0x785A9C ECTEK_Value_s16 0 NO_COMPU_METHOD 0.0 300.0 FORMAT "%.2" BIT_MASK 0xFFFF /end CHARACTERISTIC
/begin CHARACTERISTIC Auto_Torque_Max_M061 "自动转矩最大负值" VALUE 0x785A9E ECTEK_Value_s16 0 NO_FORMULA -300.0 0.0 FORMAT "%.2" BIT_MASK 0xFFFF /end CHARACTERISTIC
/begin CHARACTERISTIC R_Vhms_Average_Ratio_M061 "R档Vhms平均值缓冲比例" VALUE 0x785AA0 ECTEK_Value_u16 0 NO_FORMULA 1.0 500.0 FORMAT "%.2" BIT_MASK 0xFFFF /end CHARACTERISTIC
/begin CHARACTERISTIC D_Vhms_Average_Ratio_M061 "D档Vhms平均值缓冲比例" VALUE 0x785AA2 ECTEK_Value_u16 0 NO_FORMULA 1.0 500.0 FORMAT "%.2" BIT_MASK 0xFFFF /end CHARACTERISTIC
/begin CHARACTERISTIC Motor_Speed_Torque_M061 "转速_最大转矩_旭利、230(500)Nm、50(90)KW、2100(6000)rpm 、比例44.83" CURVE 0x785AA4 ECTEK_Curve_u16s16 0 NO_FORMULA 0.0 5000.0 FORMAT "%.2" BIT_MASK 0xFFFF
 /begin AXIS_DESCR STD_AXIS NO_INPUT_QUANTITY rpm1-1 27 -15000.0 15000.0 DEPOSIT ABSOLUTE FORMAT "%.2" /end AXIS_DESCR
/end CHARACTERISTIC
/begin CHARACTERISTIC Speed_Vmh10ms_Crawl_D_M061 "D档蠕动 转速-AD曲线 rpm----mh10ms" CURVE 0x785B12 ECTEK_Curve_s16s16 0 Vmh10ms -500.0 500.0 FORMAT "%.2" BIT_MASK 0xFFFF
 /begin AXIS_DESCR STD_AXIS NO_INPUT_QUANTITY rpm1-1 10 -15000.0 15000.0 DEPOSIT ABSOLUTE FORMAT "%.2" /end AXIS_DESCR
/end CHARACTERISTIC
/begin CHARACTERISTIC Torque_Increment_Crawl_D_M061 "D档蠕动 AD修正转矩给定每周期增量" CURVE 0x785B3C ECTEK_Curve_s16s16 0 NO_FORMULA -100.0 100.0 FORMAT "%.2" BIT_MASK 0xFFFF
 /begin AXIS_DESCR STD_AXIS NO_INPUT_QUANTITY Vmh10ms 11 -1000.0 1000.0 DEPOSIT ABSOLUTE FORMAT "%.2" /end AXIS_DESCR
/end CHARACTERISTIC
/begin CHARACTERISTIC Speed_Max_Torque_Crawl_D_M061 "D档蠕行模式最大力矩" CURVE 0x785B6A ECTEK_Curve_u16s16 0 NO_FORMULA 0.0 5000.0 FORMAT "%.2" BIT_MASK 0xFFFF
 /begin AXIS_DESCR STD_AXIS NO_INPUT_QUANTITY rpm1-1 9 -15000.0 15000.0 DEPOSIT ABSOLUTE FORMAT "%.2" /end AXIS_DESCR
/end CHARACTERISTIC
/begin CHARACTERISTIC Speed_Max_Torque_Crawl_D_Break_M061 "D档蠕行制动状态下最大驱动力矩" CURVE 0x785B90 ECTEK_Curve_u16s16 0 NO_FORMULA 0.0 5000.0 FORMAT "%.2" BIT_MASK 0xFFFF
 /begin AXIS_DESCR STD_AXIS NO_INPUT_QUANTITY rpm1-1 9 -15000.0 15000.0 DEPOSIT ABSOLUTE FORMAT "%.2" /end AXIS_DESCR
/end CHARACTERISTIC
/begin CHARACTERISTIC Speed_Vmh10ms_General_M061 "通用相对转速-AD曲线 rpm----mh10ms" CURVE 0x785BB6 ECTEK_Curve_s16s16 0 Vmh10ms -1000.0 1000.0 FORMAT "%.2" BIT_MASK 0xFFFF
 /begin AXIS_DESCR STD_AXIS NO_INPUT_QUANTITY rpm1-1 11 -30000.0 30000.0 DEPOSIT ABSOLUTE FORMAT "%.2" /end AXIS_DESCR
/end CHARACTERISTIC
/begin CHARACTERISTIC Torque_Increment_General_M061 "通用AD修正转矩给定每周期增量" CURVE 0x785BE4 ECTEK_Curve_s16s16 0 NO_FORMULA -100.0 100.0 FORMAT "%.2" BIT_MASK 0xFFFF
 /begin AXIS_DESCR STD_AXIS NO_INPUT_QUANTITY Vmh10ms 11 -1000.0 1000.0 DEPOSIT ABSOLUTE FORMAT "%.2" /end AXIS_DESCR
/end CHARACTERISTIC
/begin CHARACTERISTIC Speed_Vmh10ms_D_Park_M061 "D档驻坡 转速-AD曲线 rpm----mh10ms" CURVE 0x785C12 ECTEK_Curve_s16s16 0 Vmh10ms -1000.0 1000.0 FORMAT "%.2" BIT_MASK 0xFFFF
 /begin AXIS_DESCR STD_AXIS NO_INPUT_QUANTITY rpm1-1 12 -15000.0 15000.0 DEPOSIT ABSOLUTE FORMAT "%.2" /end AXIS_DESCR
/end CHARACTERISTIC
/begin CHARACTERISTIC Torque_Increment_D_Park_M061 "D档驻坡AD修正转矩给定每周期增量" CURVE 0x785C44 ECTEK_Curve_s16s16 0 NO_FORMULA -100.0 100.0 FORMAT "%.2" BIT_MASK 0xFFFF
 /begin AXIS_DESCR STD_AXIS NO_INPUT_QUANTITY Vmh10ms 11 -1000.0 1000.0 DEPOSIT ABSOLUTE FORMAT "%.2" /end AXIS_DESCR
/end CHARACTERISTIC
/begin CHARACTERISTIC Motor_Speed_Torque_Break_M061 "电机最大制动力矩" CURVE 0x785C72 ECTEK_Curve_s16s16 0 NO_FORMULA 0.0 1000.0 FORMAT "%.2" BIT_MASK 0xFFFF
 /begin AXIS_DESCR STD_AXIS NO_INPUT_QUANTITY rpm1-1 14 -15000.0 15000.0 DEPOSIT ABSOLUTE FORMAT "%.2" /end AXIS_DESCR
/end CHARACTERISTIC
/begin CHARACTERISTIC FeedBack_Coast_D_Torque_M061 "D档滑行回馈 速度-力矩  定点" CURVE 0x785CAC ECTEK_Curve_s16s16 0 NO_FORMULA -1000.0 1000.0 FORMAT "%.2" BIT_MASK 0xFFFF
 /begin AXIS_DESCR STD_AXIS NO_INPUT_QUANTITY rpm1-1 8 -15000.0 15000.0 DEPOSIT ABSOLUTE FORMAT "%.2" /end AXIS_DESCR
/end CHARACTERISTIC
/begin CHARACTERISTIC FeedBack_Break_D_Torque_M061 "D档制动回馈 速度-力矩 定点" CURVE 0x785CCE ECTEK_Curve_s16s16 0 NO_FORMULA -1000.0 1000.0 FORMAT "%.2" BIT_MASK 0xFFFF
 /begin AXIS_DESCR STD_AXIS NO_INPUT_QUANTITY rpm1-1 8 -15000.0 15000.0 DEPOSIT ABSOLUTE FORMAT "%.2" /end AXIS_DESCR
/end CHARACTERISTIC
/begin CHARACTERISTIC Speed_Efficieny_M061 "电机速度-转换效率曲线" CURVE 0x785CF0 ECTEK_Curve_u16u16 0 rFactor100_PWM 0.0 100.0 FORMAT "%.2" BIT_MASK 0xFFFF
 /begin AXIS_DESCR STD_AXIS NO_INPUT_QUANTITY rpm1-1 17 0.0 15000.0 DEPOSIT ABSOLUTE FORMAT "%.2" /end AXIS_DESCR
/end CHARACTERISTIC
/begin CHARACTERISTIC Speed_Efficieny_FeedBack_M061 "电机速度-转换效率曲线 发电" CURVE 0x785D36 ECTEK_Curve_u16u16 0 rFactor100_PWM 0.0 100.0 FORMAT "%.2" BIT_MASK 0xFFFF
 /begin AXIS_DESCR STD_AXIS NO_INPUT_QUANTITY rpm1-1 17 0.0 15000.0 DEPOSIT ABSOLUTE FORMAT "%.2" /end AXIS_DESCR
/end CHARACTERISTIC
/begin CHARACTERISTIC AutoPark_Motor_Speed_Torque_M061 "驻坡最大力矩" CURVE 0x785D7C ECTEK_Curve_u16s16 0 NO_FORMULA 0.0 5000.0 FORMAT "%.2" BIT_MASK 0xFFFF
 /begin AXIS_DESCR STD_AXIS NO_INPUT_QUANTITY rpm1-1 9 -15000.0 15000.0 DEPOSIT ABSOLUTE FORMAT "%.2" /end AXIS_DESCR
/end CHARACTERISTIC
/begin CHARACTERISTIC Speed_Efficieny_M062 "电机速度-转换效率曲线" CURVE 0x785DA2 ECTEK_Curve_u16u16 0 rFactor100_PWM 0.0 100.0 FORMAT "%.2" BIT_MASK 0xFFFF
 /begin AXIS_DESCR STD_AXIS NO_INPUT_QUANTITY rpm1-1 28 0.0 15000.0 DEPOSIT ABSOLUTE FORMAT "%.2" /end AXIS_DESCR
/end CHARACTERISTIC
/begin CHARACTERISTIC Speed_Efficieny_FeedBack_M062 "电机速度-转换效率曲线 发电" CURVE 0x785E14 ECTEK_Curve_u16u16 0 rFactor100_PWM 0.0 100.0 FORMAT "%.2" BIT_MASK 0xFFFF
 /begin AXIS_DESCR STD_AXIS NO_INPUT_QUANTITY rpm1-1 28 0.0 15000.0 DEPOSIT ABSOLUTE FORMAT "%.2" /end AXIS_DESCR
/end CHARACTERISTIC
/begin CHARACTERISTIC Motor_Vehicle_Speed_Scale_M09 "转速-车速比例， 优优114.411   D11 36.632" VALUE 0x785E86 ECTEK_Value_u8 0 NO_COMPU_METHOD 0.0 255.0 FORMAT "%.2" BIT_MASK 0xFF /end CHARACTERISTIC
/begin CHARACTERISTIC Demand_Limit_High_M09 "速度上限" VALUE 0x785E87 ECTEK_Value_u16 0 NO_COMPU_METHOD 0.0 4095.0 FORMAT "%.2" BIT_MASK 0xFFFF /end CHARACTERISTIC
/begin CHARACTERISTIC Demand_Limit_Low_M09 "速度下限" VALUE 0x785E89 ECTEK_Value_u16 0 NO_COMPU_METHOD 0.0 4095.0 FORMAT "%.2" BIT_MASK 0xFFFF /end CHARACTERISTIC
/begin CHARACTERISTIC Crawl_D_Speed_Max_M09 "D蠕动最大速度  从其他状态进入蠕动的速度" VALUE 0x785E8B ECTEK_Value_u16 0 NO_COMPU_METHOD 0.0 1000.0 FORMAT "%.2" BIT_MASK 0xFFFF /end CHARACTERISTIC
/begin CHARACTERISTIC Crawl_D_Torque_Delay_Max_M09 "蠕动更新间隔  单位10ms" VALUE 0x785E8D ECTEK_Value_u8 0 NO_COMPU_METHOD 1.0 255.0 FORMAT "%.2" BIT_MASK 0xFF /end CHARACTERISTIC
/begin CHARACTERISTIC Crawl_D_Torque_Delay_Start_Max_M09 "起步蠕动更新间隔  单位10ms" VALUE 0x785E8E ECTEK_Value_u8 0 NO_FORMULA 0.0 255.0 FORMAT "%.2" BIT_MASK 0xFF /end CHARACTERISTIC
/begin CHARACTERISTIC Speed_Buffer_Number_M09 "10ms车辆速度采样缓冲次数" VALUE 0x785E8F ECTEK_Value_u8 0 NO_COMPU_METHOD 1.0 69.0 FORMAT "%.2" BIT_MASK 0xFF /end CHARACTERISTIC
/begin CHARACTERISTIC Speed_Average_Number_M09 "10ms平均车速缓冲次数" VALUE 0x785E90 ECTEK_Value_u8 0 NO_COMPU_METHOD 1.0 69.0 FORMAT "%.2" BIT_MASK 0xFF /end CHARACTERISTIC
/begin CHARACTERISTIC Torque_Buffer_Number_AutoPark_M09 "10ms车辆平均转矩采样缓冲次数 驻坡" VALUE 0x785E91 ECTEK_Value_u8 0 NO_COMPU_METHOD 1.0 69.0 FORMAT "%.2" BIT_MASK 0xFF /end CHARACTERISTIC
/begin CHARACTERISTIC D_Park_Start_Speed_M09 "D驻坡触发转速" VALUE 0x785E92 ECTEK_Value_u8 0 NO_COMPU_METHOD 0.0 255.0 FORMAT "%.2" BIT_MASK 0xFF /end CHARACTERISTIC
/begin CHARACTERISTIC Auto_Park_Speed_Acc_Max_M09 "激活D驻坡最大退行转速累加" VALUE 0x785E93 ECTEK_Value_s16 0 NO_FORMULA -32768.0 32767.0 FORMAT "%.2" BIT_MASK 0xFFFF /end CHARACTERISTIC
/begin CHARACTERISTIC Auto_Park_Speed_Times_Max_M09 "激活D驻坡最大退行增速时间 单位10ms" VALUE 0x785E95 ECTEK_Value_u16 0 NO_FORMULA 0.0 65535.0 FORMAT "%.2" BIT_MASK 0xFFFF /end CHARACTERISTIC
/begin CHARACTERISTIC Auto_Torque_Min_M09 "自动转矩最小正值" VALUE 0x785E97 ECTEK_Value_s16 0 NO_COMPU_METHOD 0.0 300.0 FORMAT "%.2" BIT_MASK 0xFFFF /end CHARACTERISTIC
/begin CHARACTERISTIC Auto_Torque_Max_M09 "自动转矩最大负值" VALUE 0x785E99 ECTEK_Value_s16 0 NO_FORMULA -300.0 0.0 FORMAT "%.2" BIT_MASK 0xFFFF /end CHARACTERISTIC
/begin CHARACTERISTIC R_Vhms_Average_Ratio_M09 "R档Vhms平均值缓冲比例" VALUE 0x785E9B ECTEK_Value_u16 0 NO_FORMULA 1.0 500.0 FORMAT "%.2" BIT_MASK 0xFFFF /end CHARACTERISTIC
/begin CHARACTERISTIC D_Vhms_Average_Ratio_M09 "D档Vhms平均值缓冲比例" VALUE 0x785E9D ECTEK_Value_u16 0 NO_FORMULA 1.0 500.0 FORMAT "%.2" BIT_MASK 0xFFFF /end CHARACTERISTIC
/begin CHARACTERISTIC Motor_Speed_Torque_M09 "转速_最大转矩_大地和350-700Nm 70-100KW  比例36.632" CURVE 0x785E9F ECTEK_Curve_u16s16 0 NO_FORMULA 0.0 5000.0 FORMAT "%.2" BIT_MASK 0xFFFF
 /begin AXIS_DESCR STD_AXIS NO_INPUT_QUANTITY rpm1-1 28 -15000.0 15000.0 DEPOSIT ABSOLUTE FORMAT "%.2" /end AXIS_DESCR
/end CHARACTERISTIC
/begin CHARACTERISTIC Speed_Vmh10ms_Crawl_D_M09 "D档蠕动 转速-AD曲线 rpm----mh10ms" CURVE 0x785F11 ECTEK_Curve_s16s16 0 Vmh10ms -500.0 500.0 FORMAT "%.2" BIT_MASK 0xFFFF
 /begin AXIS_DESCR STD_AXIS NO_INPUT_QUANTITY rpm1-1 10 -15000.0 15000.0 DEPOSIT ABSOLUTE FORMAT "%.2" /end AXIS_DESCR
/end CHARACTERISTIC
/begin CHARACTERISTIC Torque_Increment_Crawl_D_M09 "D档蠕动 AD修正转矩给定每周期增量" CURVE 0x785F3B ECTEK_Curve_s16s16 0 NO_FORMULA -100.0 100.0 FORMAT "%.2" BIT_MASK 0xFFFF
 /begin AXIS_DESCR STD_AXIS NO_INPUT_QUANTITY Vmh10ms 11 -1000.0 1000.0 DEPOSIT ABSOLUTE FORMAT "%.2" /end AXIS_DESCR
/end CHARACTERISTIC
/begin CHARACTERISTIC Speed_Max_Torque_Crawl_D_M09 "D档蠕行模式最大力矩" CURVE 0x785F69 ECTEK_Curve_u16s16 0 NO_FORMULA 0.0 5000.0 FORMAT "%.2" BIT_MASK 0xFFFF
 /begin AXIS_DESCR STD_AXIS NO_INPUT_QUANTITY rpm1-1 9 -15000.0 15000.0 DEPOSIT ABSOLUTE FORMAT "%.2" /end AXIS_DESCR
/end CHARACTERISTIC
/begin CHARACTERISTIC Speed_Max_Torque_Crawl_D_Break_M09 "D档蠕行制动状态下最大驱动力矩" CURVE 0x785F8F ECTEK_Curve_u16s16 0 NO_FORMULA 0.0 5000.0 FORMAT "%.2" BIT_MASK 0xFFFF
 /begin AXIS_DESCR STD_AXIS NO_INPUT_QUANTITY rpm1-1 9 -15000.0 15000.0 DEPOSIT ABSOLUTE FORMAT "%.2" /end AXIS_DESCR
/end CHARACTERISTIC
/begin CHARACTERISTIC Speed_Vmh10ms_General_M09 "通用相对转速-AD曲线 rpm----mh10ms" CURVE 0x785FB5 ECTEK_Curve_s16s16 0 Vmh10ms -1000.0 1000.0 FORMAT "%.2" BIT_MASK 0xFFFF
 /begin AXIS_DESCR STD_AXIS NO_INPUT_QUANTITY rpm1-1 11 -30000.0 30000.0 DEPOSIT ABSOLUTE FORMAT "%.2" /end AXIS_DESCR
/end CHARACTERISTIC
/begin CHARACTERISTIC Torque_Increment_General_M09 "通用AD修正转矩给定每周期增量" CURVE 0x785FE3 ECTEK_Curve_s16s16 0 NO_FORMULA -100.0 100.0 FORMAT "%.2" BIT_MASK 0xFFFF
 /begin AXIS_DESCR STD_AXIS NO_INPUT_QUANTITY Vmh10ms 11 -1000.0 1000.0 DEPOSIT ABSOLUTE FORMAT "%.2" /end AXIS_DESCR
/end CHARACTERISTIC
/begin CHARACTERISTIC Speed_Vmh10ms_D_Park_M09 "D档驻坡 转速-AD曲线 rpm----mh10ms" CURVE 0x786011 ECTEK_Curve_s16s16 0 Vmh10ms -1000.0 1000.0 FORMAT "%.2" BIT_MASK 0xFFFF
 /begin AXIS_DESCR STD_AXIS NO_INPUT_QUANTITY rpm1-1 12 -15000.0 15000.0 DEPOSIT ABSOLUTE FORMAT "%.2" /end AXIS_DESCR
/end CHARACTERISTIC
/begin CHARACTERISTIC Torque_Increment_D_Park_M09 "D档驻坡AD修正转矩给定每周期增量" CURVE 0x786043 ECTEK_Curve_s16s16 0 NO_FORMULA -100.0 100.0 FORMAT "%.2" BIT_MASK 0xFFFF
 /begin AXIS_DESCR STD_AXIS NO_INPUT_QUANTITY Vmh10ms 11 -1000.0 1000.0 DEPOSIT ABSOLUTE FORMAT "%.2" /end AXIS_DESCR
/end CHARACTERISTIC
/begin CHARACTERISTIC Motor_Speed_Torque_Break_M09 "电机最大制动力矩" CURVE 0x786071 ECTEK_Curve_s16s16 0 NO_FORMULA 0.0 1000.0 FORMAT "%.2" BIT_MASK 0xFFFF
 /begin AXIS_DESCR STD_AXIS NO_INPUT_QUANTITY rpm1-1 14 -15000.0 15000.0 DEPOSIT ABSOLUTE FORMAT "%.2" /end AXIS_DESCR
/end CHARACTERISTIC
/begin CHARACTERISTIC FeedBack_Coast_D_Torque_M09 "D档滑行回馈 速度-力矩  定点" CURVE 0x7860AB ECTEK_Curve_s16s16 0 NO_FORMULA -1000.0 1000.0 FORMAT "%.2" BIT_MASK 0xFFFF
 /begin AXIS_DESCR STD_AXIS NO_INPUT_QUANTITY rpm1-1 8 -15000.0 15000.0 DEPOSIT ABSOLUTE FORMAT "%.2" /end AXIS_DESCR
/end CHARACTERISTIC
/begin CHARACTERISTIC FeedBack_Break_D_Torque_M09 "D档制动回馈 速度-力矩 定点" CURVE 0x7860CD ECTEK_Curve_s16s16 0 NO_FORMULA -1000.0 1000.0 FORMAT "%.2" BIT_MASK 0xFFFF
 /begin AXIS_DESCR STD_AXIS NO_INPUT_QUANTITY rpm1-1 8 -15000.0 15000.0 DEPOSIT ABSOLUTE FORMAT "%.2" /end AXIS_DESCR
/end CHARACTERISTIC
/begin CHARACTERISTIC Speed_Efficieny_M09 "电机速度-转换效率曲线" CURVE 0x7860EF ECTEK_Curve_u16u16 0 rFactor100_PWM 0.0 100.0 FORMAT "%.2" BIT_MASK 0xFFFF
 /begin AXIS_DESCR STD_AXIS NO_INPUT_QUANTITY rpm1-1 17 0.0 15000.0 DEPOSIT ABSOLUTE FORMAT "%.2" /end AXIS_DESCR
/end CHARACTERISTIC
/begin CHARACTERISTIC AutoPark_Motor_Speed_Torque_M09 "驻坡最大力矩" CURVE 0x786135 ECTEK_Curve_u16s16 0 NO_FORMULA 0.0 5000.0 FORMAT "%.2" BIT_MASK 0xFFFF
 /begin AXIS_DESCR STD_AXIS NO_INPUT_QUANTITY rpm1-1 9 -15000.0 15000.0 DEPOSIT ABSOLUTE FORMAT "%.2" /end AXIS_DESCR
/end CHARACTERISTIC
/begin CHARACTERISTIC Tire_Pressure_Low_Level_M10 "胎压过低报警压力" VALUE 0x78615B ECTEK_Value_u16 0 rFactor10_VSSPlaus 0.0 1397.0 FORMAT "%.2" BIT_MASK 0xFFFF /end CHARACTERISTIC
/begin CHARACTERISTIC Motor_Vehicle_Speed_Scale_M10 "转速-车速比例， D08  75.15" VALUE 0x78615D ECTEK_Value_u8 0 NO_FORMULA 0.0 255.0 FORMAT "%.2" BIT_MASK 0xFF /end CHARACTERISTIC
/begin CHARACTERISTIC Demand_Limit_High_M10 "转速上线  *4" VALUE 0x78615E ECTEK_Value_u16 0 NO_FORMULA -0.0 4095.0 FORMAT "%.2" BIT_MASK 0xFFFF /end CHARACTERISTIC
/begin CHARACTERISTIC Demand_Limit_Low_M10 "速度下限" VALUE 0x786160 ECTEK_Value_u16 0 NO_FORMULA -0.0 4095.0 FORMAT "%.2" BIT_MASK 0xFFFF /end CHARACTERISTIC
/begin CHARACTERISTIC Crawl_D_Speed_Max_M10 "D蠕动最大速度  从其他状态进入蠕动的速度" VALUE 0x786162 ECTEK_Value_u16 0 rpm1-1 -0.0 1000.0 FORMAT "%.2" BIT_MASK 0xFFFF /end CHARACTERISTIC
/begin CHARACTERISTIC Crawl_D_Torque_Delay_Max_M10 "蠕动更新间隔  单位10ms" VALUE 0x786164 ECTEK_Value_u8 0 NO_FORMULA -0.0 255.0 FORMAT "%.2" BIT_MASK 0xFF /end CHARACTERISTIC
/begin CHARACTERISTIC Crawl_D_Torque_Delay_Start_Max_M10 "起步蠕动更新间隔  单位10ms" VALUE 0x786165 ECTEK_Value_u8 0 NO_COMPU_METHOD -4294967296.0 4294967296.0 FORMAT "%.2" BIT_MASK 0xFF /end CHARACTERISTIC
/begin CHARACTERISTIC Speed_Buffer_Number_M10 "10ms车辆速度采样缓冲次数" VALUE 0x786166 ECTEK_Value_u8 0 NO_FORMULA -0.0 69.0 FORMAT "%.2" BIT_MASK 0xFF /end CHARACTERISTIC
/begin CHARACTERISTIC Speed_Average_Number_M10 "10ms平均车速缓冲次数" VALUE 0x786167 ECTEK_Value_u8 0 NO_FORMULA -0.0 69.0 FORMAT "%.2" BIT_MASK 0xFF /end CHARACTERISTIC
/begin CHARACTERISTIC Torque_Buffer_Number_AutoPark_M10 "10ms平均转矩缓冲次数" VALUE 0x786168 ECTEK_Value_u8 0 NO_FORMULA -0.0 69.0 FORMAT "%.2" BIT_MASK 0xFF /end CHARACTERISTIC
/begin CHARACTERISTIC D_Park_Start_Speed_M10 "D驻坡触发转速" VALUE 0x786169 ECTEK_Value_u8 0 rpm1-1 -0.0 255.0 FORMAT "%.2" BIT_MASK 0xFF /end CHARACTERISTIC
/begin CHARACTERISTIC Auto_Park_Speed_Acc_Max_M10 "激活D驻坡最大退行转速累加" VALUE 0x78616A ECTEK_Value_s16 0 NO_FORMULA -32767.0 32768.0 FORMAT "%.2" BIT_MASK 0xFFFF /end CHARACTERISTIC
/begin CHARACTERISTIC Auto_Park_Speed_Times_Max_M10 "激活D驻坡最大退行增速时间 单位10ms" VALUE 0x78616C ECTEK_Value_u16 0 NO_FORMULA -0.0 65535.0 FORMAT "%.2" BIT_MASK 0xFFFF /end CHARACTERISTIC
/begin CHARACTERISTIC Auto_Torque_Min_M10 "自动转矩最小正值" VALUE 0x78616E ECTEK_Value_s16 0 NO_FORMULA 0.0 150.0 FORMAT "%.2" BIT_MASK 0xFFFF /end CHARACTERISTIC
/begin CHARACTERISTIC Auto_Torque_Max_M10 "自动转矩最大负值" VALUE 0x786170 ECTEK_Value_s16 0 NO_FORMULA -150.0 0.0 FORMAT "%.2" BIT_MASK 0xFFFF /end CHARACTERISTIC
/begin CHARACTERISTIC R_Vhms_Average_Ratio_M10 "R档Vhms平均值缓冲比例" VALUE 0x786172 ECTEK_Value_u16 0 NO_FORMULA 1.0 500.0 FORMAT "%.2" BIT_MASK 0xFFFF /end CHARACTERISTIC
/begin CHARACTERISTIC D_Vhms_Average_Ratio_M10 "D档Vhms平均值缓冲比例" VALUE 0x786174 ECTEK_Value_u16 0 NO_FORMULA 1.0 500.0 FORMAT "%.2" BIT_MASK 0xFFFF /end CHARACTERISTIC
/begin CHARACTERISTIC Motor_Speed_Torque_M10 "转速_最大转矩 易动 200Nm 60KW 75" CURVE 0x786176 ECTEK_Curve_u16s16 0 NO_FORMULA -5000.0 5000.0 FORMAT "%.2" BIT_MASK 0xFFFF
 /begin AXIS_DESCR STD_AXIS NO_INPUT_QUANTITY rpm1-1 28 -15000.0 15000.0 DEPOSIT ABSOLUTE FORMAT "%.2" /end AXIS_DESCR
/end CHARACTERISTIC
/begin CHARACTERISTIC AccPed_Rip_M10 "油门曲线" CURVE 0x7861E8 ECTEK_Curve_u16u16 0 rFactor100_PWM -0.0 100.0 FORMAT "%.2" BIT_MASK 0xFFFF
 /begin AXIS_DESCR STD_AXIS NO_INPUT_QUANTITY rFactor100_PWM 11 -0.0 100.0 DEPOSIT ABSOLUTE FORMAT "%.2" /end AXIS_DESCR
/end CHARACTERISTIC
/begin CHARACTERISTIC Speed_Vmh10ms_Crawl_D_M10 "D档蠕动 转速-AD曲线 rpm----mh10ms" CURVE 0x786216 ECTEK_Curve_s16s16 0 Vmh10ms -500.0 500.0 FORMAT "%.2" BIT_MASK 0xFFFF
 /begin AXIS_DESCR STD_AXIS NO_INPUT_QUANTITY rpm1-1 10 -15000.0 15000.0 DEPOSIT ABSOLUTE FORMAT "%.2" /end AXIS_DESCR
/end CHARACTERISTIC
/begin CHARACTERISTIC Torque_Increment_Crawl_D_M10 "D档蠕动 AD修正转矩给定每周期增量" CURVE 0x786240 ECTEK_Curve_s16s16 0 NO_FORMULA -100.0 100.0 FORMAT "%.2" BIT_MASK 0xFFFF
 /begin AXIS_DESCR STD_AXIS NO_INPUT_QUANTITY Vmh10ms 11 -1000.0 1000.0 DEPOSIT ABSOLUTE FORMAT "%.2" /end AXIS_DESCR
/end CHARACTERISTIC
/begin CHARACTERISTIC Speed_Max_Torque_Crawl_D_M10 "D档蠕行模式最大力矩" CURVE 0x78626E ECTEK_Curve_u16s16 0 NO_FORMULA -5000.0 5000.0 FORMAT "%.2" BIT_MASK 0xFFFF
 /begin AXIS_DESCR STD_AXIS NO_INPUT_QUANTITY rpm1-1 9 -15000.0 15000.0 DEPOSIT ABSOLUTE FORMAT "%.2" /end AXIS_DESCR
/end CHARACTERISTIC
/begin CHARACTERISTIC Speed_Max_Torque_Crawl_D_Break_M10 "D档蠕行制动状态下最大驱动力矩" CURVE 0x786294 ECTEK_Curve_u16s16 0 NO_FORMULA -1000.0 1000.0 FORMAT "%.2" BIT_MASK 0xFFFF
 /begin AXIS_DESCR STD_AXIS NO_INPUT_QUANTITY rpm1-1 9 -15000.0 15000.0 DEPOSIT ABSOLUTE FORMAT "%.2" /end AXIS_DESCR
/end CHARACTERISTIC
/begin CHARACTERISTIC Speed_Vmh10ms_General_M10 "通用相对转速-AD曲线 rpm----mh10ms" CURVE 0x7862BA ECTEK_Curve_s16s16 0 Vmh10ms -500.0 500.0 FORMAT "%.2" BIT_MASK 0xFFFF
 /begin AXIS_DESCR STD_AXIS NO_INPUT_QUANTITY rpm1-1 11 -30000.0 30000.0 DEPOSIT ABSOLUTE FORMAT "%.2" /end AXIS_DESCR
/end CHARACTERISTIC
/begin CHARACTERISTIC Torque_Increment_General_M10 "通用AD修正转矩给定每周期增量" CURVE 0x7862E8 ECTEK_Curve_s16s16 0 NO_FORMULA -100.0 100.0 FORMAT "%.2" BIT_MASK 0xFFFF
 /begin AXIS_DESCR STD_AXIS NO_INPUT_QUANTITY Vmh10ms 11 -1000.0 1000.0 DEPOSIT ABSOLUTE FORMAT "%.2" /end AXIS_DESCR
/end CHARACTERISTIC
/begin CHARACTERISTIC Speed_Vmh10ms_D_Park_M10 "D档驻坡 转速-AD曲线 rpm----mh10ms" CURVE 0x786316 ECTEK_Curve_s16s16 0 Vmh10ms -500.0 500.0 FORMAT "%.2" BIT_MASK 0xFFFF
 /begin AXIS_DESCR STD_AXIS NO_INPUT_QUANTITY rpm1-1 12 -15000.0 15000.0 DEPOSIT ABSOLUTE FORMAT "%.2" /end AXIS_DESCR
/end CHARACTERISTIC
/begin CHARACTERISTIC Torque_Increment_D_Park_M10 "D档驻坡AD修正转矩给定每周期增量" CURVE 0x786348 ECTEK_Curve_s16s16 0 NO_FORMULA -100.0 100.0 FORMAT "%.2" BIT_MASK 0xFFFF
 /begin AXIS_DESCR STD_AXIS NO_INPUT_QUANTITY Vmh10ms 11 -1000.0 1000.0 DEPOSIT ABSOLUTE FORMAT "%.2" /end AXIS_DESCR
/end CHARACTERISTIC
/begin CHARACTERISTIC Motor_Speed_Torque_Break_M10 "电机最大制动力矩" CURVE 0x786376 ECTEK_Curve_s16s16 0 NO_FORMULA -5000.0 5000.0 FORMAT "%.2" BIT_MASK 0xFFFF
 /begin AXIS_DESCR STD_AXIS NO_INPUT_QUANTITY rpm1-1 14 -15000.0 15000.0 DEPOSIT ABSOLUTE FORMAT "%.2" /end AXIS_DESCR
/end CHARACTERISTIC
/begin CHARACTERISTIC FeedBack_Coast_D_Torque_M10 "D档滑行回馈 速度-力矩  定点" CURVE 0x7863B0 ECTEK_Curve_s16s16 0 NO_FORMULA -5000.0 5000.0 FORMAT "%.2" BIT_MASK 0xFFFF
 /begin AXIS_DESCR STD_AXIS NO_INPUT_QUANTITY rpm1-1 8 -15000.0 15000.0 DEPOSIT ABSOLUTE FORMAT "%.2" /end AXIS_DESCR
/end CHARACTERISTIC
/begin CHARACTERISTIC FeedBack_Break_D_Torque_M10 "D档制动回馈 速度-力矩 定点" CURVE 0x7863D2 ECTEK_Curve_s16s16 0 NO_FORMULA -5000.0 5000.0 FORMAT "%.2" BIT_MASK 0xFFFF
 /begin AXIS_DESCR STD_AXIS NO_INPUT_QUANTITY rpm1-1 8 -15000.0 15000.0 DEPOSIT ABSOLUTE FORMAT "%.2" /end AXIS_DESCR
/end CHARACTERISTIC
/begin CHARACTERISTIC Speed_Efficieny_M10 "电机速度-转换效率曲线 驱动" CURVE 0x7863F4 ECTEK_Curve_u16u16 0 rFactor100_PWM 0.0 100.0 FORMAT "%.2" BIT_MASK 0xFFFF
 /begin AXIS_DESCR STD_AXIS NO_INPUT_QUANTITY rpm1-1 20 0.0 15000.0 DEPOSIT ABSOLUTE FORMAT "%.2" /end AXIS_DESCR
/end CHARACTERISTIC
/begin CHARACTERISTIC Speed_Efficieny_FeedBack_M10 "电机速度-转换效率曲线 发电" CURVE 0x786446 ECTEK_Curve_u16u16 0 rFactor100_PWM 0.0 150.0 FORMAT "%.2" BIT_MASK 0xFFFF
 /begin AXIS_DESCR STD_AXIS NO_INPUT_QUANTITY rpm1-1 20 0.0 15000.0 DEPOSIT ABSOLUTE FORMAT "%.2" /end AXIS_DESCR
/end CHARACTERISTIC
/begin CHARACTERISTIC AutoPark_Motor_Speed_Torque_M10 "驻坡最大力矩" CURVE 0x786498 ECTEK_Curve_u16s16 0 NO_FORMULA 0.0 5000.0 FORMAT "%.2" BIT_MASK 0xFFFF
 /begin AXIS_DESCR STD_AXIS NO_INPUT_QUANTITY rpm1-1 8 -15000.0 15000.0 DEPOSIT ABSOLUTE FORMAT "%.2" /end AXIS_DESCR
/end CHARACTERISTIC
/begin CHARACTERISTIC AccPedCD_rUW_CUR_M10 "油门开度" CURVE 0x7864BA ECTEK_Curve_u16u16 0 rFactor100_PWM 0.0 100.0 FORMAT "%.2" BIT_MASK 0xFFFF
 /begin AXIS_DESCR STD_AXIS NO_INPUT_QUANTITY u5V 7 0.0 5.0 DEPOSIT ABSOLUTE FORMAT "%.2" /end AXIS_DESCR
/end CHARACTERISTIC
/begin CHARACTERISTIC AccPedCD_rUW_CUR2_M10 "油门2开度" CURVE 0x7864D8 ECTEK_Curve_u16u16 0 rFactor100_PWM 0.0 100.0 FORMAT "%.2" BIT_MASK 0xFFFF
 /begin AXIS_DESCR STD_AXIS NO_INPUT_QUANTITY u5V 7 0.0 5.0 DEPOSIT ABSOLUTE FORMAT "%.2" /end AXIS_DESCR
/end CHARACTERISTIC
/begin CHARACTERISTIC EPS_Speed_M10 "D08L EPS频率与转速对应曲线 1.2~120Hz 低频" CURVE 0x7864F6 ECTEK_Curve_u16s16 0 PWM_Hz100 1.2 600.0 BIT_MASK 0xFFFF
 /begin AXIS_DESCR STD_AXIS NO_INPUT_QUANTITY rpm1-1 6 -15000.0 15000.0 DEPOSIT ABSOLUTE FORMAT "%.2" /end AXIS_DESCR
/end CHARACTERISTIC
/begin CHARACTERISTIC AC_Condenser_Temp_M10 "空调蒸发器温度 上拉100K 下拉10K" CURVE 0x786510 ECTEK_Curve_s16u16 0 Temp -100.0 150.0 FORMAT "%.2" BIT_MASK 0xFFFF
 /begin AXIS_DESCR STD_AXIS NO_INPUT_QUANTITY NO_FORMULA 31 0.0 4095.0 DEPOSIT ABSOLUTE FORMAT "%.2" /end AXIS_DESCR
/end CHARACTERISTIC
/begin CHARACTERISTIC AC_Condenser_Temp_M10_ACES "空调蒸发器温度_奥易克斯 上拉2.74K 下拉500K" CURVE 0x78658E ECTEK_Curve_s16u16 0 Temp -100.0 150.0 FORMAT "%.2" BIT_MASK 0xFFFF
 /begin AXIS_DESCR STD_AXIS NO_INPUT_QUANTITY NO_FORMULA 29 0.0 4095.0 DEPOSIT ABSOLUTE FORMAT "%.2" /end AXIS_DESCR
/end CHARACTERISTIC
/begin CHARACTERISTIC Motor_Vehicle_Speed_Scale_M101 "转速-车速比例， D08  75.15" VALUE 0x786604 ECTEK_Value_u8 0 NO_FORMULA 0.0 255.0 FORMAT "%.2" BIT_MASK 0xFF /end CHARACTERISTIC
/begin CHARACTERISTIC Demand_Limit_High_M101 "转速上线  *4" VALUE 0x786605 ECTEK_Value_u16 0 NO_FORMULA -0.0 4095.0 FORMAT "%.2" BIT_MASK 0xFFFF /end CHARACTERISTIC
/begin CHARACTERISTIC Demand_Limit_Low_M101 "速度下限" VALUE 0x786607 ECTEK_Value_u16 0 NO_FORMULA -0.0 4095.0 FORMAT "%.2" BIT_MASK 0xFFFF /end CHARACTERISTIC
/begin CHARACTERISTIC Crawl_D_Speed_Max_M101 "D蠕动最大速度  从其他状态进入蠕动的速度" VALUE 0x786609 ECTEK_Value_u16 0 rpm1-1 -0.0 1000.0 FORMAT "%.2" BIT_MASK 0xFFFF /end CHARACTERISTIC
/begin CHARACTERISTIC Crawl_D_Torque_Delay_Max_M101 "蠕动更新间隔  单位10ms" VALUE 0x78660B ECTEK_Value_u8 0 NO_FORMULA -0.0 255.0 FORMAT "%.2" BIT_MASK 0xFF /end CHARACTERISTIC
/begin CHARACTERISTIC Crawl_D_Torque_Delay_Start_Max_M101 "起步蠕动更新间隔  单位10ms" VALUE 0x78660C ECTEK_Value_u8 0 NO_COMPU_METHOD -4294967296.0 4294967296.0 FORMAT "%.2" BIT_MASK 0xFF /end CHARACTERISTIC
/begin CHARACTERISTIC Speed_Buffer_Number_M101 "10ms车辆速度采样缓冲次数" VALUE 0x78660D ECTEK_Value_u8 0 NO_FORMULA -0.0 69.0 FORMAT "%.2" BIT_MASK 0xFF /end CHARACTERISTIC
/begin CHARACTERISTIC Speed_Average_Number_M101 "10ms平均车速缓冲次数" VALUE 0x78660E ECTEK_Value_u8 0 NO_FORMULA -0.0 69.0 FORMAT "%.2" BIT_MASK 0xFF /end CHARACTERISTIC
/begin CHARACTERISTIC Torque_Buffer_Number_AutoPark_M101 "10ms平均转矩缓冲次数" VALUE 0x78660F ECTEK_Value_u8 0 NO_FORMULA -0.0 69.0 FORMAT "%.2" BIT_MASK 0xFF /end CHARACTERISTIC
/begin CHARACTERISTIC D_Park_Start_Speed_M101 "D驻坡触发转速" VALUE 0x786610 ECTEK_Value_u8 0 rpm1-1 -0.0 255.0 FORMAT "%.2" BIT_MASK 0xFF /end CHARACTERISTIC
/begin CHARACTERISTIC Auto_Park_Speed_Acc_Max_M101 "激活D驻坡最大退行转速累加" VALUE 0x786611 ECTEK_Value_s16 0 NO_FORMULA -32767.0 32768.0 FORMAT "%.2" BIT_MASK 0xFFFF /end CHARACTERISTIC
/begin CHARACTERISTIC Auto_Park_Speed_Times_Max_M101 "激活D驻坡最大退行增速时间 单位10ms" VALUE 0x786613 ECTEK_Value_u16 0 NO_FORMULA -0.0 65535.0 FORMAT "%.2" BIT_MASK 0xFFFF /end CHARACTERISTIC
/begin CHARACTERISTIC Auto_Torque_Min_M101 "自动转矩最小正值" VALUE 0x786615 ECTEK_Value_s16 0 NO_FORMULA 0.0 150.0 FORMAT "%.2" BIT_MASK 0xFFFF /end CHARACTERISTIC
/begin CHARACTERISTIC Auto_Torque_Max_M101 "自动转矩最大负值" VALUE 0x786617 ECTEK_Value_s16 0 NO_FORMULA -150.0 0.0 FORMAT "%.2" BIT_MASK 0xFFFF /end CHARACTERISTIC
/begin CHARACTERISTIC R_Vhms_Average_Ratio_M101 "R档Vhms平均值缓冲比例" VALUE 0x786619 ECTEK_Value_u16 0 NO_FORMULA 1.0 500.0 FORMAT "%.2" BIT_MASK 0xFFFF /end CHARACTERISTIC
/begin CHARACTERISTIC D_Vhms_Average_Ratio_M101 "D档Vhms平均值缓冲比例" VALUE 0x78661B ECTEK_Value_u16 0 NO_FORMULA 1.0 500.0 FORMAT "%.2" BIT_MASK 0xFFFF /end CHARACTERISTIC
/begin CHARACTERISTIC Motor_Speed_Torque_M101 "转速_最大转矩 力信 180Nm 50KW 75" CURVE 0x78661D ECTEK_Curve_u16s16 0 NO_FORMULA -5000.0 5000.0 FORMAT "%.2" BIT_MASK 0xFFFF
 /begin AXIS_DESCR STD_AXIS NO_INPUT_QUANTITY rpm1-1 21 -15000.0 15000.0 DEPOSIT ABSOLUTE FORMAT "%.2" /end AXIS_DESCR
/end CHARACTERISTIC
/begin CHARACTERISTIC Speed_Vmh10ms_Crawl_D_M101 "D档蠕动 转速-AD曲线 rpm----mh10ms" CURVE 0x786673 ECTEK_Curve_s16s16 0 Vmh10ms -500.0 500.0 FORMAT "%.2" BIT_MASK 0xFFFF
 /begin AXIS_DESCR STD_AXIS NO_INPUT_QUANTITY rpm1-1 10 -15000.0 15000.0 DEPOSIT ABSOLUTE FORMAT "%.2" /end AXIS_DESCR
/end CHARACTERISTIC
/begin CHARACTERISTIC Torque_Increment_Crawl_D_M101 "D档蠕动 AD修正转矩给定每周期增量" CURVE 0x78669D ECTEK_Curve_s16s16 0 NO_FORMULA -100.0 100.0 FORMAT "%.2" BIT_MASK 0xFFFF
 /begin AXIS_DESCR STD_AXIS NO_INPUT_QUANTITY Vmh10ms 11 -1000.0 1000.0 DEPOSIT ABSOLUTE FORMAT "%.2" /end AXIS_DESCR
/end CHARACTERISTIC
/begin CHARACTERISTIC Speed_Max_Torque_Crawl_D_M101 "D档蠕行模式最大力矩" CURVE 0x7866CB ECTEK_Curve_u16s16 0 NO_FORMULA -5000.0 5000.0 FORMAT "%.2" BIT_MASK 0xFFFF
 /begin AXIS_DESCR STD_AXIS NO_INPUT_QUANTITY rpm1-1 9 -15000.0 15000.0 DEPOSIT ABSOLUTE FORMAT "%.2" /end AXIS_DESCR
/end CHARACTERISTIC
/begin CHARACTERISTIC Speed_Max_Torque_Crawl_D_Break_M101 "D档蠕行制动状态下最大驱动力矩" CURVE 0x7866F1 ECTEK_Curve_u16s16 0 NO_FORMULA -1000.0 1000.0 FORMAT "%.2" BIT_MASK 0xFFFF
 /begin AXIS_DESCR STD_AXIS NO_INPUT_QUANTITY rpm1-1 9 -15000.0 15000.0 DEPOSIT ABSOLUTE FORMAT "%.2" /end AXIS_DESCR
/end CHARACTERISTIC
/begin CHARACTERISTIC Speed_Vmh10ms_General_M101 "通用相对转速-AD曲线 rpm----mh10ms" CURVE 0x786717 ECTEK_Curve_s16s16 0 Vmh10ms -500.0 500.0 FORMAT "%.2" BIT_MASK 0xFFFF
 /begin AXIS_DESCR STD_AXIS NO_INPUT_QUANTITY rpm1-1 11 -30000.0 30000.0 DEPOSIT ABSOLUTE FORMAT "%.2" /end AXIS_DESCR
/end CHARACTERISTIC
/begin CHARACTERISTIC Torque_Increment_General_M101 "通用AD修正转矩给定每周期增量" CURVE 0x786745 ECTEK_Curve_s16s16 0 NO_FORMULA -100.0 100.0 FORMAT "%.2" BIT_MASK 0xFFFF
 /begin AXIS_DESCR STD_AXIS NO_INPUT_QUANTITY Vmh10ms 11 -1000.0 1000.0 DEPOSIT ABSOLUTE FORMAT "%.2" /end AXIS_DESCR
/end CHARACTERISTIC
/begin CHARACTERISTIC Speed_Vmh10ms_D_Park_M101 "D档驻坡 转速-AD曲线 rpm----mh10ms" CURVE 0x786773 ECTEK_Curve_s16s16 0 Vmh10ms -500.0 500.0 FORMAT "%.2" BIT_MASK 0xFFFF
 /begin AXIS_DESCR STD_AXIS NO_INPUT_QUANTITY rpm1-1 12 -15000.0 15000.0 DEPOSIT ABSOLUTE FORMAT "%.2" /end AXIS_DESCR
/end CHARACTERISTIC
/begin CHARACTERISTIC Torque_Increment_D_Park_M101 "D档驻坡AD修正转矩给定每周期增量" CURVE 0x7867A5 ECTEK_Curve_s16s16 0 NO_FORMULA -100.0 100.0 FORMAT "%.2" BIT_MASK 0xFFFF
 /begin AXIS_DESCR STD_AXIS NO_INPUT_QUANTITY Vmh10ms 11 -1000.0 1000.0 DEPOSIT ABSOLUTE FORMAT "%.2" /end AXIS_DESCR
/end CHARACTERISTIC
/begin CHARACTERISTIC Motor_Speed_Torque_Break_M101 "电机最大制动力矩" CURVE 0x7867D3 ECTEK_Curve_s16s16 0 NO_FORMULA -5000.0 5000.0 FORMAT "%.2" BIT_MASK 0xFFFF
 /begin AXIS_DESCR STD_AXIS NO_INPUT_QUANTITY rpm1-1 14 -15000.0 15000.0 DEPOSIT ABSOLUTE FORMAT "%.2" /end AXIS_DESCR
/end CHARACTERISTIC
/begin CHARACTERISTIC FeedBack_Coast_D_Torque_M101 "D档滑行回馈 速度-力矩  定点" CURVE 0x78680D ECTEK_Curve_s16s16 0 NO_FORMULA -5000.0 5000.0 FORMAT "%.2" BIT_MASK 0xFFFF
 /begin AXIS_DESCR STD_AXIS NO_INPUT_QUANTITY rpm1-1 8 -15000.0 15000.0 DEPOSIT ABSOLUTE FORMAT "%.2" /end AXIS_DESCR
/end CHARACTERISTIC
/begin CHARACTERISTIC FeedBack_Break_D_Torque_M101 "D档制动回馈 速度-力矩 定点" CURVE 0x78682F ECTEK_Curve_s16s16 0 NO_FORMULA -5000.0 5000.0 FORMAT "%.2" BIT_MASK 0xFFFF
 /begin AXIS_DESCR STD_AXIS NO_INPUT_QUANTITY rpm1-1 8 -15000.0 15000.0 DEPOSIT ABSOLUTE FORMAT "%.2" /end AXIS_DESCR
/end CHARACTERISTIC
/begin CHARACTERISTIC Speed_Efficieny_M101 "电机速度-转换效率曲线 驱动" CURVE 0x786851 ECTEK_Curve_u16u16 0 rFactor100_PWM 0.0 100.0 FORMAT "%.2" BIT_MASK 0xFFFF
 /begin AXIS_DESCR STD_AXIS NO_INPUT_QUANTITY rpm1-1 11 0.0 15000.0 DEPOSIT ABSOLUTE FORMAT "%.2" /end AXIS_DESCR
/end CHARACTERISTIC
/begin CHARACTERISTIC Speed_Efficieny_FeedBack_M101 "电机速度-转换效率曲线 发电" CURVE 0x78687F ECTEK_Curve_u16u16 0 rFactor100_PWM 0.0 150.0 FORMAT "%.2" BIT_MASK 0xFFFF
 /begin AXIS_DESCR STD_AXIS NO_INPUT_QUANTITY rpm1-1 20 0.0 15000.0 DEPOSIT ABSOLUTE FORMAT "%.2" /end AXIS_DESCR
/end CHARACTERISTIC
/begin CHARACTERISTIC AutoPark_Motor_Speed_Torque_M101 "驻坡最大力矩" CURVE 0x7868D1 ECTEK_Curve_u16s16 0 NO_FORMULA 0.0 5000.0 FORMAT "%.2" BIT_MASK 0xFFFF
 /begin AXIS_DESCR STD_AXIS NO_INPUT_QUANTITY rpm1-1 8 -15000.0 15000.0 DEPOSIT ABSOLUTE FORMAT "%.2" /end AXIS_DESCR
/end CHARACTERISTIC
/begin CHARACTERISTIC Motor_Vehicle_Speed_Scale_M102 "转速-车速比例， D08  75.15" VALUE 0x7868F3 ECTEK_Value_u8 0 NO_FORMULA 0.0 255.0 FORMAT "%.2" BIT_MASK 0xFF /end CHARACTERISTIC
/begin CHARACTERISTIC Demand_Limit_High_M102 "转速上线  *4" VALUE 0x7868F4 ECTEK_Value_u16 0 NO_FORMULA -0.0 4095.0 FORMAT "%.2" BIT_MASK 0xFFFF /end CHARACTERISTIC
/begin CHARACTERISTIC Demand_Limit_Low_M102 "速度下限" VALUE 0x7868F6 ECTEK_Value_u16 0 NO_FORMULA -0.0 4095.0 FORMAT "%.2" BIT_MASK 0xFFFF /end CHARACTERISTIC
/begin CHARACTERISTIC Crawl_D_Speed_Max_M102 "D蠕动最大速度  从其他状态进入蠕动的速度" VALUE 0x7868F8 ECTEK_Value_u16 0 rpm1-1 -0.0 1000.0 FORMAT "%.2" BIT_MASK 0xFFFF /end CHARACTERISTIC
/begin CHARACTERISTIC Crawl_D_Torque_Delay_Max_M102 "蠕动更新间隔  单位10ms" VALUE 0x7868FA ECTEK_Value_u8 0 NO_FORMULA -0.0 255.0 FORMAT "%.2" BIT_MASK 0xFF /end CHARACTERISTIC
/begin CHARACTERISTIC Crawl_D_Torque_Delay_Start_Max_M102 "起步蠕动更新间隔  单位10ms" VALUE 0x7868FB ECTEK_Value_u8 0 NO_COMPU_METHOD -4294967296.0 4294967296.0 FORMAT "%.2" BIT_MASK 0xFF /end CHARACTERISTIC
/begin CHARACTERISTIC Speed_Buffer_Number_M102 "10ms车辆速度采样缓冲次数" VALUE 0x7868FC ECTEK_Value_u8 0 NO_FORMULA -0.0 69.0 FORMAT "%.2" BIT_MASK 0xFF /end CHARACTERISTIC
/begin CHARACTERISTIC Speed_Average_Number_M102 "10ms平均车速缓冲次数" VALUE 0x7868FD ECTEK_Value_u8 0 NO_FORMULA -0.0 69.0 FORMAT "%.2" BIT_MASK 0xFF /end CHARACTERISTIC
/begin CHARACTERISTIC Torque_Buffer_Number_AutoPark_M102 "10ms平均转矩缓冲次数" VALUE 0x7868FE ECTEK_Value_u8 0 NO_FORMULA -0.0 69.0 FORMAT "%.2" BIT_MASK 0xFF /end CHARACTERISTIC
/begin CHARACTERISTIC D_Park_Start_Speed_M102 "D驻坡触发转速" VALUE 0x7868FF ECTEK_Value_u8 0 rpm1-1 -0.0 255.0 FORMAT "%.2" BIT_MASK 0xFF /end CHARACTERISTIC
/begin CHARACTERISTIC Auto_Park_Speed_Acc_Max_M102 "激活D驻坡最大退行转速累加" VALUE 0x786900 ECTEK_Value_s16 0 NO_FORMULA -32767.0 32768.0 FORMAT "%.2" BIT_MASK 0xFFFF /end CHARACTERISTIC
/begin CHARACTERISTIC Auto_Park_Speed_Times_Max_M102 "激活D驻坡最大退行增速时间 单位10ms" VALUE 0x786902 ECTEK_Value_u16 0 NO_FORMULA -0.0 65535.0 FORMAT "%.2" BIT_MASK 0xFFFF /end CHARACTERISTIC
/begin CHARACTERISTIC Auto_Torque_Min_M102 "自动转矩最小正值" VALUE 0x786904 ECTEK_Value_s16 0 NO_FORMULA 0.0 150.0 FORMAT "%.2" BIT_MASK 0xFFFF /end CHARACTERISTIC
/begin CHARACTERISTIC Auto_Torque_Max_M102 "自动转矩最大负值" VALUE 0x786906 ECTEK_Value_s16 0 NO_FORMULA -150.0 0.0 FORMAT "%.2" BIT_MASK 0xFFFF /end CHARACTERISTIC
/begin CHARACTERISTIC R_Vhms_Average_Ratio_M102 "R档Vhms平均值缓冲比例" VALUE 0x786908 ECTEK_Value_u16 0 NO_FORMULA 1.0 500.0 FORMAT "%.2" BIT_MASK 0xFFFF /end CHARACTERISTIC
/begin CHARACTERISTIC D_Vhms_Average_Ratio_M102 "D档Vhms平均值缓冲比例" VALUE 0x78690A ECTEK_Value_u16 0 NO_FORMULA 1.0 500.0 FORMAT "%.2" BIT_MASK 0xFFFF /end CHARACTERISTIC
/begin CHARACTERISTIC Motor_Speed_Torque_M102 "转速_最大转矩 力信 180Nm 50KW 75" CURVE 0x78690C ECTEK_Curve_u16s16 0 NO_FORMULA -5000.0 5000.0 FORMAT "%.2" BIT_MASK 0xFFFF
 /begin AXIS_DESCR STD_AXIS NO_INPUT_QUANTITY rpm1-1 28 -15000.0 15000.0 DEPOSIT ABSOLUTE FORMAT "%.2" /end AXIS_DESCR
/end CHARACTERISTIC
/begin CHARACTERISTIC Speed_Vmh10ms_Crawl_D_M102 "D档蠕动 转速-AD曲线 rpm----mh10ms" CURVE 0x78697E ECTEK_Curve_s16s16 0 Vmh10ms -500.0 500.0 FORMAT "%.2" BIT_MASK 0xFFFF
 /begin AXIS_DESCR STD_AXIS NO_INPUT_QUANTITY rpm1-1 10 -15000.0 15000.0 DEPOSIT ABSOLUTE FORMAT "%.2" /end AXIS_DESCR
/end CHARACTERISTIC
/begin CHARACTERISTIC Torque_Increment_Crawl_D_M102 "D档蠕动 AD修正转矩给定每周期增量" CURVE 0x7869A8 ECTEK_Curve_s16s16 0 NO_FORMULA -100.0 100.0 FORMAT "%.2" BIT_MASK 0xFFFF
 /begin AXIS_DESCR STD_AXIS NO_INPUT_QUANTITY Vmh10ms 11 -1000.0 1000.0 DEPOSIT ABSOLUTE FORMAT "%.2" /end AXIS_DESCR
/end CHARACTERISTIC
/begin CHARACTERISTIC Speed_Max_Torque_Crawl_D_M102 "D档蠕行模式最大力矩" CURVE 0x7869D6 ECTEK_Curve_u16s16 0 NO_FORMULA -5000.0 5000.0 FORMAT "%.2" BIT_MASK 0xFFFF
 /begin AXIS_DESCR STD_AXIS NO_INPUT_QUANTITY rpm1-1 9 -15000.0 15000.0 DEPOSIT ABSOLUTE FORMAT "%.2" /end AXIS_DESCR
/end CHARACTERISTIC
/begin CHARACTERISTIC Speed_Max_Torque_Crawl_D_Break_M102 "D档蠕行制动状态下最大驱动力矩" CURVE 0x7869FC ECTEK_Curve_u16s16 0 NO_FORMULA -1000.0 1000.0 FORMAT "%.2" BIT_MASK 0xFFFF
 /begin AXIS_DESCR STD_AXIS NO_INPUT_QUANTITY rpm1-1 9 -15000.0 15000.0 DEPOSIT ABSOLUTE FORMAT "%.2" /end AXIS_DESCR
/end CHARACTERISTIC
/begin CHARACTERISTIC Speed_Vmh10ms_General_M102 "通用相对转速-AD曲线 rpm----mh10ms" CURVE 0x786A22 ECTEK_Curve_s16s16 0 Vmh10ms -500.0 500.0 FORMAT "%.2" BIT_MASK 0xFFFF
 /begin AXIS_DESCR STD_AXIS NO_INPUT_QUANTITY rpm1-1 11 -30000.0 30000.0 DEPOSIT ABSOLUTE FORMAT "%.2" /end AXIS_DESCR
/end CHARACTERISTIC
/begin CHARACTERISTIC Torque_Increment_General_M102 "通用AD修正转矩给定每周期增量" CURVE 0x786A50 ECTEK_Curve_s16s16 0 NO_FORMULA -100.0 100.0 FORMAT "%.2" BIT_MASK 0xFFFF
 /begin AXIS_DESCR STD_AXIS NO_INPUT_QUANTITY Vmh10ms 11 -1000.0 1000.0 DEPOSIT ABSOLUTE FORMAT "%.2" /end AXIS_DESCR
/end CHARACTERISTIC
/begin CHARACTERISTIC Speed_Vmh10ms_D_Park_M102 "D档驻坡 转速-AD曲线 rpm----mh10ms" CURVE 0x786A7E ECTEK_Curve_s16s16 0 Vmh10ms -500.0 500.0 FORMAT "%.2" BIT_MASK 0xFFFF
 /begin AXIS_DESCR STD_AXIS NO_INPUT_QUANTITY rpm1-1 12 -15000.0 15000.0 DEPOSIT ABSOLUTE FORMAT "%.2" /end AXIS_DESCR
/end CHARACTERISTIC
/begin CHARACTERISTIC Torque_Increment_D_Park_M102 "D档驻坡AD修正转矩给定每周期增量" CURVE 0x786AB0 ECTEK_Curve_s16s16 0 NO_FORMULA -100.0 100.0 FORMAT "%.2" BIT_MASK 0xFFFF
 /begin AXIS_DESCR STD_AXIS NO_INPUT_QUANTITY Vmh10ms 11 -1000.0 1000.0 DEPOSIT ABSOLUTE FORMAT "%.2" /end AXIS_DESCR
/end CHARACTERISTIC
/begin CHARACTERISTIC Motor_Speed_Torque_Break_M102 "电机最大制动力矩" CURVE 0x786ADE ECTEK_Curve_s16s16 0 NO_FORMULA -5000.0 5000.0 FORMAT "%.2" BIT_MASK 0xFFFF
 /begin AXIS_DESCR STD_AXIS NO_INPUT_QUANTITY rpm1-1 14 -15000.0 15000.0 DEPOSIT ABSOLUTE FORMAT "%.2" /end AXIS_DESCR
/end CHARACTERISTIC
/begin CHARACTERISTIC FeedBack_Coast_D_Torque_M102 "D档滑行回馈 速度-力矩  定点" CURVE 0x786B18 ECTEK_Curve_s16s16 0 NO_FORMULA -5000.0 5000.0 FORMAT "%.2" BIT_MASK 0xFFFF
 /begin AXIS_DESCR STD_AXIS NO_INPUT_QUANTITY rpm1-1 8 -15000.0 15000.0 DEPOSIT ABSOLUTE FORMAT "%.2" /end AXIS_DESCR
/end CHARACTERISTIC
/begin CHARACTERISTIC FeedBack_Break_D_Torque_M102 "D档制动回馈 速度-力矩 定点" CURVE 0x786B3A ECTEK_Curve_s16s16 0 NO_FORMULA -5000.0 5000.0 FORMAT "%.2" BIT_MASK 0xFFFF
 /begin AXIS_DESCR STD_AXIS NO_INPUT_QUANTITY rpm1-1 8 -15000.0 15000.0 DEPOSIT ABSOLUTE FORMAT "%.2" /end AXIS_DESCR
/end CHARACTERISTIC
/begin CHARACTERISTIC Speed_Efficieny_M102 "电机速度-转换效率曲线 驱动" CURVE 0x786B5C ECTEK_Curve_u16u16 0 rFactor100_PWM 0.0 100.0 FORMAT "%.2" BIT_MASK 0xFFFF
 /begin AXIS_DESCR STD_AXIS NO_INPUT_QUANTITY rpm1-1 20 0.0 15000.0 DEPOSIT ABSOLUTE FORMAT "%.2" /end AXIS_DESCR
/end CHARACTERISTIC
/begin CHARACTERISTIC Speed_Efficieny_FeedBack_M102 "电机速度-转换效率曲线 发电" CURVE 0x786BAE ECTEK_Curve_u16u16 0 rFactor100_PWM 0.0 150.0 FORMAT "%.2" BIT_MASK 0xFFFF
 /begin AXIS_DESCR STD_AXIS NO_INPUT_QUANTITY rpm1-1 20 0.0 15000.0 DEPOSIT ABSOLUTE FORMAT "%.2" /end AXIS_DESCR
/end CHARACTERISTIC
/begin CHARACTERISTIC AutoPark_Motor_Speed_Torque_M102 "驻坡最大力矩" CURVE 0x786C00 ECTEK_Curve_u16s16 0 NO_FORMULA 0.0 5000.0 FORMAT "%.2" BIT_MASK 0xFFFF
 /begin AXIS_DESCR STD_AXIS NO_INPUT_QUANTITY rpm1-1 8 -15000.0 15000.0 DEPOSIT ABSOLUTE FORMAT "%.2" /end AXIS_DESCR
/end CHARACTERISTIC
/begin CHARACTERISTIC Motor_Vehicle_Speed_Scale_M11 "转速-车速比例， 优优114.411   D11 36.632   D07  62.111  A9 95.064 D07L 68.836   70 7.66后桥" VALUE 0x786C22 ECTEK_Value_u8 0 NO_FORMULA 0.0 255.0 FORMAT "%.2" BIT_MASK 0xFF /end CHARACTERISTIC
/begin CHARACTERISTIC Demand_Limit_High_M11 "转速上线  *4" VALUE 0x786C23 ECTEK_Value_u16 0 NO_FORMULA -0.0 4095.0 FORMAT "%.2" BIT_MASK 0xFFFF /end CHARACTERISTIC
/begin CHARACTERISTIC Demand_Limit_Low_M11 "速度下限" VALUE 0x786C25 ECTEK_Value_u16 0 NO_FORMULA -0.0 4095.0 FORMAT "%.2" BIT_MASK 0xFFFF /end CHARACTERISTIC
/begin CHARACTERISTIC Crawl_D_Speed_Max_M11 "D蠕动最大速度  从其他状态进入蠕动的速度" VALUE 0x786C27 ECTEK_Value_u16 0 rpm1-1 -0.0 1000.0 FORMAT "%.2" BIT_MASK 0xFFFF /end CHARACTERISTIC
/begin CHARACTERISTIC Crawl_D_Torque_Delay_Max_M11 "蠕动更新间隔  单位10ms" VALUE 0x786C29 ECTEK_Value_u8 0 NO_FORMULA -0.0 255.0 FORMAT "%.2" BIT_MASK 0xFF /end CHARACTERISTIC
/begin CHARACTERISTIC Crawl_D_Torque_Delay_Start_Max_M11 "起步蠕动更新间隔  单位10ms" VALUE 0x786C2A ECTEK_Value_u8 0 NO_COMPU_METHOD -4294967296.0 4294967296.0 FORMAT "%.2" BIT_MASK 0xFF /end CHARACTERISTIC
/begin CHARACTERISTIC Speed_Buffer_Number_M11 "10ms车辆速度采样缓冲次数" VALUE 0x786C2B ECTEK_Value_u8 0 NO_FORMULA 1.0 69.0 FORMAT "%.2" BIT_MASK 0xFF /end CHARACTERISTIC
/begin CHARACTERISTIC Speed_Average_Number_M11 "10ms平均车速缓冲次数" VALUE 0x786C2C ECTEK_Value_u8 0 NO_FORMULA 1.0 69.0 FORMAT "%.2" BIT_MASK 0xFF /end CHARACTERISTIC
/begin CHARACTERISTIC Torque_Buffer_Number_AutoPark_M11 "10ms平均转矩缓冲次数" VALUE 0x786C2D ECTEK_Value_u8 0 NO_FORMULA -0.0 69.0 FORMAT "%.2" BIT_MASK 0xFF /end CHARACTERISTIC
/begin CHARACTERISTIC D_Park_Start_Speed_M11 "D驻坡触发转速" VALUE 0x786C2E ECTEK_Value_u8 0 rpm1-1 -0.0 255.0 FORMAT "%.2" BIT_MASK 0xFF /end CHARACTERISTIC
/begin CHARACTERISTIC Auto_Park_Speed_Acc_Max_M11 "激活D驻坡最大退行转速累加" VALUE 0x786C2F ECTEK_Value_s16 0 NO_FORMULA -32767.0 32768.0 FORMAT "%.2" BIT_MASK 0xFFFF /end CHARACTERISTIC
/begin CHARACTERISTIC Auto_Park_Speed_Times_Max_M11 "激活D驻坡最大退行增速时间 单位10ms" VALUE 0x786C31 ECTEK_Value_u16 0 NO_FORMULA -0.0 65535.0 FORMAT "%.2" BIT_MASK 0xFFFF /end CHARACTERISTIC
/begin CHARACTERISTIC Auto_Torque_Min_M11 "自动转矩最小正值" VALUE 0x786C33 ECTEK_Value_s16 0 NO_FORMULA 0.0 150.0 FORMAT "%.2" BIT_MASK 0xFFFF /end CHARACTERISTIC
/begin CHARACTERISTIC Auto_Torque_Max_M11 "自动转矩最大负值" VALUE 0x786C35 ECTEK_Value_s16 0 NO_FORMULA -150.0 0.0 FORMAT "%.2" BIT_MASK 0xFFFF /end CHARACTERISTIC
/begin CHARACTERISTIC R_Vhms_Average_Ratio_M11 "R档Vhms平均值缓冲比例" VALUE 0x786C37 ECTEK_Value_u16 0 NO_FORMULA 1.0 500.0 FORMAT "%.2" BIT_MASK 0xFFFF /end CHARACTERISTIC
/begin CHARACTERISTIC D_Vhms_Average_Ratio_M11 "D档Vhms平均值缓冲比例" VALUE 0x786C39 ECTEK_Value_u16 0 NO_FORMULA 1.0 500.0 FORMAT "%.2" BIT_MASK 0xFFFF /end CHARACTERISTIC
/begin CHARACTERISTIC Motor_Speed_Torque_M11 "转速_最大转矩 大地和 30KW 150N   95" CURVE 0x786C3B ECTEK_Curve_u16s16 0 NO_FORMULA -5000.0 5000.0 FORMAT "%.2" BIT_MASK 0xFFFF
 /begin AXIS_DESCR STD_AXIS NO_INPUT_QUANTITY rpm1-1 26 -15000.0 15000.0 DEPOSIT ABSOLUTE FORMAT "%.2" /end AXIS_DESCR
/end CHARACTERISTIC
/begin CHARACTERISTIC AccPed_Rip_M11 "油门曲线" CURVE 0x786CA5 ECTEK_Curve_u16u16 0 rFactor100_PWM -0.0 100.0 FORMAT "%.2" BIT_MASK 0xFFFF
 /begin AXIS_DESCR STD_AXIS NO_INPUT_QUANTITY rFactor100_PWM 11 -0.0 100.0 DEPOSIT ABSOLUTE FORMAT "%.2" /end AXIS_DESCR
/end CHARACTERISTIC
/begin CHARACTERISTIC Speed_Vmh10ms_Crawl_D_M11 "D档蠕动 转速-AD曲线 rpm----mh10ms" CURVE 0x786CD3 ECTEK_Curve_s16s16 0 Vmh10ms -500.0 500.0 FORMAT "%.2" BIT_MASK 0xFFFF
 /begin AXIS_DESCR STD_AXIS NO_INPUT_QUANTITY rpm1-1 10 -15000.0 15000.0 DEPOSIT ABSOLUTE FORMAT "%.2" /end AXIS_DESCR
/end CHARACTERISTIC
/begin CHARACTERISTIC Torque_Increment_Crawl_D_M11 "D档蠕动 AD修正转矩给定每周期增量" CURVE 0x786CFD ECTEK_Curve_s16s16 0 NO_FORMULA -100.0 100.0 FORMAT "%.2" BIT_MASK 0xFFFF
 /begin AXIS_DESCR STD_AXIS NO_INPUT_QUANTITY Vmh10ms 11 -1000.0 1000.0 DEPOSIT ABSOLUTE FORMAT "%.2" /end AXIS_DESCR
/end CHARACTERISTIC
/begin CHARACTERISTIC Speed_Max_Torque_Crawl_D_M11 "D档蠕行模式最大力矩" CURVE 0x786D2B ECTEK_Curve_u16s16 0 NO_FORMULA -5000.0 5000.0 FORMAT "%.2" BIT_MASK 0xFFFF
 /begin AXIS_DESCR STD_AXIS NO_INPUT_QUANTITY rpm1-1 9 -15000.0 15000.0 DEPOSIT ABSOLUTE FORMAT "%.2" /end AXIS_DESCR
/end CHARACTERISTIC
/begin CHARACTERISTIC Speed_Max_Torque_Crawl_D_Break_M11 "D档蠕行制动状态下最大驱动力矩" CURVE 0x786D51 ECTEK_Curve_u16s16 0 NO_FORMULA -1000.0 1000.0 FORMAT "%.2" BIT_MASK 0xFFFF
 /begin AXIS_DESCR STD_AXIS NO_INPUT_QUANTITY rpm1-1 9 -15000.0 15000.0 DEPOSIT ABSOLUTE FORMAT "%.2" /end AXIS_DESCR
/end CHARACTERISTIC
/begin CHARACTERISTIC Speed_Vmh10ms_General_M11 "通用相对转速-AD曲线 rpm----mh10ms" CURVE 0x786D77 ECTEK_Curve_s16s16 0 Vmh10ms -500.0 500.0 FORMAT "%.2" BIT_MASK 0xFFFF
 /begin AXIS_DESCR STD_AXIS NO_INPUT_QUANTITY rpm1-1 11 -30000.0 30000.0 DEPOSIT ABSOLUTE FORMAT "%.2" /end AXIS_DESCR
/end CHARACTERISTIC
/begin CHARACTERISTIC Torque_Increment_General_M11 "通用AD修正转矩给定每周期增量" CURVE 0x786DA5 ECTEK_Curve_s16s16 0 NO_FORMULA -100.0 100.0 FORMAT "%.2" BIT_MASK 0xFFFF
 /begin AXIS_DESCR STD_AXIS NO_INPUT_QUANTITY Vmh10ms 11 -1000.0 1000.0 DEPOSIT ABSOLUTE FORMAT "%.2" /end AXIS_DESCR
/end CHARACTERISTIC
/begin CHARACTERISTIC Speed_Vmh10ms_D_Park_M11 "D档驻坡 转速-AD曲线 rpm----mh10ms" CURVE 0x786DD3 ECTEK_Curve_s16s16 0 Vmh10ms -500.0 500.0 FORMAT "%.2" BIT_MASK 0xFFFF
 /begin AXIS_DESCR STD_AXIS NO_INPUT_QUANTITY rpm1-1 12 -15000.0 15000.0 DEPOSIT ABSOLUTE FORMAT "%.2" /end AXIS_DESCR
/end CHARACTERISTIC
/begin CHARACTERISTIC Torque_Increment_D_Park_M11 "D档驻坡AD修正转矩给定每周期增量" CURVE 0x786E05 ECTEK_Curve_s16s16 0 NO_FORMULA -100.0 100.0 FORMAT "%.2" BIT_MASK 0xFFFF
 /begin AXIS_DESCR STD_AXIS NO_INPUT_QUANTITY Vmh10ms 11 -1000.0 1000.0 DEPOSIT ABSOLUTE FORMAT "%.2" /end AXIS_DESCR
/end CHARACTERISTIC
/begin CHARACTERISTIC Motor_Speed_Torque_Break_M11 "电机最大制动力矩" CURVE 0x786E33 ECTEK_Curve_s16s16 0 NO_FORMULA -5000.0 5000.0 FORMAT "%.2" BIT_MASK 0xFFFF
 /begin AXIS_DESCR STD_AXIS NO_INPUT_QUANTITY rpm1-1 14 -15000.0 15000.0 DEPOSIT ABSOLUTE FORMAT "%.2" /end AXIS_DESCR
/end CHARACTERISTIC
/begin CHARACTERISTIC FeedBack_Coast_D_Torque_M11 "D档滑行回馈 速度-力矩  定点" CURVE 0x786E6D ECTEK_Curve_s16s16 0 NO_FORMULA -5000.0 5000.0 FORMAT "%.2" BIT_MASK 0xFFFF
 /begin AXIS_DESCR STD_AXIS NO_INPUT_QUANTITY rpm1-1 8 -15000.0 15000.0 DEPOSIT ABSOLUTE FORMAT "%.2" /end AXIS_DESCR
/end CHARACTERISTIC
/begin CHARACTERISTIC FeedBack_Break_D_Torque_M11 "D档制动回馈 速度-力矩 定点" CURVE 0x786E8F ECTEK_Curve_s16s16 0 NO_FORMULA -5000.0 5000.0 FORMAT "%.2" BIT_MASK 0xFFFF
 /begin AXIS_DESCR STD_AXIS NO_INPUT_QUANTITY rpm1-1 8 -15000.0 15000.0 DEPOSIT ABSOLUTE FORMAT "%.2" /end AXIS_DESCR
/end CHARACTERISTIC
/begin CHARACTERISTIC Speed_Efficieny_M11 "电机速度-转换效率曲线 驱动" CURVE 0x786EB1 ECTEK_Curve_u16u16 0 rFactor100_PWM 0.0 100.0 FORMAT "%.2" BIT_MASK 0xFFFF
 /begin AXIS_DESCR STD_AXIS NO_INPUT_QUANTITY rpm1-1 20 0.0 15000.0 DEPOSIT ABSOLUTE FORMAT "%.2" /end AXIS_DESCR
/end CHARACTERISTIC
/begin CHARACTERISTIC Speed_Efficieny_FeedBack_M11 "电机速度-转换效率曲线 发电" CURVE 0x786F03 ECTEK_Curve_u16u16 0 rFactor100_PWM 0.0 150.0 FORMAT "%.2" BIT_MASK 0xFFFF
 /begin AXIS_DESCR STD_AXIS NO_INPUT_QUANTITY rpm1-1 20 0.0 15000.0 DEPOSIT ABSOLUTE FORMAT "%.2" /end AXIS_DESCR
/end CHARACTERISTIC
/begin CHARACTERISTIC AutoPark_Motor_Speed_Torque_M11 "驻坡最大力矩" CURVE 0x786F55 ECTEK_Curve_u16s16 0 NO_FORMULA 0.0 5000.0 FORMAT "%.2" BIT_MASK 0xFFFF
 /begin AXIS_DESCR STD_AXIS NO_INPUT_QUANTITY rpm1-1 8 -15000.0 15000.0 DEPOSIT ABSOLUTE FORMAT "%.2" /end AXIS_DESCR
/end CHARACTERISTIC
/begin CHARACTERISTIC AccPedCD_rUW_CUR_M11 "油门开度" CURVE 0x786F77 ECTEK_Curve_u16u16 0 rFactor100_PWM 0.0 100.0 FORMAT "%.2" BIT_MASK 0xFFFF
 /begin AXIS_DESCR STD_AXIS NO_INPUT_QUANTITY u5V 7 0.0 5.0 DEPOSIT ABSOLUTE FORMAT "%.2" /end AXIS_DESCR
/end CHARACTERISTIC
/begin CHARACTERISTIC AccPedCD_rUW_CUR2_M11 "油门2开度" CURVE 0x786F95 ECTEK_Curve_u16u16 0 rFactor100_PWM 0.0 100.0 FORMAT "%.2" BIT_MASK 0xFFFF
 /begin AXIS_DESCR STD_AXIS NO_INPUT_QUANTITY u5V 7 0.0 5.0 DEPOSIT ABSOLUTE FORMAT "%.2" /end AXIS_DESCR
/end CHARACTERISTIC
/begin CHARACTERISTIC AC_Condenser_Temp_M11 "空调蒸发器温度 上拉100K 下拉10K" CURVE 0x786FB3 ECTEK_Curve_s16u16 0 Temp -100.0 150.0 FORMAT "%.2" BIT_MASK 0xFFFF
 /begin AXIS_DESCR STD_AXIS NO_INPUT_QUANTITY NO_FORMULA 31 0.0 4095.0 DEPOSIT ABSOLUTE FORMAT "%.2" /end AXIS_DESCR
/end CHARACTERISTIC
/begin CHARACTERISTIC AC_Condenser_Temp_M11_ACES "空调蒸发器温度_奥易克斯 上拉2.74K 下拉500K" CURVE 0x787031 ECTEK_Curve_s16u16 0 Temp -100.0 150.0 FORMAT "%.2" BIT_MASK 0xFFFF
 /begin AXIS_DESCR STD_AXIS NO_INPUT_QUANTITY NO_FORMULA 29 0.0 4095.0 DEPOSIT ABSOLUTE FORMAT "%.2" /end AXIS_DESCR
/end CHARACTERISTIC
/begin CHARACTERISTIC INS_Scale "临时仪表类型速比 程序内部已经除100" VALUE 0x7870A7 ECTEK_Value_u8 0 NO_FORMULA 1.0 255.0 FORMAT "%.2" BIT_MASK 0xFF /end CHARACTERISTIC
/begin RECORD_LAYOUT ECTEK_Value_u16 FNC_VALUES 1 UWORD ROW_DIR DIRECT ALIGNMENT_BYTE 1 ALIGNMENT_WORD 1 ALIGNMENT_LONG 1 ALIGNMENT_FLOAT32_IEEE 1 ALIGNMENT_FLOAT64_IEEE 1 /end RECORD_LAYOUT
/begin RECORD_LAYOUT ECTEK_Value_u8 FNC_VALUES 1 UBYTE ROW_DIR DIRECT ALIGNMENT_BYTE 1 ALIGNMENT_WORD 1 ALIGNMENT_LONG 1 ALIGNMENT_FLOAT32_IEEE 1 ALIGNMENT_FLOAT64_IEEE 1 /end RECORD_LAYOUT
/begin RECORD_LAYOUT ECTEK_Value_u32 FNC_VALUES 1 ULONG ROW_DIR DIRECT ALIGNMENT_BYTE 1 ALIGNMENT_WORD 1 ALIGNMENT_LONG 1 ALIGNMENT_FLOAT32_IEEE 1 ALIGNMENT_FLOAT64_IEEE 1 /end RECORD_LAYOUT
/begin RECORD_LAYOUT ECTEK_Curve_u16u16 FNC_VALUES 3 UWORD ROW_DIR DIRECT AXIS_PTS_X 2 UWORD INDEX_INCR DIRECT NO_AXIS_PTS_X 1 UWORD ALIGNMENT_BYTE 1 ALIGNMENT_WORD 1 ALIGNMENT_LONG 1 ALIGNMENT_FLOAT32_IEEE 1 ALIGNMENT_FLOAT64_IEEE 1 /end RECORD_LAYOUT
/begin RECORD_LAYOUT ECTEK_Value_s16 FNC_VALUES 1 SWORD ROW_DIR DIRECT ALIGNMENT_BYTE 1 ALIGNMENT_WORD 1 ALIGNMENT_LONG 1 ALIGNMENT_FLOAT32_IEEE 1 ALIGNMENT_FLOAT64_IEEE 1 /end RECORD_LAYOUT
/begin RECORD_LAYOUT ECTEK_Curve_u16s16 FNC_VALUES 3 UWORD ROW_DIR DIRECT AXIS_PTS_X 2 SWORD INDEX_INCR DIRECT NO_AXIS_PTS_X 1 UWORD ALIGNMENT_BYTE 1 ALIGNMENT_WORD 1 ALIGNMENT_LONG 1 ALIGNMENT_FLOAT32_IEEE 1 ALIGNMENT_FLOAT64_IEEE 1 /end RECORD_LAYOUT
/begin RECORD_LAYOUT ECTEK_Curve_s16s16 FNC_VALUES 3 SWORD ROW_DIR DIRECT AXIS_PTS_X 2 SWORD INDEX_INCR DIRECT NO_AXIS_PTS_X 1 UWORD ALIGNMENT_BYTE 1 ALIGNMENT_WORD 1 ALIGNMENT_LONG 1 ALIGNMENT_FLOAT32_IEEE 1 ALIGNMENT_FLOAT64_IEEE 1 /end RECORD_LAYOUT
/begin RECORD_LAYOUT ECTEK_Value_s8 FNC_VALUES 1 SBYTE ROW_DIR DIRECT ALIGNMENT_BYTE 1 ALIGNMENT_WORD 1 ALIGNMENT_LONG 1 ALIGNMENT_FLOAT32_IEEE 1 ALIGNMENT_FLOAT64_IEEE 1 /end RECORD_LAYOUT
/begin RECORD_LAYOUT ECTEK_Curve_s16u16 FNC_VALUES 3 SWORD ROW_DIR DIRECT AXIS_PTS_X 2 UWORD INDEX_INCR DIRECT NO_AXIS_PTS_X 1 UWORD ALIGNMENT_BYTE 1 ALIGNMENT_WORD 1 ALIGNMENT_LONG 1 ALIGNMENT_FLOAT32_IEEE 1 ALIGNMENT_FLOAT64_IEEE 1 /end RECORD_LAYOUT
/end MODULE
/end PROJECT
