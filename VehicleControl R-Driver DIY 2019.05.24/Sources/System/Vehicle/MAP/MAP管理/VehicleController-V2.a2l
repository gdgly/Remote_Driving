ASAP2_VERSION 1 51
/begin PROJECT EUP ""
/begin MODULE CPP ""
/begin MOD_COMMON "" BYTE_ORDER MSB_FIRST ALIGNMENT_BYTE 1 ALIGNMENT_WORD 2 ALIGNMENT_LONG 4 ALIGNMENT_FLOAT32_IEEE 4 ALIGNMENT_FLOAT64_IEEE 8 /end MOD_COMMON
/begin COMPU_VTAB bCondition "" TAB_VERB 2 0 "否(No)" 1 "是(Yes)" DEFAULT_VALUE "0" /end COMPU_VTAB
/begin COMPU_VTAB idxAccPedType "油门类型" TAB_VERB 4 0 "不配备(Without)" 1 "双油门(Dual Analog)" 2 "带怠速开关(With Idle Switch)" 3 "单油门(Single Analog)" /end COMPU_VTAB
/begin COMPU_VTAB idxEdgeType "边沿捕捉" TAB_VERB 4 0 "不捕捉(None)" 1 "上升沿(Rising Edge)" 2 "下降沿(Falling Edge)" 3 "所有边沿(All)" DEFAULT_VALUE "0" /end COMPU_VTAB
/begin COMPU_VTAB idxManualResetType "" TAB_VERB 15 0 "非自动复位(Not Manual)" 1 "RAM测试(RAM Test Err)" 10 "PLL丢失同步(PLL Lost)" 11 "CRG时钟错误(CRG Err)" 12 "PIT时钟错误(PIT Err)" 20 "EEPROM ACCERR错误(EEPROM ACCERR)" 21 "EEPROM GSTAT错误(EEPROM GSTAT)" 22 "EEPROM Partition错误(EEPROM Parition Err)" 23 "Flash双位错误(Flash DoubleBit Err)" 30 "KWP2000复位(KWP2000 Reset)" 31 "Flash编程复位(FlashProgram Reset)" 40 "ATD队列错误(ATD Queue Err)" 50 "不可识别中断源(Unimplemented)" 60 "XGATE软件错误(XGATE Software Err)" 70 "MPU错误(MPU Err)" DEFAULT_VALUE "0" /end COMPU_VTAB
/begin COMPU_VTAB idxResetType "" TAB_VERB 7 1 "上电复位(PowerUp)" 2 "低电压(LowVoltage)" 3 "时钟(ClockMonitor)" 4 "看门狗(WatchDog)" 5 "非法地址(IllegalAddress)" 6 "系统复位(SystemReset)" 7 "不可识别(Unimplemented)" /end COMPU_VTAB
/begin COMPU_VTAB idxSwitchType "开关类型" TAB_VERB 4 0 "接电源常开(Power Open)" 1 "接电源常闭(Power Close)" 2 "接地常开(Ground Open)" 3 "接地常闭(Ground Close)" DEFAULT_VALUE "0" /end COMPU_VTAB
/begin COMPU_VTAB idxTriggerType "" TAB_VERB 10 0 "AlwaysTrue" 1 "NoTrigger" 2 "Time" 3 "WarmUpCycle" 4 "DrivingCycleFLC" 5 "DrivingCycleHLC" 6 "SimilarCondition" 7 "Project1" 8 "Project2" 9 "OneHour" DEFAULT_VALUE "1" /end COMPU_VTAB
/begin COMPU_VTAB idxVREGAcq "" TAB_VERB 3 0 "不采集(None)" 1 "采集CPU温度(CPU Temperature Acq)" 2 "采集1.2V参考电压(1.2V Acq)" /end COMPU_VTAB
/begin COMPU_VTAB stCamshaft "" TAB_VERB 5 1 "Cam_NoCrk" 2 "Cam_Search" 4 "Cam_Verify" 8 "Cam_Switchoff" 16 "Cam_Diag" /end COMPU_VTAB
/begin COMPU_VTAB stCrankshaft "" TAB_VERB 7 0 "Crk_Init" 4 "Crk_OneTooth" 5 "Crk_MatchTooth" 6 "Crk_WaitForSyn" 8 "Crk_Syn" 10 "Crk_Tooth" 11 "Crk_LastTooth" /end COMPU_VTAB
/begin COMPU_VTAB stDFC "" TAB_VERB 5 0 "诊断未开始(None)" 1 "部分错误(Preliminary Err)" 2 "完全错误(Err)" 3 "部分正常(Preliminary Heal)" 4 "完全正常(Heal)" /end COMPU_VTAB
/begin COMPU_VTAB stEGRRationSetPointRampState "EGR控制目标开度ramp状态" TAB_VERB 3 0 "PT1" 1 "PosRamp" 2 "NegRamp" /end COMPU_VTAB
/begin COMPU_VTAB stEngErrLim "" TAB_VERB 5 0 "没有限制(None)" 1 "90%功率限制(90% Limit)" 2 "85%功率限制(85% Limit)" 4 "80%功率限制(80% Limit)" 8 "70%功率限制(70% Limit)" DEFAULT_VALUE "0" /end COMPU_VTAB
/begin COMPU_VTAB stEngFuelLim "" TAB_VERB 6 0 "无限制(None)" 1 "冒烟限制(Air System Limit)" 2 "发动机保护限制(Engine Protect Limit)" 4 "发动机故障限制(Engine Err Limit)" 8 "最大油量限制(Fuel System Max Limit)" 16 "最小油量限制(Fuel System Min Limit)" DEFAULT_VALUE "0" /end COMPU_VTAB
/begin COMPU_VTAB stEngPrtLim "" TAB_VERB 3 0 "没有限制(None)" 1 "发动机过热保护(OverHeat Protect)" 2 "发动机机械保护(Mechanic Protect)" DEFAULT_VALUE "0" /end COMPU_VTAB
/begin COMPU_VTAB stEngine "" TAB_VERB 7 0 "初始化(Eng_Init)" 1 "停机(Eng_StandBy)" 2 "等待起动(Eng_Ready)" 3 "起动(Eng_Cranking)" 4 "正常运转(Eng_Running)" 5 "Eng_Stopping" 6 "Eng_Finish" /end COMPU_VTAB
/begin COMPU_VTAB stEpm "" TAB_VERB 4 0 "没有同步(Epm_NoSyn)" 2 "凸轮轴同步(Epm_CamSyn)" 8 "曲轴同步(Epm_CrkSyn)" 32 "完全同步(Epm_FullSyn)" /end COMPU_VTAB
/begin COMPU_VTAB stHIGovIFreeze "高怠速I冻结转速状态" TAB_VERB 2 0 "转速低于起始转速" 1 "转速大于或等于起始转速" /end COMPU_VTAB
/begin COMPU_VTAB stInjection "" TAB_VERB 6 0 "Inj_Wait" 1 "Inj_Verify" 2 "Inj_OK" 4 "Inj_BackCrk" 8 "Inj_BackCam" 16 "Inj_Err" /end COMPU_VTAB
/begin COMPU_VTAB stLIGovPreDef "低怠速前馈油量锁状态" TAB_VERB 2 0 "锁(Lock)" 1 "解锁(Unlock)" /end COMPU_VTAB
/begin COMPU_VTAB stLowIdleSetPoint "" TAB_VERB 5 1 "蓄电池电压低怠速(Battery Voltage Low)" 2 "空调怠速(Air Condition)" 4 "油门踏板故障怠速(Accped Defect)" 8 "水温怠速(Coolant)" 16 "档位怠速(Gear)" DEFAULT_VALUE "8" /end COMPU_VTAB
/begin COMPU_VTAB stMechPrtLim "" TAB_VERB 6 0 "没有限制(None)" 1 "增压器保护(Turbine Protect)" 2 "最大车速限制(Vehicle Speed Protect)" 4 "最大发动机转速限制(Engine Speed Protect)" 8 "最大爆发压力限制(Boost Presure Protect)" 16 "OBD限制" DEFAULT_VALUE "0" /end COMPU_VTAB
/begin COMPU_VTAB stOvhtPrtLim "" TAB_VERB 4 0 "没有限制(None)" 1 "水温限制(Coolant Temperature Limit)" 2 "燃油温度限制(Fuel Temperature Limit)" 4 "机油温度限制(Oil Temperature Limit)" DEFAULT_VALUE "0" /end COMPU_VTAB
/begin COMPU_VTAB stPostDrive "" TAB_VERB 9 0 "禁止(Inactive)" 1 "等待(Wait)" 2 "诊断开始(DSMBegin)" 3 "EEPROM开始(EEPBegin)" 4 "等待2(Wait2)" 5 "DSM结束(DSM End)" 6 "EEPROM结束(EEP End)" 7 "最小时间(MinTime)" 8 "结束(Done)" /end COMPU_VTAB
/begin COMPU_VTAB stPreDrive "" TAB_VERB 2 0 "禁止(Inactive)" 1 "结束(Done)" /end COMPU_VTAB
/begin COMPU_VTAB stRamp "" TAB_VERB 2 0 "结束(End)" 1 "正在进行(Begin)" /end COMPU_VTAB
/begin COMPU_VTAB stShutOff "" TAB_VERB 5 0 "禁止(Inactive)" 1 "DSM(DSM)" 2 "EEPROM(EEP)" 3 "主继电器关闭(MainRelay)" 4 " 结束(Done)" /end COMPU_VTAB
/begin COMPU_VTAB stStartSysCtl "起动控制状态" TAB_VERB 3 0 "初始化(Init)" 1 "起动进行中(Begin)" 2 "起动成功(End)" /end COMPU_VTAB
/begin COMPU_VTAB stSysConMon "" TAB_VERB 5 0 "初始化(Init)" 1 "关闭(Off)" 2 "起动(Boot)" 3 "执行(Exec)" 4 "关闭(Shutdown)" /end COMPU_VTAB
/begin COMPU_VTAB stSysConSub "" TAB_VERB 6 0 "初始化(Init)" 1 "硬件初始化(HardwareInit)" 2 "管理系统初始化(ManageInit)" 3 "PreDrive(PreDrive)" 4 "Drive(Drive)" 5 "PostDrive(PostDrive)" /end COMPU_VTAB
/begin COMPU_VTAB stTestInj "" TAB_VERB 5 0 "TestInj_Void" 1 "TestInj_Inj" 2 "TestInj_Calc" 3 "TestInj_Syn" 4 "TestInj_NoSyn" /end COMPU_VTAB
/begin COMPU_VTAB swtComponentInput "输入是否使用，信号来源" TAB_VERB 2 0 "不使用(Inactive)" 1 "使用(Active)" /end COMPU_VTAB
/begin COMPU_VTAB swtComponentOutput "输出设备是否使用" TAB_VERB 2 0 "不使用(Inactive)" 1 "使用(Active)" /end COMPU_VTAB
/begin COMPU_METHOD NO_FORMULA "" RAT_FUNC "%2.0" "" COEFFS 0 1 0 0 0 1 /end COMPU_METHOD
/begin COMPU_METHOD aFactor32 "" RAT_FUNC "%3.2" "米/秒^2" COEFFS 0 32 -0 0 0 1 /end COMPU_METHOD
/begin COMPU_METHOD bCondition "" TAB_VERB "%3.0" "" COMPU_TAB_REF bCondition /end COMPU_METHOD
/begin COMPU_METHOD ctTimes "计数次数" RAT_FUNC "%3.1" "次" COEFFS 0 1 0 0 0 1 /end COMPU_METHOD
/begin COMPU_METHOD dnFactor1 "" RAT_FUNC "%3.1" "转/分" COEFFS 0 1 0 0 0 1 /end COMPU_METHOD
/begin COMPU_METHOD dpFactor32 "" RAT_FUNC "%3.2" "" COEFFS 0 32 -0 0 0 1 /end COMPU_METHOD
/begin COMPU_METHOD dqFactor128 "" RAT_FUNC "%3.2" "毫克" COEFFS 0 128 -0 0 0 1 /end COMPU_METHOD
/begin COMPU_METHOD drFactor256_AccPed "油门踏板变化率" RAT_FUNC "%3.1" "%/秒" COEFFS 0 256 -0 0 0 1 /end COMPU_METHOD
/begin COMPU_METHOD dtFactor256 "" RAT_FUNC "%3.2" "度" COEFFS 0 256 -0 0 0 1 /end COMPU_METHOD
/begin COMPU_METHOD fFactor1 "9825,9362控制频率" RAT_FUNC "%3.0" "Hz" COEFFS 0 1 0 0 0 1 /end COMPU_METHOD
/begin COMPU_METHOD facFactor100_Correction "修正系数" RAT_FUNC "%3.3" "%" COEFFS 0 100 -0 0 0 1 /end COMPU_METHOD
/begin COMPU_METHOD facFactor100_PID "PID参数" RAT_FUNC "%3.3" "" COEFFS 0 100 -0 0 0 1 /end COMPU_METHOD
/begin COMPU_METHOD idxAccPedType "油门类型" TAB_VERB "%3.1" "" COMPU_TAB_REF idxAccPedType /end COMPU_METHOD
/begin COMPU_METHOD idxEdgeType "边沿捕捉" TAB_VERB "%3.1" "" COMPU_TAB_REF idxEdgeType /end COMPU_METHOD
/begin COMPU_METHOD idxManualResetType "" TAB_VERB "%3.2" "" COMPU_TAB_REF idxManualResetType /end COMPU_METHOD
/begin COMPU_METHOD idxResetType "" TAB_VERB "%3.2" "" COMPU_TAB_REF idxResetType /end COMPU_METHOD
/begin COMPU_METHOD idxSwitchType "开关类型" TAB_VERB "%3.1" "" COMPU_TAB_REF idxSwitchType /end COMPU_METHOD
/begin COMPU_METHOD idxTriggerType "" TAB_VERB "%3.1" "" COMPU_TAB_REF idxTriggerType /end COMPU_METHOD
/begin COMPU_METHOD idxVREGAcq "" TAB_VERB "%3.1" "" COMPU_TAB_REF idxVREGAcq /end COMPU_METHOD
/begin COMPU_METHOD numFactor256 "" RAT_FUNC "%3.2" "脉冲" COEFFS 0 256 -0 0 0 1 /end COMPU_METHOD
/begin COMPU_METHOD pFactor32_kPa "" RAT_FUNC "%3.2" "千帕" COEFFS 0 32 -0 0 0 1 /end COMPU_METHOD
/begin COMPU_METHOD phiFactor32 "" RAT_FUNC "%3.2" "度" COEFFS 0 32 -0 0 0 1 /end COMPU_METHOD
/begin COMPU_METHOD qFactor128 "" RAT_FUNC "%3.2" "毫克" COEFFS 0 128 -0 0 0 1 /end COMPU_METHOD
/begin COMPU_METHOD rFactor100_PWM "9825,9362控制占空比" RAT_FUNC "%3.2" "%" COEFFS 0 100 -0 0 0 1 /end COMPU_METHOD
/begin COMPU_METHOD rFactor100_control "阀控制开度" RAT_FUNC "%3.2" "%" COEFFS 0 100 -0 0 0 1 /end COMPU_METHOD
/begin COMPU_METHOD rFactor10_VSSPlaus "车速合理性计算" RAT_FUNC "%3.1" "" COEFFS 0 10 -0 0 0 1 /end COMPU_METHOD
/begin COMPU_METHOD rFactor256_AccPed "" RAT_FUNC "%3.1" "%" COEFFS 0 256 -0 0 0 1 /end COMPU_METHOD
/begin COMPU_METHOD rFactor256_Plaus "" RAT_FUNC "%3.2" "" COEFFS 0 256 -0 0 0 1 /end COMPU_METHOD
/begin COMPU_METHOD rFactor32_GearConv "" RAT_FUNC "%3.2" "" COEFFS 0 32 -0 0 0 1 /end COMPU_METHOD
/begin COMPU_METHOD stPostDrive "" TAB_VERB "%3.1" "" COMPU_TAB_REF stPostDrive /end COMPU_METHOD
/begin COMPU_METHOD stPreDrive "" TAB_VERB "%3.1" "" COMPU_TAB_REF stPreDrive /end COMPU_METHOD
/begin COMPU_METHOD stRamp "" TAB_VERB "%3.1" "" COMPU_TAB_REF stRamp /end COMPU_METHOD
/begin COMPU_METHOD stShutOff "" TAB_VERB "%3.1" "" COMPU_TAB_REF stShutOff /end COMPU_METHOD
/begin COMPU_METHOD stSysConMon "" TAB_VERB "%3.1" "" COMPU_TAB_REF stSysConMon /end COMPU_METHOD
/begin COMPU_METHOD stSysConSub "" TAB_VERB "%3.1" "" COMPU_TAB_REF stSysConSub /end COMPU_METHOD
/begin COMPU_METHOD swtComponentInput "输入是否使用，信号来源" TAB_VERB "%3.1" "" COMPU_TAB_REF swtComponentInput /end COMPU_METHOD
/begin COMPU_METHOD swtComponentOutput "输出设备是否使用" TAB_VERB "%3.1" "" COMPU_TAB_REF swtComponentOutput /end COMPU_METHOD
/begin COMPU_METHOD tiFactor1000_1ms "" RAT_FUNC "%3.3" "秒" COEFFS 0 1000 -0 0 0 1 /end COMPU_METHOD
/begin COMPU_METHOD tiFactor100_10ms "" RAT_FUNC "%3.2" "秒" COEFFS 0 100 -0 0 0 1 /end COMPU_METHOD
/begin COMPU_METHOD tiFactor25_25MHz "ECT时钟" RAT_FUNC "%3.3" "" COEFFS 0 25 -0 0 0 1 /end COMPU_METHOD
/begin COMPU_METHOD volFactor16 "" RAT_FUNC "%3.2" "毫克/缸" COEFFS 0 16 -0 0 0 1 /end COMPU_METHOD
/begin COMPU_METHOD fFactor256 "" RAT_FUNC "%.2" "Hz" COEFFS 0 1 -1 0 0 0.003906 /end COMPU_METHOD
/begin COMPU_METHOD u5V "AD采样电压" RAT_FUNC "%.3" "伏" COEFFS 0 819 0 0 0 1 /end COMPU_METHOD
/begin COMPU_METHOD PWM_Hz100 "" RAT_FUNC "%.2" "Hz" COEFFS 0 100 0 0 0 1 /end COMPU_METHOD
/begin COMPU_METHOD rpm1-1 "转速1：1转换" RAT_FUNC "%.0" "rpm" COEFFS 0 1 0 0 0 1 /end COMPU_METHOD
/begin COMPU_METHOD Vmh10ms "车速变化率 每10ms车速变化量 米/小时/10ms " RAT_FUNC "%.0" "mh10ms" COEFFS 0 1 0 0 0 1 /end COMPU_METHOD
/begin COMPU_METHOD rr100 "" RAT_FUNC "%.2" "" COEFFS 0 100 0 0 0 1 /end COMPU_METHOD
/begin COMPU_METHOD Speed "" RAT_FUNC "" "km/h" COEFFS 0 1 50 0 0 1 /end COMPU_METHOD
/begin COMPU_METHOD Temp "线性温度转换 1：1" RAT_FUNC "%.0" "℃" COEFFS 0 1 0 0 0 1 /end COMPU_METHOD
/begin COMPU_METHOD rFactor20 "" RAT_FUNC "%.2" "" COEFFS 0 20 0 0 0 1 /end COMPU_METHOD
/begin CHARACTERISTIC Auto_Torque_Max_M021 "自动转矩最大负值" VALUE 0xF08D7 ECTEK_Value_s16 0 NO_FORMULA -300 0 FORMAT "%.2" /end CHARACTERISTIC
/begin CHARACTERISTIC R_Vhms_Average_Ratio_M021 "R档Vhms平均值缓冲比例" VALUE 0xF08D9 ECTEK_Value_u16 0 NO_FORMULA 1 500 FORMAT "%.2" /end CHARACTERISTIC
/begin CHARACTERISTIC D_Vhms_Average_Ratio_M021 "D档Vhms平均值缓冲比例" VALUE 0xF08DB ECTEK_Value_u16 0 NO_FORMULA 1 500 FORMAT "%.2" /end CHARACTERISTIC
/begin CHARACTERISTIC Motor_Speed_Torque_M021 "转速_最大转矩_大地和350-700Nm 70-100KW 比例36.632" CURVE 0xF08DD ECTEK_Curve_u16s16 0 NO_FORMULA 0 5000
 /begin AXIS_DESCR STD_AXIS NO_INPUT_QUANTITY rpm1-1 19 -15000 15000 DEPOSIT ABSOLUTE FORMAT "%.2" /end AXIS_DESCR
 FORMAT "%.2" /end CHARACTERISTIC
/begin CHARACTERISTIC Speed_Vmh10ms_Crawl_D_M021 "D档蠕动 转速-AD曲线 rpm----mh10ms" CURVE 0xF092B ECTEK_Curve_s16s16 0 Vmh10ms -500 500
 /begin AXIS_DESCR STD_AXIS NO_INPUT_QUANTITY rpm1-1 10 -15000 15000 DEPOSIT ABSOLUTE FORMAT "%.2" /end AXIS_DESCR
 FORMAT "%.2" /end CHARACTERISTIC
/begin CHARACTERISTIC Torque_Increment_Crawl_D_M021 "D档蠕动 AD修正转矩给定每周期增量" CURVE 0xF0955 ECTEK_Curve_s16s16 0 NO_FORMULA -100 100
 /begin AXIS_DESCR STD_AXIS NO_INPUT_QUANTITY Vmh10ms 11 -1000 1000 DEPOSIT ABSOLUTE FORMAT "%.2" /end AXIS_DESCR
 FORMAT "%.2" /end CHARACTERISTIC
/begin CHARACTERISTIC Speed_Max_Torque_Crawl_D_M021 "D档蠕行模式最大力矩" CURVE 0xF0983 ECTEK_Curve_u16s16 0 NO_FORMULA 0 5000
 /begin AXIS_DESCR STD_AXIS NO_INPUT_QUANTITY rpm1-1 9 -15000 15000 DEPOSIT ABSOLUTE FORMAT "%.2" /end AXIS_DESCR
 FORMAT "%.2" /end CHARACTERISTIC
/begin CHARACTERISTIC Speed_Max_Torque_Crawl_D_Break_M021 "D档蠕行制动状态下最大驱动力矩" CURVE 0xF09A9 ECTEK_Curve_u16s16 0 NO_FORMULA 0 5000
 /begin AXIS_DESCR STD_AXIS NO_INPUT_QUANTITY rpm1-1 9 -15000 15000 DEPOSIT ABSOLUTE FORMAT "%.2" /end AXIS_DESCR
 FORMAT "%.2" /end CHARACTERISTIC
/begin CHARACTERISTIC Speed_Vmh10ms_General_M021 "通用相对转速-AD曲线 rpm----mh10ms" CURVE 0xF09CF ECTEK_Curve_s16s16 0 Vmh10ms -1000 1000
 /begin AXIS_DESCR STD_AXIS NO_INPUT_QUANTITY rpm1-1 11 -30000 30000 DEPOSIT ABSOLUTE FORMAT "%.2" /end AXIS_DESCR
 FORMAT "%.2" /end CHARACTERISTIC
/begin CHARACTERISTIC Torque_Increment_General_M021 "通用AD修正转矩给定每周期增量" CURVE 0xF09FD ECTEK_Curve_s16s16 0 NO_FORMULA -100 100
 /begin AXIS_DESCR STD_AXIS NO_INPUT_QUANTITY Vmh10ms 11 -1000 1000 DEPOSIT ABSOLUTE FORMAT "%.2" /end AXIS_DESCR
 FORMAT "%.2" /end CHARACTERISTIC
/begin CHARACTERISTIC Speed_Vmh10ms_D_Park_M021 "D档驻坡 转速-AD曲线 rpm----mh10ms" CURVE 0xF0A2B ECTEK_Curve_s16s16 0 Vmh10ms -1000 1000
 /begin AXIS_DESCR STD_AXIS NO_INPUT_QUANTITY rpm1-1 12 -15000 15000 DEPOSIT ABSOLUTE FORMAT "%.2" /end AXIS_DESCR
 FORMAT "%.2" /end CHARACTERISTIC
/begin CHARACTERISTIC Torque_Increment_D_Park_M021 "D档驻坡AD修正转矩给定每周期增量" CURVE 0xF0A5D ECTEK_Curve_s16s16 0 NO_FORMULA -100 100
 /begin AXIS_DESCR STD_AXIS NO_INPUT_QUANTITY Vmh10ms 11 -1000 1000 DEPOSIT ABSOLUTE FORMAT "%.2" /end AXIS_DESCR
 FORMAT "%.2" /end CHARACTERISTIC
/begin CHARACTERISTIC Motor_Speed_Torque_Break_M021 "电机最大制动力矩" CURVE 0xF0A8B ECTEK_Curve_s16s16 0 NO_FORMULA 0 1000
 /begin AXIS_DESCR STD_AXIS NO_INPUT_QUANTITY rpm1-1 14 -15000 15000 DEPOSIT ABSOLUTE FORMAT "%.2" /end AXIS_DESCR
 FORMAT "%.2" /end CHARACTERISTIC
/begin CHARACTERISTIC FeedBack_Coast_D_Torque_M021 "D档滑行回馈 速度-力矩 定点" CURVE 0xF0AC5 ECTEK_Curve_s16s16 0 NO_FORMULA -1000 1000
 /begin AXIS_DESCR STD_AXIS NO_INPUT_QUANTITY rpm1-1 8 -15000 15000 DEPOSIT ABSOLUTE FORMAT "%.2" /end AXIS_DESCR
 FORMAT "%.2" /end CHARACTERISTIC
/begin CHARACTERISTIC FeedBack_Break_D_Torque_M021 "D档制动回馈 速度-力矩 定点" CURVE 0xF0AE7 ECTEK_Curve_s16s16 0 NO_FORMULA -1000 1000
 /begin AXIS_DESCR STD_AXIS NO_INPUT_QUANTITY rpm1-1 8 -15000 15000 DEPOSIT ABSOLUTE FORMAT "%.2" /end AXIS_DESCR
 FORMAT "%.2" /end CHARACTERISTIC
/begin CHARACTERISTIC Speed_Efficieny_M021 "电机速度-转换效率曲线" CURVE 0xF0B09 ECTEK_Curve_u16u16 0 rFactor100_PWM 0 100
 /begin AXIS_DESCR STD_AXIS NO_INPUT_QUANTITY rpm1-1 17 0 15000 DEPOSIT ABSOLUTE FORMAT "%.2" /end AXIS_DESCR
 FORMAT "%.2" /end CHARACTERISTIC
/begin CHARACTERISTIC AutoPark_Motor_Speed_Torque_M021 "驻坡最大力矩" CURVE 0xF0B4F ECTEK_Curve_u16s16 0 NO_FORMULA 0 5000
 /begin AXIS_DESCR STD_AXIS NO_INPUT_QUANTITY rpm1-1 9 -15000 15000 DEPOSIT ABSOLUTE FORMAT "%.2" /end AXIS_DESCR
 FORMAT "%.2" /end CHARACTERISTIC
/begin CHARACTERISTIC Motor_Vehicle_Speed_Scale_M03 "转速-车速比例， 优优114.411 D11 36.632 D07 62.111" VALUE 0xF0B75 ECTEK_Value_u8 0 NO_FORMULA 0 255 FORMAT "%.2" /end CHARACTERISTIC
/begin CHARACTERISTIC Demand_Limit_High_M03 "转速上线 *4" VALUE 0xF0B76 ECTEK_Value_u16 0 NO_FORMULA 0 4095 FORMAT "%.2" /end CHARACTERISTIC
/begin CHARACTERISTIC Demand_Limit_Low_M03 "速度下限" VALUE 0xF0B78 ECTEK_Value_u16 0 NO_FORMULA 0 4095 FORMAT "%.2" /end CHARACTERISTIC
/begin CHARACTERISTIC Crawl_D_Speed_Max_M03 "D蠕动最大速度 从其他状态进入蠕动的速度" VALUE 0xF0B7A ECTEK_Value_u16 0 rpm1-1 0 1000 FORMAT "%.2" /end CHARACTERISTIC
/begin CHARACTERISTIC Crawl_D_Torque_Delay_Max_M03 "蠕动更新间隔 单位10ms" VALUE 0xF0B7C ECTEK_Value_u8 0 NO_FORMULA 0 255 FORMAT "%.2" /end CHARACTERISTIC
/begin CHARACTERISTIC Crawl_D_Torque_Delay_Start_Max_M03 "起步蠕动更新间隔 单位10ms" VALUE 0xF0B7D ECTEK_Value_u8 0 NO_FORMULA 0 255 FORMAT "%.2" /end CHARACTERISTIC
/begin CHARACTERISTIC Speed_Buffer_Number_M03 "10ms车辆速度采样缓冲次数" VALUE 0xF0B7E ECTEK_Value_u8 0 NO_FORMULA 0 69 FORMAT "%.2" /end CHARACTERISTIC
/begin CHARACTERISTIC Speed_Average_Number_M03 "10ms平均车速缓冲次数" VALUE 0xF0B7F ECTEK_Value_u8 0 NO_FORMULA 0 69 FORMAT "%.2" /end CHARACTERISTIC
/begin CHARACTERISTIC Torque_Buffer_Number_AutoPark_M03 "10ms平均车速缓冲次数" VALUE 0xF0B80 ECTEK_Value_u8 0 NO_FORMULA 0 69 FORMAT "%.2" /end CHARACTERISTIC
/begin CHARACTERISTIC D_Park_Start_Speed_M03 "D驻坡触发转速" VALUE 0xF0B81 ECTEK_Value_u8 0 rpm1-1 0 255 FORMAT "%.2" /end CHARACTERISTIC
/begin CHARACTERISTIC Auto_Park_Speed_Acc_Max_M03 "激活D驻坡最大退行转速累加" VALUE 0xF0B82 ECTEK_Value_s16 0 NO_FORMULA -32768 32767 FORMAT "%.2" /end CHARACTERISTIC
/begin CHARACTERISTIC Auto_Park_Speed_Times_Max_M03 "激活D驻坡最大退行增速时间 单位10ms" VALUE 0xF0B84 ECTEK_Value_u16 0 NO_FORMULA 0 65535 FORMAT "%.2" /end CHARACTERISTIC
/begin CHARACTERISTIC EPS_Pwm "EPS脉冲信号手工频率" VALUE 0xF0B86 ECTEK_Value_u32 0 PWM_Hz100 0 5000 /end CHARACTERISTIC
/begin CHARACTERISTIC EPS_Vehicle_Speed_Scale "EPS频率-车速比例 100倍" VALUE 0xF0B8A ECTEK_Value_u16 0 NO_COMPU_METHOD 0 65535 FORMAT "%.2" /end CHARACTERISTIC
/begin CHARACTERISTIC AC_Pressure_Max_Times "空调压力开关动作延迟 *50mS" VALUE 0xF0B8C ECTEK_Value_u16 0 NO_FORMULA 0 65535 FORMAT "%.2" /end CHARACTERISTIC
/begin CHARACTERISTIC AC_Condenser_Temp_Low "空调蒸发器温度最低值" VALUE 0xF0B8E ECTEK_Value_s8 0 NO_FORMULA -128 127 FORMAT "%.2" /end CHARACTERISTIC
/begin CHARACTERISTIC AC_Condenser_Reset_Temp "空调蒸发器复位温度" VALUE 0xF0B8F ECTEK_Value_s8 0 NO_COMPU_METHOD -4294967296 4294967296 FORMAT "%.2" /end CHARACTERISTIC
/begin CHARACTERISTIC FanStopDelay "空调风机停机延时 *50ms 默认15秒" VALUE 0xF0B90 ECTEK_Value_u16 0 NO_COMPU_METHOD -4294967296 4294967296 FORMAT "%.2" /end CHARACTERISTIC
/begin CHARACTERISTIC Auto_Torque_Min_M03 "自动转矩最小正值" VALUE 0xF0B92 ECTEK_Value_s16 0 NO_FORMULA -300 300 FORMAT "%.2" /end CHARACTERISTIC
/begin CHARACTERISTIC Auto_Torque_Max_M03 "自动转矩最大负值" VALUE 0xF0B94 ECTEK_Value_s16 0 NO_FORMULA -300 300 FORMAT "%.2" /end CHARACTERISTIC
/begin CHARACTERISTIC R_Vhms_Average_Ratio_M03 "R档Vhms平均值缓冲比例" VALUE 0xF0B96 ECTEK_Value_u16 0 NO_FORMULA 1 500 FORMAT "%.2" /end CHARACTERISTIC
/begin CHARACTERISTIC D_Vhms_Average_Ratio_M03 "D档Vhms平均值缓冲比例" VALUE 0xF0B98 ECTEK_Value_u16 0 NO_FORMULA 1 500 FORMAT "%.2" /end CHARACTERISTIC
/begin CHARACTERISTIC Motor_Speed_Torque_M03 "转速_最大转矩 大地和 100KW 300N 62.111" CURVE 0xF0B9A ECTEK_Curve_u16s16 0 NO_FORMULA 0 5000
 /begin AXIS_DESCR STD_AXIS NO_INPUT_QUANTITY rpm1-1 19 -15000 15000 DEPOSIT ABSOLUTE FORMAT "%.2" /end AXIS_DESCR
 FORMAT "%.2" /end CHARACTERISTIC
/begin CHARACTERISTIC AccPed_Rip_M03 "油门曲线" CURVE 0xF0BE8 ECTEK_Curve_u16u16 0 rFactor100_PWM 0 100
 /begin AXIS_DESCR STD_AXIS NO_INPUT_QUANTITY rFactor100_PWM 11 0 100 DEPOSIT ABSOLUTE FORMAT "%.2" /end AXIS_DESCR
 FORMAT "%.2" /end CHARACTERISTIC
/begin CHARACTERISTIC Speed_Vmh10ms_Crawl_D_M03 "D档蠕动 转速-AD曲线 rpm----mh10ms" CURVE 0xF0C16 ECTEK_Curve_s16s16 0 Vmh10ms -500 500
 /begin AXIS_DESCR STD_AXIS NO_INPUT_QUANTITY rpm1-1 10 -15000 15000 DEPOSIT ABSOLUTE FORMAT "%.2" /end AXIS_DESCR
 FORMAT "%.2" /end CHARACTERISTIC
/begin CHARACTERISTIC Torque_Increment_Crawl_D_M03 "D档蠕动 AD修正转矩给定每周期增量" CURVE 0xF0C40 ECTEK_Curve_s16s16 0 NO_FORMULA -100 100
 /begin AXIS_DESCR STD_AXIS NO_INPUT_QUANTITY NO_COMPU_METHOD 11 -1000 1000 DEPOSIT ABSOLUTE FORMAT "%.2" /end AXIS_DESCR
 FORMAT "%.2" /end CHARACTERISTIC
/begin CHARACTERISTIC Speed_Max_Torque_Crawl_D_M03 "D档蠕行模式最大力矩" CURVE 0xF0C6E ECTEK_Curve_u16s16 0 NO_FORMULA 0 5000
 /begin AXIS_DESCR STD_AXIS NO_INPUT_QUANTITY rpm1-1 10 -15000 15000 DEPOSIT ABSOLUTE FORMAT "%.2" /end AXIS_DESCR
 FORMAT "%.2" /end CHARACTERISTIC
/begin CHARACTERISTIC Speed_Max_Torque_Crawl_D_Break_M03 "D档蠕行制动状态下最大驱动力矩" CURVE 0xF0C98 ECTEK_Curve_u16s16 0 NO_COMPU_METHOD 0 5000
 /begin AXIS_DESCR STD_AXIS NO_INPUT_QUANTITY NO_COMPU_METHOD 11 -15000 15000 DEPOSIT ABSOLUTE FORMAT "%.2" /end AXIS_DESCR
 FORMAT "%.2" /end CHARACTERISTIC
/begin CHARACTERISTIC Speed_Vmh10ms_General_M03 "通用相对转速-AD曲线 rpm----mh10ms" CURVE 0xF0CC6 ECTEK_Curve_s16s16 0 Vmh10ms -1000 1000
 /begin AXIS_DESCR STD_AXIS NO_INPUT_QUANTITY rpm1-1 11 -30000 30000 DEPOSIT ABSOLUTE FORMAT "%.2" /end AXIS_DESCR
 FORMAT "%.2" /end CHARACTERISTIC
/begin CHARACTERISTIC Torque_Increment_General_M03 "通用AD修正转矩给定每周期增量" CURVE 0xF0CF4 ECTEK_Curve_s16s16 0 NO_FORMULA -100 100
 /begin AXIS_DESCR STD_AXIS NO_INPUT_QUANTITY Vmh10ms 11 -1000 1000 DEPOSIT ABSOLUTE FORMAT "%.2" /end AXIS_DESCR
 FORMAT "%.2" /end CHARACTERISTIC
/begin CHARACTERISTIC Speed_Vmh10ms_D_Park_M03 "D档驻坡 转速-AD曲线 rpm----mh10ms" CURVE 0xF0D22 ECTEK_Curve_s16s16 0 Vmh10ms -1000 1000
 /begin AXIS_DESCR STD_AXIS NO_INPUT_QUANTITY rpm1-1 12 -15000 15000 DEPOSIT ABSOLUTE FORMAT "%.2" /end AXIS_DESCR
 FORMAT "%.2" /end CHARACTERISTIC
/begin CHARACTERISTIC Torque_Increment_D_Park_M03 "D档驻坡AD修正转矩给定每周期增量" CURVE 0xF0D54 ECTEK_Curve_s16s16 0 NO_FORMULA -100 100
 /begin AXIS_DESCR STD_AXIS NO_INPUT_QUANTITY Vmh10ms 11 -1000 1000 DEPOSIT ABSOLUTE FORMAT "%.2" /end AXIS_DESCR
 FORMAT "%.2" /end CHARACTERISTIC
/begin CHARACTERISTIC Motor_Speed_Torque_Break_M03 "电机最大制动力矩" CURVE 0xF0D82 ECTEK_Curve_s16s16 0 NO_FORMULA -0 5000
 /begin AXIS_DESCR STD_AXIS NO_INPUT_QUANTITY rpm1-1 14 -15000 15000 DEPOSIT ABSOLUTE FORMAT "%.2" /end AXIS_DESCR
 FORMAT "%.2" /end CHARACTERISTIC
/begin CHARACTERISTIC FeedBack_Coast_D_Torque_M03 "D档滑行回馈 速度-力矩 定点" CURVE 0xF0DBC ECTEK_Curve_s16s16 0 NO_FORMULA -1000 1000
 /begin AXIS_DESCR STD_AXIS NO_INPUT_QUANTITY rpm1-1 8 -15000 15000 DEPOSIT ABSOLUTE FORMAT "%.2" /end AXIS_DESCR
 FORMAT "%.2" /end CHARACTERISTIC
/begin CHARACTERISTIC FeedBack_Break_D_Torque_M03 "D档制动回馈 速度-力矩 定点" CURVE 0xF0DDE ECTEK_Curve_s16s16 0 NO_FORMULA -1000 1000
 /begin AXIS_DESCR STD_AXIS NO_INPUT_QUANTITY rpm1-1 8 -15000 15000 DEPOSIT ABSOLUTE FORMAT "%.2" /end AXIS_DESCR
 FORMAT "%.2" /end CHARACTERISTIC
/begin CHARACTERISTIC Speed_Efficieny_M03 "电机速度-转换效率曲线 驱动" CURVE 0xF0E00 ECTEK_Curve_u16u16 0 rFactor100_PWM 0 100
 /begin AXIS_DESCR STD_AXIS NO_INPUT_QUANTITY rpm1-1 14 0 15000 DEPOSIT ABSOLUTE FORMAT "%.2" /end AXIS_DESCR
 FORMAT "%.2" /end CHARACTERISTIC
/begin CHARACTERISTIC Speed_Efficieny_FeedBack_M03 "电机速度-转换效率曲线 发电" CURVE 0xF0E3A ECTEK_Curve_u16u16 0 rFactor100_PWM 0 100
 /begin AXIS_DESCR STD_AXIS NO_INPUT_QUANTITY rpm1-1 14 0 15000 DEPOSIT ABSOLUTE FORMAT "%.2" /end AXIS_DESCR
 FORMAT "%.2" /end CHARACTERISTIC
/begin CHARACTERISTIC AutoPark_Motor_Speed_Torque_M03 "驻坡最大力矩" CURVE 0xF0E74 ECTEK_Curve_u16s16 0 NO_FORMULA 0 5000
 /begin AXIS_DESCR STD_AXIS NO_INPUT_QUANTITY rpm1-1 8 -15000 15000 DEPOSIT ABSOLUTE FORMAT "%.2" /end AXIS_DESCR
 FORMAT "%.2" /end CHARACTERISTIC
/begin CHARACTERISTIC AccPedCD_rUW_CUR_M03 "油门开度" CURVE 0xF0E96 ECTEK_Curve_u16u16 0 rFactor100_PWM 0 100
 /begin AXIS_DESCR STD_AXIS NO_INPUT_QUANTITY u5V 7 0 5 DEPOSIT ABSOLUTE FORMAT "%.2" /end AXIS_DESCR
 FORMAT "%.2" /end CHARACTERISTIC
/begin CHARACTERISTIC AccPedCD_rUW_CUR2_M03 "油门2开度" CURVE 0xF0EB4 ECTEK_Curve_u16u16 0 rFactor100_PWM 0 100
 /begin AXIS_DESCR STD_AXIS NO_INPUT_QUANTITY u5V 7 0 5 DEPOSIT ABSOLUTE FORMAT "%.2" /end AXIS_DESCR
 FORMAT "%.2" /end CHARACTERISTIC
/begin CHARACTERISTIC EPS_Speed "D07 EPS频率与转速对应曲线 33~233.30Hz" CURVE 0xF0ED2 ECTEK_Curve_u16s16 0 PWM_Hz100 33 600
 /begin AXIS_DESCR STD_AXIS NO_INPUT_QUANTITY rpm1-1 10 -15000 15000 DEPOSIT ABSOLUTE FORMAT "%.2" /end AXIS_DESCR
/end CHARACTERISTIC
/begin CHARACTERISTIC AC_Condenser_Temp_M03 "空调蒸发器温度" CURVE 0xF0EFC ECTEK_Curve_s16u16 0 NO_FORMULA -100 150
 /begin AXIS_DESCR STD_AXIS NO_INPUT_QUANTITY NO_FORMULA 35 0 4095 DEPOSIT ABSOLUTE FORMAT "%.2" /end AXIS_DESCR
 BIT_MASK 0xFF FORMAT "%.2" /end CHARACTERISTIC
/begin CHARACTERISTIC AC_Condenser_Temp_M03_ACES "空调蒸发器温度_奥易克斯" CURVE 0xF0F8A ECTEK_Curve_s16u16 0 NO_FORMULA -100 150
 /begin AXIS_DESCR STD_AXIS NO_INPUT_QUANTITY NO_FORMULA 36 0 4095 DEPOSIT ABSOLUTE FORMAT "%.2" /end AXIS_DESCR
 FORMAT "%.2" /end CHARACTERISTIC
/begin CHARACTERISTIC Motor_Vehicle_Speed_Scale_M031 "转速-车速比例， 优优114.411 D11 36.632 D07 62.111 8.25智环桥 71.28" VALUE 0xF101C ECTEK_Value_u8 0 NO_FORMULA 0 255 FORMAT "%.2" /end CHARACTERISTIC
/begin CHARACTERISTIC Demand_Limit_High_M031 "转速上线 *4" VALUE 0xF101D ECTEK_Value_u16 0 NO_FORMULA 0 4095 FORMAT "%.2" /end CHARACTERISTIC
/begin CHARACTERISTIC Demand_Limit_Low_M031 "速度下限" VALUE 0xF101F ECTEK_Value_u16 0 NO_FORMULA 0 4095 FORMAT "%.2" /end CHARACTERISTIC
/begin CHARACTERISTIC Crawl_D_Speed_Max_M031 "D蠕动最大速度 从其他状态进入蠕动的速度" VALUE 0xF1021 ECTEK_Value_u16 0 rpm1-1 0 1000 FORMAT "%.2" /end CHARACTERISTIC
/begin CHARACTERISTIC Crawl_D_Torque_Delay_Max_M031 "蠕动更新间隔 单位10ms" VALUE 0xF1023 ECTEK_Value_u8 0 NO_FORMULA 0 255 FORMAT "%.2" /end CHARACTERISTIC
/begin CHARACTERISTIC Crawl_D_Torque_Delay_Start_Max_M031 "起步蠕动更新间隔 单位10ms" VALUE 0xF1024 ECTEK_Value_u8 0 NO_FORMULA 0 255 FORMAT "%.2" /end CHARACTERISTIC
/begin CHARACTERISTIC Speed_Buffer_Number_M031 "10ms车辆速度采样缓冲次数" VALUE 0xF1025 ECTEK_Value_u8 0 NO_FORMULA 0 69 FORMAT "%.2" /end CHARACTERISTIC
/begin CHARACTERISTIC Speed_Average_Number_M031 "10ms平均车速缓冲次数" VALUE 0xF1026 ECTEK_Value_u8 0 NO_FORMULA 0 69 FORMAT "%.2" /end CHARACTERISTIC
/begin CHARACTERISTIC Torque_Buffer_Number_AutoPark_M031 "10ms平均车速缓冲次数" VALUE 0xF1027 ECTEK_Value_u8 0 NO_FORMULA 0 69 FORMAT "%.2" /end CHARACTERISTIC
/begin CHARACTERISTIC D_Park_Start_Speed_M031 "D驻坡触发转速" VALUE 0xF1028 ECTEK_Value_u8 0 rpm1-1 0 255 FORMAT "%.2" /end CHARACTERISTIC
/begin CHARACTERISTIC Auto_Park_Speed_Acc_Max_M031 "激活D驻坡最大退行转速累加" VALUE 0xF1029 ECTEK_Value_s16 0 NO_FORMULA -32768 32767 FORMAT "%.2" /end CHARACTERISTIC
/begin CHARACTERISTIC Auto_Park_Speed_Times_Max_M031 "激活D驻坡最大退行增速时间 单位10ms" VALUE 0xF102B ECTEK_Value_u16 0 NO_FORMULA 0 65535 FORMAT "%.2" /end CHARACTERISTIC
/begin CHARACTERISTIC Auto_Torque_Min_M031 "自动转矩最小正值" VALUE 0xF102D ECTEK_Value_s16 0 NO_FORMULA -300 300 FORMAT "%.2" /end CHARACTERISTIC
/begin CHARACTERISTIC Auto_Torque_Max_M031 "自动转矩最大负值" VALUE 0xF102F ECTEK_Value_s16 0 NO_FORMULA -300 300 FORMAT "%.2" /end CHARACTERISTIC
/begin CHARACTERISTIC R_Vhms_Average_Ratio_M031 "R档Vhms平均值缓冲比例" VALUE 0xF1031 ECTEK_Value_u16 0 NO_FORMULA 1 500 FORMAT "%.2" /end CHARACTERISTIC
/begin CHARACTERISTIC D_Vhms_Average_Ratio_M031 "D档Vhms平均值缓冲比例" VALUE 0xF1033 ECTEK_Value_u16 0 NO_FORMULA 1 500 FORMAT "%.2" /end CHARACTERISTIC
/begin CHARACTERISTIC Motor_Speed_Torque_M031 "转速_最大转矩 大地和 100KW 300N 62.111" CURVE 0xF1035 ECTEK_Curve_u16s16 0 NO_FORMULA 0 5000
 /begin AXIS_DESCR STD_AXIS NO_INPUT_QUANTITY rpm1-1 20 -15000 15000 DEPOSIT ABSOLUTE FORMAT "%.2" /end AXIS_DESCR
 FORMAT "%.2" /end CHARACTERISTIC
/begin CHARACTERISTIC Speed_Vmh10ms_Crawl_D_M031 "D档蠕动 转速-AD曲线 rpm----mh10ms" CURVE 0xF1087 ECTEK_Curve_s16s16 0 Vmh10ms -500 500
 /begin AXIS_DESCR STD_AXIS NO_INPUT_QUANTITY rpm1-1 10 -15000 15000 DEPOSIT ABSOLUTE FORMAT "%.2" /end AXIS_DESCR
 FORMAT "%.2" /end CHARACTERISTIC
/begin CHARACTERISTIC Torque_Increment_Crawl_D_M031 "D档蠕动 AD修正转矩给定每周期增量" CURVE 0xF10B1 ECTEK_Curve_s16s16 0 NO_FORMULA -100 100
 /begin AXIS_DESCR STD_AXIS NO_INPUT_QUANTITY NO_COMPU_METHOD 11 -1000 1000 DEPOSIT ABSOLUTE FORMAT "%.2" /end AXIS_DESCR
 FORMAT "%.2" /end CHARACTERISTIC
/begin CHARACTERISTIC Speed_Max_Torque_Crawl_D_M031 "D档蠕行模式最大力矩" CURVE 0xF10DF ECTEK_Curve_u16s16 0 NO_FORMULA 0 5000
 /begin AXIS_DESCR STD_AXIS NO_INPUT_QUANTITY rpm1-1 10 -15000 15000 DEPOSIT ABSOLUTE FORMAT "%.2" /end AXIS_DESCR
 FORMAT "%.2" /end CHARACTERISTIC
/begin CHARACTERISTIC Speed_Max_Torque_Crawl_D_Break_M031 "D档蠕行制动状态下最大驱动力矩" CURVE 0xF1109 ECTEK_Curve_u16s16 0 NO_COMPU_METHOD 0 5000
 /begin AXIS_DESCR STD_AXIS NO_INPUT_QUANTITY NO_COMPU_METHOD 11 -15000 15000 DEPOSIT ABSOLUTE FORMAT "%.2" /end AXIS_DESCR
 FORMAT "%.2" /end CHARACTERISTIC
/begin CHARACTERISTIC Speed_Vmh10ms_General_M031 "通用相对转速-AD曲线 rpm----mh10ms" CURVE 0xF1137 ECTEK_Curve_s16s16 0 Vmh10ms -1000 1000
 /begin AXIS_DESCR STD_AXIS NO_INPUT_QUANTITY rpm1-1 11 -30000 30000 DEPOSIT ABSOLUTE FORMAT "%.2" /end AXIS_DESCR
 FORMAT "%.2" /end CHARACTERISTIC
/begin CHARACTERISTIC Torque_Increment_General_M031 "通用AD修正转矩给定每周期增量" CURVE 0xF1165 ECTEK_Curve_s16s16 0 NO_FORMULA -100 100
 /begin AXIS_DESCR STD_AXIS NO_INPUT_QUANTITY Vmh10ms 11 -1000 1000 DEPOSIT ABSOLUTE FORMAT "%.2" /end AXIS_DESCR
 FORMAT "%.2" /end CHARACTERISTIC
/begin CHARACTERISTIC Speed_Vmh10ms_D_Park_M031 "D档驻坡 转速-AD曲线 rpm----mh10ms" CURVE 0xF1193 ECTEK_Curve_s16s16 0 Vmh10ms -1000 1000
 /begin AXIS_DESCR STD_AXIS NO_INPUT_QUANTITY rpm1-1 12 -15000 15000 DEPOSIT ABSOLUTE FORMAT "%.2" /end AXIS_DESCR
 FORMAT "%.2" /end CHARACTERISTIC
/begin CHARACTERISTIC Torque_Increment_D_Park_M031 "D档驻坡AD修正转矩给定每周期增量" CURVE 0xF11C5 ECTEK_Curve_s16s16 0 NO_FORMULA -100 100
 /begin AXIS_DESCR STD_AXIS NO_INPUT_QUANTITY Vmh10ms 11 -1000 1000 DEPOSIT ABSOLUTE FORMAT "%.2" /end AXIS_DESCR
 FORMAT "%.2" /end CHARACTERISTIC
/begin CHARACTERISTIC Motor_Speed_Torque_Break_M031 "电机最大制动力矩" CURVE 0xF11F3 ECTEK_Curve_s16s16 0 NO_FORMULA -0 5000
 /begin AXIS_DESCR STD_AXIS NO_INPUT_QUANTITY rpm1-1 14 -15000 15000 DEPOSIT ABSOLUTE FORMAT "%.2" /end AXIS_DESCR
 FORMAT "%.2" /end CHARACTERISTIC
/begin CHARACTERISTIC FeedBack_Coast_D_Torque_M031 "D档滑行回馈 速度-力矩 定点" CURVE 0xF122D ECTEK_Curve_s16s16 0 NO_FORMULA -1000 1000
 /begin AXIS_DESCR STD_AXIS NO_INPUT_QUANTITY rpm1-1 8 -15000 15000 DEPOSIT ABSOLUTE FORMAT "%.2" /end AXIS_DESCR
 FORMAT "%.2" /end CHARACTERISTIC
/begin CHARACTERISTIC FeedBack_Break_D_Torque_M031 "D档制动回馈 速度-力矩 定点" CURVE 0xF124F ECTEK_Curve_s16s16 0 NO_FORMULA -1000 1000
 /begin AXIS_DESCR STD_AXIS NO_INPUT_QUANTITY rpm1-1 8 -15000 15000 DEPOSIT ABSOLUTE FORMAT "%.2" /end AXIS_DESCR
 FORMAT "%.2" /end CHARACTERISTIC
/begin CHARACTERISTIC Speed_Efficieny_M031 "电机速度-转换效率曲线 驱动" CURVE 0xF1271 ECTEK_Curve_u16u16 0 rFactor100_PWM 0 100
 /begin AXIS_DESCR STD_AXIS NO_INPUT_QUANTITY rpm1-1 14 0 15000 DEPOSIT ABSOLUTE FORMAT "%.2" /end AXIS_DESCR
 FORMAT "%.2" /end CHARACTERISTIC
/begin CHARACTERISTIC Speed_Efficieny_FeedBack_M031 "电机速度-转换效率曲线 发电" CURVE 0xF12AB ECTEK_Curve_u16u16 0 rFactor100_PWM 0 100
 /begin AXIS_DESCR STD_AXIS NO_INPUT_QUANTITY rpm1-1 14 0 15000 DEPOSIT ABSOLUTE FORMAT "%.2" /end AXIS_DESCR
 FORMAT "%.2" /end CHARACTERISTIC
/begin CHARACTERISTIC AutoPark_Motor_Speed_Torque_M031 "驻坡最大力矩" CURVE 0xF12E5 ECTEK_Curve_u16s16 0 NO_FORMULA 0 5000
 /begin AXIS_DESCR STD_AXIS NO_INPUT_QUANTITY rpm1-1 8 -15000 15000 DEPOSIT ABSOLUTE FORMAT "%.2" /end AXIS_DESCR
 FORMAT "%.2" /end CHARACTERISTIC
/begin CHARACTERISTIC APU_DebugMode "増程器手动调试模式开关" VALUE 0xF1307 ECTEK_Value_u8 0 NO_FORMULA 0 1 FORMAT "%.2" /end CHARACTERISTIC
/begin CHARACTERISTIC APU_Debug_CMD "増程器工作命令 0 停 1 工作(启动) 2 发电 3 主动放电" VALUE 0xF1308 ECTEK_Value_u8 0 NO_FORMULA 0 3 FORMAT "%.2" /end CHARACTERISTIC
/begin CHARACTERISTIC APU_Debug_Demand_Power "増程器目标发电功率 1310.7~0.1KW" VALUE 0xF1309 ECTEK_Value_u16 0 rFactor10_VSSPlaus 0 1310.7 FORMAT "%.2" /end CHARACTERISTIC
/begin CHARACTERISTIC APU_Debug_Demand_Speed "増程器目标转速" VALUE 0xF130B ECTEK_Value_u16 0 rpm1-1 0 7650 FORMAT "%.2" /end CHARACTERISTIC
/begin CHARACTERISTIC Motor_Vehicle_Speed_Scale_M06 "转速-车速比例， D09减速箱9.07 速比：75.89" VALUE 0xF130D ECTEK_Value_u8 0 NO_COMPU_METHOD 0 255 FORMAT "%.2" /end CHARACTERISTIC
/begin CHARACTERISTIC Demand_Limit_High_M06 "速度上限" VALUE 0xF130E ECTEK_Value_u16 0 NO_COMPU_METHOD 0 4095 FORMAT "%.2" /end CHARACTERISTIC
/begin CHARACTERISTIC Demand_Limit_Low_M06 "速度下限" VALUE 0xF1310 ECTEK_Value_u16 0 NO_COMPU_METHOD 0 4095 FORMAT "%.2" /end CHARACTERISTIC
/begin CHARACTERISTIC Crawl_D_Speed_Max_M06 "D蠕动最大速度 从其他状态进入蠕动的速度" VALUE 0xF1312 ECTEK_Value_u16 0 NO_COMPU_METHOD 0 1000 FORMAT "%.2" /end CHARACTERISTIC
/begin CHARACTERISTIC Crawl_D_Torque_Delay_Max_M06 "蠕动更新间隔 单位10ms" VALUE 0xF1314 ECTEK_Value_u8 0 NO_COMPU_METHOD 1 255 FORMAT "%.2" /end CHARACTERISTIC
/begin CHARACTERISTIC Crawl_D_Torque_Delay_Start_Max_M06 "起步蠕动更新间隔 单位10ms" VALUE 0xF1315 ECTEK_Value_u8 0 NO_FORMULA 0 255 FORMAT "%.2" /end CHARACTERISTIC
/begin CHARACTERISTIC Speed_Buffer_Number_M06 "10ms车辆速度采样缓冲次数" VALUE 0xF1316 ECTEK_Value_u8 0 NO_COMPU_METHOD 1 69 FORMAT "%.2" /end CHARACTERISTIC
/begin CHARACTERISTIC Speed_Average_Number_M06 "10ms平均车速缓冲次数" VALUE 0xF1317 ECTEK_Value_u8 0 NO_COMPU_METHOD 1 69 FORMAT "%.2" /end CHARACTERISTIC
/begin CHARACTERISTIC Torque_Buffer_Number_AutoPark_M06 "10ms车辆平均转矩采样缓冲次数 驻坡" VALUE 0xF1318 ECTEK_Value_u8 0 NO_COMPU_METHOD 1 69 FORMAT "%.2" /end CHARACTERISTIC
/begin CHARACTERISTIC D_Park_Start_Speed_M06 "D驻坡触发转速" VALUE 0xF1319 ECTEK_Value_u8 0 NO_COMPU_METHOD 0 255 FORMAT "%.2" /end CHARACTERISTIC
/begin CHARACTERISTIC Auto_Park_Speed_Acc_Max_M06 "激活D驻坡最大退行转速累加" VALUE 0xF131A ECTEK_Value_s16 0 NO_FORMULA -32768 32767 FORMAT "%.2" /end CHARACTERISTIC
/begin CHARACTERISTIC Auto_Park_Speed_Times_Max_M06 "" VALUE 0xF131C ECTEK_Value_u16 0 NO_FORMULA 0 65535 FORMAT "%.2" /end CHARACTERISTIC
/begin CHARACTERISTIC Auto_Torque_Min_M06 "自动转矩最小正值" VALUE 0xF131E ECTEK_Value_s16 0 NO_COMPU_METHOD 0 300 FORMAT "%.2" /end CHARACTERISTIC
/begin CHARACTERISTIC Auto_Torque_Max_M06 "自动转矩最大负值" VALUE 0xF1320 ECTEK_Value_s16 0 NO_FORMULA -300 0 FORMAT "%.2" /end CHARACTERISTIC
/begin CHARACTERISTIC R_Vhms_Average_Ratio_M06 "R档Vhms平均值缓冲比例" VALUE 0xF1322 ECTEK_Value_u16 0 NO_FORMULA 1 500 FORMAT "%.2" /end CHARACTERISTIC
/begin CHARACTERISTIC D_Vhms_Average_Ratio_M06 "D档Vhms平均值缓冲比例" VALUE 0xF1324 ECTEK_Value_u16 0 NO_FORMULA 1 500 FORMAT "%.2" /end CHARACTERISTIC
/begin CHARACTERISTIC Motor_Speed_Torque_M06 "转速_最大转矩_旭利、230(500)Nm、50(90)KW、2100(6000)rpm 、比例44.83" CURVE 0xF1326 ECTEK_Curve_u16s16 0 NO_FORMULA 0 5000
 /begin AXIS_DESCR STD_AXIS NO_INPUT_QUANTITY rpm1-1 27 -15000 15000 DEPOSIT ABSOLUTE FORMAT "%.2" /end AXIS_DESCR
 FORMAT "%.2" /end CHARACTERISTIC
/begin CHARACTERISTIC Speed_Vmh10ms_Crawl_D_M06 "D档蠕动 转速-AD曲线 rpm----mh10ms" CURVE 0xF1394 ECTEK_Curve_s16s16 0 Vmh10ms -500 500
 /begin AXIS_DESCR STD_AXIS NO_INPUT_QUANTITY rpm1-1 10 -15000 15000 DEPOSIT ABSOLUTE FORMAT "%.2" /end AXIS_DESCR
 FORMAT "%.2" /end CHARACTERISTIC
/begin CHARACTERISTIC Torque_Increment_Crawl_D_M06 "D档蠕动 AD修正转矩给定每周期增量" CURVE 0xF13BE ECTEK_Curve_s16s16 0 NO_FORMULA -100 100
 /begin AXIS_DESCR STD_AXIS NO_INPUT_QUANTITY Vmh10ms 11 -1000 1000 DEPOSIT ABSOLUTE FORMAT "%.2" /end AXIS_DESCR
 FORMAT "%.2" /end CHARACTERISTIC
/begin CHARACTERISTIC Speed_Max_Torque_Crawl_D_M06 "D档蠕行模式最大力矩" CURVE 0xF13EC ECTEK_Curve_u16s16 0 NO_FORMULA 0 5000
 /begin AXIS_DESCR STD_AXIS NO_INPUT_QUANTITY rpm1-1 9 -15000 15000 DEPOSIT ABSOLUTE FORMAT "%.2" /end AXIS_DESCR
 FORMAT "%.2" /end CHARACTERISTIC
/begin CHARACTERISTIC Speed_Max_Torque_Crawl_D_Break_M06 "D档蠕行制动状态下最大驱动力矩" CURVE 0xF1412 ECTEK_Curve_u16s16 0 NO_FORMULA 0 5000
 /begin AXIS_DESCR STD_AXIS NO_INPUT_QUANTITY rpm1-1 9 -15000 15000 DEPOSIT ABSOLUTE FORMAT "%.2" /end AXIS_DESCR
 FORMAT "%.2" /end CHARACTERISTIC
/begin CHARACTERISTIC Speed_Vmh10ms_General_M06 "通用相对转速-AD曲线 rpm----mh10ms" CURVE 0xF1438 ECTEK_Curve_s16s16 0 Vmh10ms -1000 1000
 /begin AXIS_DESCR STD_AXIS NO_INPUT_QUANTITY rpm1-1 11 -30000 30000 DEPOSIT ABSOLUTE FORMAT "%.2" /end AXIS_DESCR
 FORMAT "%.2" /end CHARACTERISTIC
/begin CHARACTERISTIC Torque_Increment_General_M06 "通用AD修正转矩给定每周期增量" CURVE 0xF1466 ECTEK_Curve_s16s16 0 NO_FORMULA -100 100
 /begin AXIS_DESCR STD_AXIS NO_INPUT_QUANTITY Vmh10ms 11 -1000 1000 DEPOSIT ABSOLUTE FORMAT "%.2" /end AXIS_DESCR
 FORMAT "%.2" /end CHARACTERISTIC
/begin CHARACTERISTIC Speed_Vmh10ms_D_Park_M06 "D档驻坡 转速-AD曲线 rpm----mh10ms" CURVE 0xF1494 ECTEK_Curve_s16s16 0 Vmh10ms -1000 1000
 /begin AXIS_DESCR STD_AXIS NO_INPUT_QUANTITY rpm1-1 12 -15000 15000 DEPOSIT ABSOLUTE FORMAT "%.2" /end AXIS_DESCR
 FORMAT "%.2" /end CHARACTERISTIC
/begin CHARACTERISTIC Torque_Increment_D_Park_M06 "D档驻坡AD修正转矩给定每周期增量" CURVE 0xF14C6 ECTEK_Curve_s16s16 0 NO_FORMULA -100 100
 /begin AXIS_DESCR STD_AXIS NO_INPUT_QUANTITY Vmh10ms 11 -1000 1000 DEPOSIT ABSOLUTE FORMAT "%.2" /end AXIS_DESCR
 FORMAT "%.2" /end CHARACTERISTIC
/begin CHARACTERISTIC Motor_Speed_Torque_Break_M06 "电机最大制动力矩" CURVE 0xF14F4 ECTEK_Curve_s16s16 0 NO_FORMULA 0 1000
 /begin AXIS_DESCR STD_AXIS NO_INPUT_QUANTITY rpm1-1 14 -15000 15000 DEPOSIT ABSOLUTE FORMAT "%.2" /end AXIS_DESCR
 FORMAT "%.2" /end CHARACTERISTIC
/begin CHARACTERISTIC FeedBack_Coast_D_Torque_M06 "D档滑行回馈 速度-力矩 定点" CURVE 0xF152E ECTEK_Curve_s16s16 0 NO_FORMULA -1000 1000
 /begin AXIS_DESCR STD_AXIS NO_INPUT_QUANTITY rpm1-1 8 -15000 15000 DEPOSIT ABSOLUTE FORMAT "%.2" /end AXIS_DESCR
 FORMAT "%.2" /end CHARACTERISTIC
/begin CHARACTERISTIC FeedBack_Break_D_Torque_M06 "D档制动回馈 速度-力矩 定点" CURVE 0xF1550 ECTEK_Curve_s16s16 0 NO_FORMULA -1000 1000
 /begin AXIS_DESCR STD_AXIS NO_INPUT_QUANTITY rpm1-1 8 -15000 15000 DEPOSIT ABSOLUTE FORMAT "%.2" /end AXIS_DESCR
 FORMAT "%.2" /end CHARACTERISTIC
/begin CHARACTERISTIC Speed_Efficieny_M06 "电机速度-转换效率曲线" CURVE 0xF1572 ECTEK_Curve_u16u16 0 rFactor100_PWM 0 100
 /begin AXIS_DESCR STD_AXIS NO_INPUT_QUANTITY rpm1-1 16 0 15000 DEPOSIT ABSOLUTE FORMAT "%.2" /end AXIS_DESCR
 FORMAT "%.2" /end CHARACTERISTIC
/begin CHARACTERISTIC Speed_Efficieny_FeedBack_M06 "电机速度-转换效率曲线 发电" CURVE 0xF15B4 ECTEK_Curve_u16u16 0 rFactor100_PWM 0 100
 /begin AXIS_DESCR STD_AXIS NO_INPUT_QUANTITY rpm1-1 16 0 15000 DEPOSIT ABSOLUTE FORMAT "%.2" /end AXIS_DESCR
 FORMAT "%.2" /end CHARACTERISTIC
/begin CHARACTERISTIC AutoPark_Motor_Speed_Torque_M06 "驻坡最大力矩" CURVE 0xF15F6 ECTEK_Curve_u16s16 0 NO_FORMULA 0 5000
 /begin AXIS_DESCR STD_AXIS NO_INPUT_QUANTITY rpm1-1 9 -15000 15000 DEPOSIT ABSOLUTE FORMAT "%.2" /end AXIS_DESCR
 FORMAT "%.2" /end CHARACTERISTIC
/begin CHARACTERISTIC AccPedCD_rUW_CUR_M06 "油门开度" CURVE 0xF161C ECTEK_Curve_u16u16 0 rFactor100_PWM 0 100
 /begin AXIS_DESCR STD_AXIS NO_INPUT_QUANTITY u5V 7 0 5 DEPOSIT ABSOLUTE FORMAT "%.2" /end AXIS_DESCR
 FORMAT "%.2" /end CHARACTERISTIC
/begin CHARACTERISTIC AccPedCD_rUW_CUR2_M06 "油门2开度" CURVE 0xF163A ECTEK_Curve_u16u16 0 rFactor100_PWM 0 100
 /begin AXIS_DESCR STD_AXIS NO_INPUT_QUANTITY u5V 7 0 5 DEPOSIT ABSOLUTE FORMAT "%.2" /end AXIS_DESCR
 FORMAT "%.2" /end CHARACTERISTIC
/begin CHARACTERISTIC Motor_Vehicle_Speed_Scale_M061 "转速-车速比例， D09 车速与转速比 1：44.83" VALUE 0xF1658 ECTEK_Value_u8 0 NO_COMPU_METHOD 0 255 FORMAT "%.2" /end CHARACTERISTIC
/begin CHARACTERISTIC Demand_Limit_High_M061 "速度上限" VALUE 0xF1659 ECTEK_Value_u16 0 NO_COMPU_METHOD 0 4095 FORMAT "%.2" /end CHARACTERISTIC
/begin CHARACTERISTIC Demand_Limit_Low_M061 "速度下限" VALUE 0xF165B ECTEK_Value_u16 0 NO_COMPU_METHOD 0 4095 FORMAT "%.2" /end CHARACTERISTIC
/begin CHARACTERISTIC Crawl_D_Speed_Max_M061 "D蠕动最大速度 从其他状态进入蠕动的速度" VALUE 0xF165D ECTEK_Value_u16 0 NO_COMPU_METHOD 0 1000 FORMAT "%.2" /end CHARACTERISTIC
/begin CHARACTERISTIC Crawl_D_Torque_Delay_Max_M061 "蠕动更新间隔 单位10ms" VALUE 0xF165F ECTEK_Value_u8 0 NO_COMPU_METHOD 1 255 FORMAT "%.2" /end CHARACTERISTIC
/begin CHARACTERISTIC Crawl_D_Torque_Delay_Start_Max_M061 "起步蠕动更新间隔 单位10ms" VALUE 0xF1660 ECTEK_Value_u8 0 NO_FORMULA 0 255 FORMAT "%.2" /end CHARACTERISTIC
/begin CHARACTERISTIC Speed_Buffer_Number_M061 "10ms车辆速度采样缓冲次数" VALUE 0xF1661 ECTEK_Value_u8 0 NO_COMPU_METHOD 1 69 FORMAT "%.2" /end CHARACTERISTIC
/begin CHARACTERISTIC Speed_Average_Number_M061 "10ms平均车速缓冲次数" VALUE 0xF1662 ECTEK_Value_u8 0 NO_COMPU_METHOD 1 69 FORMAT "%.2" /end CHARACTERISTIC
/begin CHARACTERISTIC Torque_Buffer_Number_AutoPark_M061 "10ms车辆平均转矩采样缓冲次数 驻坡" VALUE 0xF1663 ECTEK_Value_u8 0 NO_COMPU_METHOD 1 69 FORMAT "%.2" /end CHARACTERISTIC
/begin CHARACTERISTIC D_Park_Start_Speed_M061 "D驻坡触发转速" VALUE 0xF1664 ECTEK_Value_u8 0 NO_COMPU_METHOD 0 255 FORMAT "%.2" /end CHARACTERISTIC
/begin CHARACTERISTIC Auto_Park_Speed_Acc_Max_M061 "激活D驻坡最大退行转速累加" VALUE 0xF1665 ECTEK_Value_s16 0 NO_FORMULA -32768 32767 FORMAT "%.2" /end CHARACTERISTIC
/begin CHARACTERISTIC Auto_Park_Speed_Times_Max_M061 "" VALUE 0xF1667 ECTEK_Value_u16 0 NO_FORMULA 0 65535 FORMAT "%.2" /end CHARACTERISTIC
/begin CHARACTERISTIC Auto_Torque_Min_M061 "自动转矩最小正值" VALUE 0xF1669 ECTEK_Value_s16 0 NO_COMPU_METHOD 0 300 FORMAT "%.2" /end CHARACTERISTIC
/begin CHARACTERISTIC Auto_Torque_Max_M061 "自动转矩最大负值" VALUE 0xF166B ECTEK_Value_s16 0 NO_FORMULA -300 0 FORMAT "%.2" /end CHARACTERISTIC
/begin CHARACTERISTIC R_Vhms_Average_Ratio_M061 "R档Vhms平均值缓冲比例" VALUE 0xF166D ECTEK_Value_u16 0 NO_FORMULA 1 500 FORMAT "%.2" /end CHARACTERISTIC
/begin CHARACTERISTIC D_Vhms_Average_Ratio_M061 "D档Vhms平均值缓冲比例" VALUE 0xF166F ECTEK_Value_u16 0 NO_FORMULA 1 500 FORMAT "%.2" /end CHARACTERISTIC
/begin CHARACTERISTIC Motor_Speed_Torque_M061 "转速_最大转矩_旭利、230(500)Nm、50(90)KW、2100(6000)rpm 、比例44.83" CURVE 0xF1671 ECTEK_Curve_u16s16 0 NO_FORMULA 0 5000
 /begin AXIS_DESCR STD_AXIS NO_INPUT_QUANTITY rpm1-1 27 -15000 15000 DEPOSIT ABSOLUTE FORMAT "%.2" /end AXIS_DESCR
 FORMAT "%.2" /end CHARACTERISTIC
/begin CHARACTERISTIC Speed_Vmh10ms_Crawl_D_M061 "D档蠕动 转速-AD曲线 rpm----mh10ms" CURVE 0xF16DF ECTEK_Curve_s16s16 0 Vmh10ms -500 500
 /begin AXIS_DESCR STD_AXIS NO_INPUT_QUANTITY rpm1-1 10 -15000 15000 DEPOSIT ABSOLUTE FORMAT "%.2" /end AXIS_DESCR
 FORMAT "%.2" /end CHARACTERISTIC
/begin CHARACTERISTIC Torque_Increment_Crawl_D_M061 "D档蠕动 AD修正转矩给定每周期增量" CURVE 0xF1709 ECTEK_Curve_s16s16 0 NO_FORMULA -100 100
 /begin AXIS_DESCR STD_AXIS NO_INPUT_QUANTITY Vmh10ms 11 -1000 1000 DEPOSIT ABSOLUTE FORMAT "%.2" /end AXIS_DESCR
 FORMAT "%.2" /end CHARACTERISTIC
/begin CHARACTERISTIC Speed_Max_Torque_Crawl_D_M061 "D档蠕行模式最大力矩" CURVE 0xF1737 ECTEK_Curve_u16s16 0 NO_FORMULA 0 5000
 /begin AXIS_DESCR STD_AXIS NO_INPUT_QUANTITY rpm1-1 9 -15000 15000 DEPOSIT ABSOLUTE FORMAT "%.2" /end AXIS_DESCR
 FORMAT "%.2" /end CHARACTERISTIC
/begin CHARACTERISTIC Speed_Max_Torque_Crawl_D_Break_M061 "D档蠕行制动状态下最大驱动力矩" CURVE 0xF175D ECTEK_Curve_u16s16 0 NO_FORMULA 0 5000
 /begin AXIS_DESCR STD_AXIS NO_INPUT_QUANTITY rpm1-1 9 -15000 15000 DEPOSIT ABSOLUTE FORMAT "%.2" /end AXIS_DESCR
 FORMAT "%.2" /end CHARACTERISTIC
/begin CHARACTERISTIC Speed_Vmh10ms_General_M061 "通用相对转速-AD曲线 rpm----mh10ms" CURVE 0xF1783 ECTEK_Curve_s16s16 0 Vmh10ms -1000 1000
 /begin AXIS_DESCR STD_AXIS NO_INPUT_QUANTITY rpm1-1 11 -30000 30000 DEPOSIT ABSOLUTE FORMAT "%.2" /end AXIS_DESCR
 FORMAT "%.2" /end CHARACTERISTIC
/begin CHARACTERISTIC Torque_Increment_General_M061 "通用AD修正转矩给定每周期增量" CURVE 0xF17B1 ECTEK_Curve_s16s16 0 NO_FORMULA -100 100
 /begin AXIS_DESCR STD_AXIS NO_INPUT_QUANTITY Vmh10ms 11 -1000 1000 DEPOSIT ABSOLUTE FORMAT "%.2" /end AXIS_DESCR
 FORMAT "%.2" /end CHARACTERISTIC
/begin CHARACTERISTIC Speed_Vmh10ms_D_Park_M061 "D档驻坡 转速-AD曲线 rpm----mh10ms" CURVE 0xF17DF ECTEK_Curve_s16s16 0 Vmh10ms -1000 1000
 /begin AXIS_DESCR STD_AXIS NO_INPUT_QUANTITY rpm1-1 12 -15000 15000 DEPOSIT ABSOLUTE FORMAT "%.2" /end AXIS_DESCR
 FORMAT "%.2" /end CHARACTERISTIC
/begin CHARACTERISTIC Torque_Increment_D_Park_M061 "D档驻坡AD修正转矩给定每周期增量" CURVE 0xF1811 ECTEK_Curve_s16s16 0 NO_FORMULA -100 100
 /begin AXIS_DESCR STD_AXIS NO_INPUT_QUANTITY Vmh10ms 11 -1000 1000 DEPOSIT ABSOLUTE FORMAT "%.2" /end AXIS_DESCR
 FORMAT "%.2" /end CHARACTERISTIC
/begin CHARACTERISTIC Motor_Speed_Torque_Break_M061 "电机最大制动力矩" CURVE 0xF183F ECTEK_Curve_s16s16 0 NO_FORMULA 0 1000
 /begin AXIS_DESCR STD_AXIS NO_INPUT_QUANTITY rpm1-1 14 -15000 15000 DEPOSIT ABSOLUTE FORMAT "%.2" /end AXIS_DESCR
 FORMAT "%.2" /end CHARACTERISTIC
/begin CHARACTERISTIC FeedBack_Coast_D_Torque_M061 "D档滑行回馈 速度-力矩 定点" CURVE 0xF1879 ECTEK_Curve_s16s16 0 NO_FORMULA -1000 1000
 /begin AXIS_DESCR STD_AXIS NO_INPUT_QUANTITY rpm1-1 8 -15000 15000 DEPOSIT ABSOLUTE FORMAT "%.2" /end AXIS_DESCR
 FORMAT "%.2" /end CHARACTERISTIC
/begin CHARACTERISTIC FeedBack_Break_D_Torque_M061 "D档制动回馈 速度-力矩 定点" CURVE 0xF189B ECTEK_Curve_s16s16 0 NO_FORMULA -1000 1000
 /begin AXIS_DESCR STD_AXIS NO_INPUT_QUANTITY rpm1-1 8 -15000 15000 DEPOSIT ABSOLUTE FORMAT "%.2" /end AXIS_DESCR
 FORMAT "%.2" /end CHARACTERISTIC
/begin CHARACTERISTIC Speed_Efficieny_M061 "电机速度-转换效率曲线" CURVE 0xF18BD ECTEK_Curve_u16u16 0 rFactor100_PWM 0 100
 /begin AXIS_DESCR STD_AXIS NO_INPUT_QUANTITY rpm1-1 17 0 15000 DEPOSIT ABSOLUTE FORMAT "%.2" /end AXIS_DESCR
 FORMAT "%.2" /end CHARACTERISTIC
/begin CHARACTERISTIC Speed_Efficieny_FeedBack_M061 "电机速度-转换效率曲线 发电" CURVE 0xF1903 ECTEK_Curve_u16u16 0 rFactor100_PWM 0 100
 /begin AXIS_DESCR STD_AXIS NO_INPUT_QUANTITY rpm1-1 17 0 15000 DEPOSIT ABSOLUTE FORMAT "%.2" /end AXIS_DESCR
 FORMAT "%.2" /end CHARACTERISTIC
/begin CHARACTERISTIC AutoPark_Motor_Speed_Torque_M061 "驻坡最大力矩" CURVE 0xF1949 ECTEK_Curve_u16s16 0 NO_FORMULA 0 5000
 /begin AXIS_DESCR STD_AXIS NO_INPUT_QUANTITY rpm1-1 9 -15000 15000 DEPOSIT ABSOLUTE FORMAT "%.2" /end AXIS_DESCR
 FORMAT "%.2" /end CHARACTERISTIC
/begin CHARACTERISTIC Speed_Efficieny_M062 "电机速度-转换效率曲线" CURVE 0xF196F ECTEK_Curve_u16u16 0 rFactor100_PWM 0 100
 /begin AXIS_DESCR STD_AXIS NO_INPUT_QUANTITY rpm1-1 28 0 15000 DEPOSIT ABSOLUTE FORMAT "%.2" /end AXIS_DESCR
 FORMAT "%.2" /end CHARACTERISTIC
/begin CHARACTERISTIC Speed_Efficieny_FeedBack_M062 "电机速度-转换效率曲线 发电" CURVE 0xF19E1 ECTEK_Curve_u16u16 0 rFactor100_PWM 0 100
 /begin AXIS_DESCR STD_AXIS NO_INPUT_QUANTITY rpm1-1 28 0 15000 DEPOSIT ABSOLUTE FORMAT "%.2" /end AXIS_DESCR
 FORMAT "%.2" /end CHARACTERISTIC
/begin CHARACTERISTIC Motor_Vehicle_Speed_Scale_M09 "转速-车速比例， 优优114.411 D11 36.632" VALUE 0xF1A53 ECTEK_Value_u8 0 NO_COMPU_METHOD 0 255 FORMAT "%.2" /end CHARACTERISTIC
/begin CHARACTERISTIC Demand_Limit_High_M09 "速度上限" VALUE 0xF1A54 ECTEK_Value_u16 0 NO_COMPU_METHOD 0 4095 FORMAT "%.2" /end CHARACTERISTIC
/begin CHARACTERISTIC Demand_Limit_Low_M09 "速度下限" VALUE 0xF1A56 ECTEK_Value_u16 0 NO_COMPU_METHOD 0 4095 FORMAT "%.2" /end CHARACTERISTIC
/begin CHARACTERISTIC Crawl_D_Speed_Max_M09 "D蠕动最大速度 从其他状态进入蠕动的速度" VALUE 0xF1A58 ECTEK_Value_u16 0 NO_COMPU_METHOD 0 1000 FORMAT "%.2" /end CHARACTERISTIC
/begin CHARACTERISTIC Crawl_D_Torque_Delay_Max_M09 "蠕动更新间隔 单位10ms" VALUE 0xF1A5A ECTEK_Value_u8 0 NO_COMPU_METHOD 1 255 FORMAT "%.2" /end CHARACTERISTIC
/begin CHARACTERISTIC Crawl_D_Torque_Delay_Start_Max_M09 "起步蠕动更新间隔 单位10ms" VALUE 0xF1A5B ECTEK_Value_u8 0 NO_FORMULA 0 255 FORMAT "%.2" /end CHARACTERISTIC
/begin CHARACTERISTIC Speed_Buffer_Number_M09 "10ms车辆速度采样缓冲次数" VALUE 0xF1A5C ECTEK_Value_u8 0 NO_COMPU_METHOD 1 69 FORMAT "%.2" /end CHARACTERISTIC
/begin CHARACTERISTIC Speed_Average_Number_M09 "10ms平均车速缓冲次数" VALUE 0xF1A5D ECTEK_Value_u8 0 NO_COMPU_METHOD 1 69 FORMAT "%.2" /end CHARACTERISTIC
/begin CHARACTERISTIC Torque_Buffer_Number_AutoPark_M09 "10ms车辆平均转矩采样缓冲次数 驻坡" VALUE 0xF1A5E ECTEK_Value_u8 0 NO_COMPU_METHOD 1 69 FORMAT "%.2" /end CHARACTERISTIC
/begin CHARACTERISTIC D_Park_Start_Speed_M09 "D驻坡触发转速" VALUE 0xF1A5F ECTEK_Value_u8 0 NO_COMPU_METHOD 0 255 FORMAT "%.2" /end CHARACTERISTIC
/begin CHARACTERISTIC Auto_Park_Speed_Acc_Max_M09 "激活D驻坡最大退行转速累加" VALUE 0xF1A60 ECTEK_Value_s16 0 NO_FORMULA -32768 32767 FORMAT "%.2" /end CHARACTERISTIC
/begin CHARACTERISTIC Auto_Park_Speed_Times_Max_M09 "激活D驻坡最大退行增速时间 单位10ms" VALUE 0xF1A62 ECTEK_Value_u16 0 NO_FORMULA 0 65535 FORMAT "%.2" /end CHARACTERISTIC
/begin CHARACTERISTIC Auto_Torque_Min_M09 "自动转矩最小正值" VALUE 0xF1A64 ECTEK_Value_s16 0 NO_COMPU_METHOD 0 300 FORMAT "%.2" /end CHARACTERISTIC
/begin CHARACTERISTIC Auto_Torque_Max_M09 "自动转矩最大负值" VALUE 0xF1A66 ECTEK_Value_s16 0 NO_FORMULA -300 0 FORMAT "%.2" /end CHARACTERISTIC
/begin CHARACTERISTIC R_Vhms_Average_Ratio_M09 "R档Vhms平均值缓冲比例" VALUE 0xF1A68 ECTEK_Value_u16 0 NO_FORMULA 1 500 FORMAT "%.2" /end CHARACTERISTIC
/begin CHARACTERISTIC D_Vhms_Average_Ratio_M09 "D档Vhms平均值缓冲比例" VALUE 0xF1A6A ECTEK_Value_u16 0 NO_FORMULA 1 500 FORMAT "%.2" /end CHARACTERISTIC
/begin CHARACTERISTIC Motor_Speed_Torque_M09 "转速_最大转矩_大地和350-700Nm 70-100KW 比例36.632" CURVE 0xF1A6C ECTEK_Curve_u16s16 0 NO_FORMULA 0 5000
 /begin AXIS_DESCR STD_AXIS NO_INPUT_QUANTITY rpm1-1 28 -15000 15000 DEPOSIT ABSOLUTE FORMAT "%.2" /end AXIS_DESCR
 FORMAT "%.2" /end CHARACTERISTIC
/begin CHARACTERISTIC Speed_Vmh10ms_Crawl_D_M09 "D档蠕动 转速-AD曲线 rpm----mh10ms" CURVE 0xF1ADE ECTEK_Curve_s16s16 0 Vmh10ms -500 500
 /begin AXIS_DESCR STD_AXIS NO_INPUT_QUANTITY rpm1-1 10 -15000 15000 DEPOSIT ABSOLUTE FORMAT "%.2" /end AXIS_DESCR
 FORMAT "%.2" /end CHARACTERISTIC
/begin CHARACTERISTIC Torque_Increment_Crawl_D_M09 "D档蠕动 AD修正转矩给定每周期增量" CURVE 0xF1B08 ECTEK_Curve_s16s16 0 NO_FORMULA -100 100
 /begin AXIS_DESCR STD_AXIS NO_INPUT_QUANTITY Vmh10ms 11 -1000 1000 DEPOSIT ABSOLUTE FORMAT "%.2" /end AXIS_DESCR
 FORMAT "%.2" /end CHARACTERISTIC
/begin CHARACTERISTIC Speed_Max_Torque_Crawl_D_M09 "D档蠕行模式最大力矩" CURVE 0xF1B36 ECTEK_Curve_u16s16 0 NO_FORMULA 0 5000
 /begin AXIS_DESCR STD_AXIS NO_INPUT_QUANTITY rpm1-1 9 -15000 15000 DEPOSIT ABSOLUTE FORMAT "%.2" /end AXIS_DESCR
 FORMAT "%.2" /end CHARACTERISTIC
/begin CHARACTERISTIC Speed_Max_Torque_Crawl_D_Break_M09 "D档蠕行制动状态下最大驱动力矩" CURVE 0xF1B5C ECTEK_Curve_u16s16 0 NO_FORMULA 0 5000
 /begin AXIS_DESCR STD_AXIS NO_INPUT_QUANTITY rpm1-1 9 -15000 15000 DEPOSIT ABSOLUTE FORMAT "%.2" /end AXIS_DESCR
 FORMAT "%.2" /end CHARACTERISTIC
/begin CHARACTERISTIC Speed_Vmh10ms_General_M09 "通用相对转速-AD曲线 rpm----mh10ms" CURVE 0xF1B82 ECTEK_Curve_s16s16 0 Vmh10ms -1000 1000
 /begin AXIS_DESCR STD_AXIS NO_INPUT_QUANTITY rpm1-1 11 -30000 30000 DEPOSIT ABSOLUTE FORMAT "%.2" /end AXIS_DESCR
 FORMAT "%.2" /end CHARACTERISTIC
/begin CHARACTERISTIC Torque_Increment_General_M09 "通用AD修正转矩给定每周期增量" CURVE 0xF1BB0 ECTEK_Curve_s16s16 0 NO_FORMULA -100 100
 /begin AXIS_DESCR STD_AXIS NO_INPUT_QUANTITY Vmh10ms 11 -1000 1000 DEPOSIT ABSOLUTE FORMAT "%.2" /end AXIS_DESCR
 FORMAT "%.2" /end CHARACTERISTIC
/begin CHARACTERISTIC Speed_Vmh10ms_D_Park_M09 "D档驻坡 转速-AD曲线 rpm----mh10ms" CURVE 0xF1BDE ECTEK_Curve_s16s16 0 Vmh10ms -1000 1000
 /begin AXIS_DESCR STD_AXIS NO_INPUT_QUANTITY rpm1-1 12 -15000 15000 DEPOSIT ABSOLUTE FORMAT "%.2" /end AXIS_DESCR
 FORMAT "%.2" /end CHARACTERISTIC
/begin CHARACTERISTIC Torque_Increment_D_Park_M09 "D档驻坡AD修正转矩给定每周期增量" CURVE 0xF1C10 ECTEK_Curve_s16s16 0 NO_FORMULA -100 100
 /begin AXIS_DESCR STD_AXIS NO_INPUT_QUANTITY Vmh10ms 11 -1000 1000 DEPOSIT ABSOLUTE FORMAT "%.2" /end AXIS_DESCR
 FORMAT "%.2" /end CHARACTERISTIC
/begin CHARACTERISTIC Motor_Speed_Torque_Break_M09 "电机最大制动力矩" CURVE 0xF1C3E ECTEK_Curve_s16s16 0 NO_FORMULA 0 1000
 /begin AXIS_DESCR STD_AXIS NO_INPUT_QUANTITY rpm1-1 14 -15000 15000 DEPOSIT ABSOLUTE FORMAT "%.2" /end AXIS_DESCR
 FORMAT "%.2" /end CHARACTERISTIC
/begin CHARACTERISTIC FeedBack_Coast_D_Torque_M09 "D档滑行回馈 速度-力矩 定点" CURVE 0xF1C78 ECTEK_Curve_s16s16 0 NO_FORMULA -1000 1000
 /begin AXIS_DESCR STD_AXIS NO_INPUT_QUANTITY rpm1-1 8 -15000 15000 DEPOSIT ABSOLUTE FORMAT "%.2" /end AXIS_DESCR
 FORMAT "%.2" /end CHARACTERISTIC
/begin CHARACTERISTIC FeedBack_Break_D_Torque_M09 "D档制动回馈 速度-力矩 定点" CURVE 0xF1C9A ECTEK_Curve_s16s16 0 NO_FORMULA -1000 1000
 /begin AXIS_DESCR STD_AXIS NO_INPUT_QUANTITY rpm1-1 8 -15000 15000 DEPOSIT ABSOLUTE FORMAT "%.2" /end AXIS_DESCR
 FORMAT "%.2" /end CHARACTERISTIC
/begin CHARACTERISTIC Speed_Efficieny_M09 "电机速度-转换效率曲线" CURVE 0xF1CBC ECTEK_Curve_u16u16 0 rFactor100_PWM 0 100
 /begin AXIS_DESCR STD_AXIS NO_INPUT_QUANTITY rpm1-1 17 0 15000 DEPOSIT ABSOLUTE FORMAT "%.2" /end AXIS_DESCR
 FORMAT "%.2" /end CHARACTERISTIC
/begin CHARACTERISTIC AutoPark_Motor_Speed_Torque_M09 "驻坡最大力矩" CURVE 0xF1D02 ECTEK_Curve_u16s16 0 NO_FORMULA 0 5000
 /begin AXIS_DESCR STD_AXIS NO_INPUT_QUANTITY rpm1-1 9 -15000 15000 DEPOSIT ABSOLUTE FORMAT "%.2" /end AXIS_DESCR
 FORMAT "%.2" /end CHARACTERISTIC
/begin CHARACTERISTIC Tire_Pressure_Low_Level_M10 "胎压过低报警压力" VALUE 0xF1D28 ECTEK_Value_u16 0 rFactor10_VSSPlaus 0 1397 FORMAT "%.2" /end CHARACTERISTIC
/begin CHARACTERISTIC Motor_Vehicle_Speed_Scale_M10 "转速-车速比例， D08 75.15" VALUE 0xF1D2A ECTEK_Value_u8 0 NO_FORMULA 0 255 FORMAT "%.2" /end CHARACTERISTIC
/begin CHARACTERISTIC Demand_Limit_High_M10 "转速上线 *4" VALUE 0xF1D2B ECTEK_Value_u16 0 NO_FORMULA -0 4095 FORMAT "%.2" /end CHARACTERISTIC
/begin CHARACTERISTIC Demand_Limit_Low_M10 "速度下限" VALUE 0xF1D2D ECTEK_Value_u16 0 NO_FORMULA -0 4095 FORMAT "%.2" /end CHARACTERISTIC
/begin CHARACTERISTIC Crawl_D_Speed_Max_M10 "D蠕动最大速度 从其他状态进入蠕动的速度" VALUE 0xF1D2F ECTEK_Value_u16 0 rpm1-1 -0 1000 FORMAT "%.2" /end CHARACTERISTIC
/begin CHARACTERISTIC Crawl_D_Torque_Delay_Max_M10 "蠕动更新间隔 单位10ms" VALUE 0xF1D31 ECTEK_Value_u8 0 NO_FORMULA -0 255 FORMAT "%.2" /end CHARACTERISTIC
/begin CHARACTERISTIC Crawl_D_Torque_Delay_Start_Max_M10 "起步蠕动更新间隔 单位10ms" VALUE 0xF1D32 ECTEK_Value_u8 0 NO_COMPU_METHOD -4294967296 4294967296 FORMAT "%.2" /end CHARACTERISTIC
/begin CHARACTERISTIC Speed_Buffer_Number_M10 "10ms车辆速度采样缓冲次数" VALUE 0xF1D33 ECTEK_Value_u8 0 NO_FORMULA -0 69 FORMAT "%.2" /end CHARACTERISTIC
/begin CHARACTERISTIC Speed_Average_Number_M10 "10ms平均车速缓冲次数" VALUE 0xF1D34 ECTEK_Value_u8 0 NO_FORMULA -0 69 FORMAT "%.2" /end CHARACTERISTIC
/begin CHARACTERISTIC Torque_Buffer_Number_AutoPark_M10 "10ms平均转矩缓冲次数" VALUE 0xF1D35 ECTEK_Value_u8 0 NO_FORMULA -0 69 FORMAT "%.2" /end CHARACTERISTIC
/begin CHARACTERISTIC D_Park_Start_Speed_M10 "D驻坡触发转速" VALUE 0xF1D36 ECTEK_Value_u8 0 rpm1-1 -0 255 FORMAT "%.2" /end CHARACTERISTIC
/begin CHARACTERISTIC Auto_Park_Speed_Acc_Max_M10 "激活D驻坡最大退行转速累加" VALUE 0xF1D37 ECTEK_Value_s16 0 NO_FORMULA -32767 32768 FORMAT "%.2" /end CHARACTERISTIC
/begin CHARACTERISTIC Auto_Park_Speed_Times_Max_M10 "激活D驻坡最大退行增速时间 单位10ms" VALUE 0xF1D39 ECTEK_Value_u16 0 NO_FORMULA -0 65535 FORMAT "%.2" /end CHARACTERISTIC
/begin CHARACTERISTIC Auto_Torque_Min_M10 "自动转矩最小正值" VALUE 0xF1D3B ECTEK_Value_s16 0 NO_FORMULA 0 150 FORMAT "%.2" /end CHARACTERISTIC
/begin CHARACTERISTIC Auto_Torque_Max_M10 "自动转矩最大负值" VALUE 0xF1D3D ECTEK_Value_s16 0 NO_FORMULA -150 0 FORMAT "%.2" /end CHARACTERISTIC
/begin CHARACTERISTIC R_Vhms_Average_Ratio_M10 "R档Vhms平均值缓冲比例" VALUE 0xF1D3F ECTEK_Value_u16 0 NO_FORMULA 1 500 FORMAT "%.2" /end CHARACTERISTIC
/begin CHARACTERISTIC D_Vhms_Average_Ratio_M10 "D档Vhms平均值缓冲比例" VALUE 0xF1D41 ECTEK_Value_u16 0 NO_FORMULA 1 500 FORMAT "%.2" /end CHARACTERISTIC
/begin CHARACTERISTIC Motor_Speed_Torque_M10 "转速_最大转矩 易动 200Nm 60KW 75" CURVE 0xF1D43 ECTEK_Curve_u16s16 0 NO_FORMULA -5000 5000
 /begin AXIS_DESCR STD_AXIS NO_INPUT_QUANTITY rpm1-1 28 -15000 15000 DEPOSIT ABSOLUTE FORMAT "%.2" /end AXIS_DESCR
 FORMAT "%.2" /end CHARACTERISTIC
/begin CHARACTERISTIC AccPed_Rip_M10 "油门曲线" CURVE 0xF1DB5 ECTEK_Curve_u16u16 0 rFactor100_PWM -0 100
 /begin AXIS_DESCR STD_AXIS NO_INPUT_QUANTITY rFactor100_PWM 11 -0 100 DEPOSIT ABSOLUTE FORMAT "%.2" /end AXIS_DESCR
 FORMAT "%.2" /end CHARACTERISTIC
/begin CHARACTERISTIC Speed_Vmh10ms_Crawl_D_M10 "D档蠕动 转速-AD曲线 rpm----mh10ms" CURVE 0xF1DE3 ECTEK_Curve_s16s16 0 Vmh10ms -500 500
 /begin AXIS_DESCR STD_AXIS NO_INPUT_QUANTITY rpm1-1 10 -15000 15000 DEPOSIT ABSOLUTE FORMAT "%.2" /end AXIS_DESCR
 FORMAT "%.2" /end CHARACTERISTIC
/begin CHARACTERISTIC Torque_Increment_Crawl_D_M10 "D档蠕动 AD修正转矩给定每周期增量" CURVE 0xF1E0D ECTEK_Curve_s16s16 0 NO_FORMULA -100 100
 /begin AXIS_DESCR STD_AXIS NO_INPUT_QUANTITY Vmh10ms 11 -1000 1000 DEPOSIT ABSOLUTE FORMAT "%.2" /end AXIS_DESCR
 FORMAT "%.2" /end CHARACTERISTIC
/begin CHARACTERISTIC Speed_Max_Torque_Crawl_D_M10 "D档蠕行模式最大力矩" CURVE 0xF1E3B ECTEK_Curve_u16s16 0 NO_FORMULA -5000 5000
 /begin AXIS_DESCR STD_AXIS NO_INPUT_QUANTITY rpm1-1 9 -15000 15000 DEPOSIT ABSOLUTE FORMAT "%.2" /end AXIS_DESCR
 FORMAT "%.2" /end CHARACTERISTIC
/begin CHARACTERISTIC Speed_Max_Torque_Crawl_D_Break_M10 "D档蠕行制动状态下最大驱动力矩" CURVE 0xF1E61 ECTEK_Curve_u16s16 0 NO_FORMULA -1000 1000
 /begin AXIS_DESCR STD_AXIS NO_INPUT_QUANTITY rpm1-1 9 -15000 15000 DEPOSIT ABSOLUTE FORMAT "%.2" /end AXIS_DESCR
 FORMAT "%.2" /end CHARACTERISTIC
/begin CHARACTERISTIC Speed_Vmh10ms_General_M10 "通用相对转速-AD曲线 rpm----mh10ms" CURVE 0xF1E87 ECTEK_Curve_s16s16 0 Vmh10ms -500 500
 /begin AXIS_DESCR STD_AXIS NO_INPUT_QUANTITY rpm1-1 11 -30000 30000 DEPOSIT ABSOLUTE FORMAT "%.2" /end AXIS_DESCR
 FORMAT "%.2" /end CHARACTERISTIC
/begin CHARACTERISTIC Torque_Increment_General_M10 "通用AD修正转矩给定每周期增量" CURVE 0xF1EB5 ECTEK_Curve_s16s16 0 NO_FORMULA -100 100
 /begin AXIS_DESCR STD_AXIS NO_INPUT_QUANTITY Vmh10ms 11 -1000 1000 DEPOSIT ABSOLUTE FORMAT "%.2" /end AXIS_DESCR
 FORMAT "%.2" /end CHARACTERISTIC
/begin CHARACTERISTIC Speed_Vmh10ms_D_Park_M10 "D档驻坡 转速-AD曲线 rpm----mh10ms" CURVE 0xF1EE3 ECTEK_Curve_s16s16 0 Vmh10ms -500 500
 /begin AXIS_DESCR STD_AXIS NO_INPUT_QUANTITY rpm1-1 12 -15000 15000 DEPOSIT ABSOLUTE FORMAT "%.2" /end AXIS_DESCR
 FORMAT "%.2" /end CHARACTERISTIC
/begin CHARACTERISTIC Torque_Increment_D_Park_M10 "D档驻坡AD修正转矩给定每周期增量" CURVE 0xF1F15 ECTEK_Curve_s16s16 0 NO_FORMULA -100 100
 /begin AXIS_DESCR STD_AXIS NO_INPUT_QUANTITY Vmh10ms 11 -1000 1000 DEPOSIT ABSOLUTE FORMAT "%.2" /end AXIS_DESCR
 FORMAT "%.2" /end CHARACTERISTIC
/begin CHARACTERISTIC Motor_Speed_Torque_Break_M10 "电机最大制动力矩" CURVE 0xF1F43 ECTEK_Curve_s16s16 0 NO_FORMULA -5000 5000
 /begin AXIS_DESCR STD_AXIS NO_INPUT_QUANTITY rpm1-1 14 -15000 15000 DEPOSIT ABSOLUTE FORMAT "%.2" /end AXIS_DESCR
 FORMAT "%.2" /end CHARACTERISTIC
/begin CHARACTERISTIC FeedBack_Coast_D_Torque_M10 "D档滑行回馈 速度-力矩 定点" CURVE 0xF1F7D ECTEK_Curve_s16s16 0 NO_FORMULA -5000 5000
 /begin AXIS_DESCR STD_AXIS NO_INPUT_QUANTITY rpm1-1 8 -15000 15000 DEPOSIT ABSOLUTE FORMAT "%.2" /end AXIS_DESCR
 FORMAT "%.2" /end CHARACTERISTIC
/begin CHARACTERISTIC FeedBack_Break_D_Torque_M10 "D档制动回馈 速度-力矩 定点" CURVE 0xF1F9F ECTEK_Curve_s16s16 0 NO_FORMULA -5000 5000
 /begin AXIS_DESCR STD_AXIS NO_INPUT_QUANTITY rpm1-1 8 -15000 15000 DEPOSIT ABSOLUTE FORMAT "%.2" /end AXIS_DESCR
 FORMAT "%.2" /end CHARACTERISTIC
/begin CHARACTERISTIC Speed_Efficieny_M10 "电机速度-转换效率曲线 驱动" CURVE 0xF1FC1 ECTEK_Curve_u16u16 0 rFactor100_PWM 0 100
 /begin AXIS_DESCR STD_AXIS NO_INPUT_QUANTITY rpm1-1 20 0 15000 DEPOSIT ABSOLUTE FORMAT "%.2" /end AXIS_DESCR
 FORMAT "%.2" /end CHARACTERISTIC
/begin CHARACTERISTIC Speed_Efficieny_FeedBack_M10 "电机速度-转换效率曲线 发电" CURVE 0xF2013 ECTEK_Curve_u16u16 0 rFactor100_PWM 0 150
 /begin AXIS_DESCR STD_AXIS NO_INPUT_QUANTITY rpm1-1 20 0 15000 DEPOSIT ABSOLUTE FORMAT "%.2" /end AXIS_DESCR
 FORMAT "%.2" /end CHARACTERISTIC
/begin CHARACTERISTIC AutoPark_Motor_Speed_Torque_M10 "驻坡最大力矩" CURVE 0xF2065 ECTEK_Curve_u16s16 0 NO_FORMULA 0 5000
 /begin AXIS_DESCR STD_AXIS NO_INPUT_QUANTITY rpm1-1 8 -15000 15000 DEPOSIT ABSOLUTE FORMAT "%.2" /end AXIS_DESCR
 FORMAT "%.2" /end CHARACTERISTIC
/begin CHARACTERISTIC AccPedCD_rUW_CUR_M10 "油门开度" CURVE 0xF2087 ECTEK_Curve_u16u16 0 rFactor100_PWM 0 100
 /begin AXIS_DESCR STD_AXIS NO_INPUT_QUANTITY u5V 7 0 5 DEPOSIT ABSOLUTE FORMAT "%.2" /end AXIS_DESCR
 FORMAT "%.2" /end CHARACTERISTIC
/begin CHARACTERISTIC AccPedCD_rUW_CUR2_M10 "油门2开度" CURVE 0xF20A5 ECTEK_Curve_u16u16 0 rFactor100_PWM 0 100
 /begin AXIS_DESCR STD_AXIS NO_INPUT_QUANTITY u5V 7 0 5 DEPOSIT ABSOLUTE FORMAT "%.2" /end AXIS_DESCR
 FORMAT "%.2" /end CHARACTERISTIC
/begin CHARACTERISTIC EPS_Speed_M10 "D08L EPS频率与转速对应曲线 1.2~120Hz 低频" CURVE 0xF20C3 ECTEK_Curve_u16s16 0 PWM_Hz100 1.2 600
 /begin AXIS_DESCR STD_AXIS NO_INPUT_QUANTITY rpm1-1 6 -15000 15000 DEPOSIT ABSOLUTE FORMAT "%.2" /end AXIS_DESCR
/end CHARACTERISTIC
/begin CHARACTERISTIC AC_Condenser_Temp_M10 "空调蒸发器温度 上拉100K 下拉10K" CURVE 0xF20DD ECTEK_Curve_s16u16 0 Temp -100 150
 /begin AXIS_DESCR STD_AXIS NO_INPUT_QUANTITY NO_FORMULA 31 0 4095 DEPOSIT ABSOLUTE FORMAT "%.2" /end AXIS_DESCR
 FORMAT "%.2" /end CHARACTERISTIC
/begin CHARACTERISTIC AC_Condenser_Temp_M10_ACES "空调蒸发器温度_奥易克斯 上拉2.74K 下拉500K" CURVE 0xF215B ECTEK_Curve_s16u16 0 Temp -100 150
 /begin AXIS_DESCR STD_AXIS NO_INPUT_QUANTITY NO_FORMULA 29 0 4095 DEPOSIT ABSOLUTE FORMAT "%.2" /end AXIS_DESCR
 FORMAT "%.2" /end CHARACTERISTIC
/begin CHARACTERISTIC Motor_Vehicle_Speed_Scale_M101 "转速-车速比例， D08 75.15" VALUE 0xF21D1 ECTEK_Value_u8 0 NO_FORMULA 0 255 FORMAT "%.2" /end CHARACTERISTIC
/begin CHARACTERISTIC Demand_Limit_High_M101 "转速上线 *4" VALUE 0xF21D2 ECTEK_Value_u16 0 NO_FORMULA -0 4095 FORMAT "%.2" /end CHARACTERISTIC
/begin CHARACTERISTIC Demand_Limit_Low_M101 "速度下限" VALUE 0xF21D4 ECTEK_Value_u16 0 NO_FORMULA -0 4095 FORMAT "%.2" /end CHARACTERISTIC
/begin CHARACTERISTIC Crawl_D_Speed_Max_M101 "D蠕动最大速度 从其他状态进入蠕动的速度" VALUE 0xF21D6 ECTEK_Value_u16 0 rpm1-1 -0 1000 FORMAT "%.2" /end CHARACTERISTIC
/begin CHARACTERISTIC Crawl_D_Torque_Delay_Max_M101 "蠕动更新间隔 单位10ms" VALUE 0xF21D8 ECTEK_Value_u8 0 NO_FORMULA -0 255 FORMAT "%.2" /end CHARACTERISTIC
/begin CHARACTERISTIC Crawl_D_Torque_Delay_Start_Max_M101 "起步蠕动更新间隔 单位10ms" VALUE 0xF21D9 ECTEK_Value_u8 0 NO_COMPU_METHOD -4294967296 4294967296 FORMAT "%.2" /end CHARACTERISTIC
/begin CHARACTERISTIC Speed_Buffer_Number_M101 "10ms车辆速度采样缓冲次数" VALUE 0xF21DA ECTEK_Value_u8 0 NO_FORMULA -0 69 FORMAT "%.2" /end CHARACTERISTIC
/begin CHARACTERISTIC Speed_Average_Number_M101 "10ms平均车速缓冲次数" VALUE 0xF21DB ECTEK_Value_u8 0 NO_FORMULA -0 69 FORMAT "%.2" /end CHARACTERISTIC
/begin CHARACTERISTIC Torque_Buffer_Number_AutoPark_M101 "10ms平均转矩缓冲次数" VALUE 0xF21DC ECTEK_Value_u8 0 NO_FORMULA -0 69 FORMAT "%.2" /end CHARACTERISTIC
/begin CHARACTERISTIC D_Park_Start_Speed_M101 "D驻坡触发转速" VALUE 0xF21DD ECTEK_Value_u8 0 rpm1-1 -0 255 FORMAT "%.2" /end CHARACTERISTIC
/begin CHARACTERISTIC Auto_Park_Speed_Acc_Max_M101 "激活D驻坡最大退行转速累加" VALUE 0xF21DE ECTEK_Value_s16 0 NO_FORMULA -32767 32768 FORMAT "%.2" /end CHARACTERISTIC
/begin CHARACTERISTIC Auto_Park_Speed_Times_Max_M101 "激活D驻坡最大退行增速时间 单位10ms" VALUE 0xF21E0 ECTEK_Value_u16 0 NO_FORMULA -0 65535 FORMAT "%.2" /end CHARACTERISTIC
/begin CHARACTERISTIC Auto_Torque_Min_M101 "自动转矩最小正值" VALUE 0xF21E2 ECTEK_Value_s16 0 NO_FORMULA 0 150 FORMAT "%.2" /end CHARACTERISTIC
/begin CHARACTERISTIC Auto_Torque_Max_M101 "自动转矩最大负值" VALUE 0xF21E4 ECTEK_Value_s16 0 NO_FORMULA -150 0 FORMAT "%.2" /end CHARACTERISTIC
/begin CHARACTERISTIC R_Vhms_Average_Ratio_M101 "R档Vhms平均值缓冲比例" VALUE 0xF21E6 ECTEK_Value_u16 0 NO_FORMULA 1 500 FORMAT "%.2" /end CHARACTERISTIC
/begin CHARACTERISTIC D_Vhms_Average_Ratio_M101 "D档Vhms平均值缓冲比例" VALUE 0xF21E8 ECTEK_Value_u16 0 NO_FORMULA 1 500 FORMAT "%.2" /end CHARACTERISTIC
/begin CHARACTERISTIC Motor_Speed_Torque_M101 "转速_最大转矩 力信 180Nm 50KW 75" CURVE 0xF21EA ECTEK_Curve_u16s16 0 NO_FORMULA -5000 5000
 /begin AXIS_DESCR STD_AXIS NO_INPUT_QUANTITY rpm1-1 21 -15000 15000 DEPOSIT ABSOLUTE FORMAT "%.2" /end AXIS_DESCR
 FORMAT "%.2" /end CHARACTERISTIC
/begin CHARACTERISTIC Speed_Vmh10ms_Crawl_D_M101 "D档蠕动 转速-AD曲线 rpm----mh10ms" CURVE 0xF2240 ECTEK_Curve_s16s16 0 Vmh10ms -500 500
 /begin AXIS_DESCR STD_AXIS NO_INPUT_QUANTITY rpm1-1 10 -15000 15000 DEPOSIT ABSOLUTE FORMAT "%.2" /end AXIS_DESCR
 FORMAT "%.2" /end CHARACTERISTIC
/begin CHARACTERISTIC Torque_Increment_Crawl_D_M101 "D档蠕动 AD修正转矩给定每周期增量" CURVE 0xF226A ECTEK_Curve_s16s16 0 NO_FORMULA -100 100
 /begin AXIS_DESCR STD_AXIS NO_INPUT_QUANTITY Vmh10ms 11 -1000 1000 DEPOSIT ABSOLUTE FORMAT "%.2" /end AXIS_DESCR
 FORMAT "%.2" /end CHARACTERISTIC
/begin CHARACTERISTIC Speed_Max_Torque_Crawl_D_M101 "D档蠕行模式最大力矩" CURVE 0xF2298 ECTEK_Curve_u16s16 0 NO_FORMULA -5000 5000
 /begin AXIS_DESCR STD_AXIS NO_INPUT_QUANTITY rpm1-1 9 -15000 15000 DEPOSIT ABSOLUTE FORMAT "%.2" /end AXIS_DESCR
 FORMAT "%.2" /end CHARACTERISTIC
/begin CHARACTERISTIC Speed_Max_Torque_Crawl_D_Break_M101 "D档蠕行制动状态下最大驱动力矩" CURVE 0xF22BE ECTEK_Curve_u16s16 0 NO_FORMULA -1000 1000
 /begin AXIS_DESCR STD_AXIS NO_INPUT_QUANTITY rpm1-1 9 -15000 15000 DEPOSIT ABSOLUTE FORMAT "%.2" /end AXIS_DESCR
 FORMAT "%.2" /end CHARACTERISTIC
/begin CHARACTERISTIC Speed_Vmh10ms_General_M101 "通用相对转速-AD曲线 rpm----mh10ms" CURVE 0xF22E4 ECTEK_Curve_s16s16 0 Vmh10ms -500 500
 /begin AXIS_DESCR STD_AXIS NO_INPUT_QUANTITY rpm1-1 11 -30000 30000 DEPOSIT ABSOLUTE FORMAT "%.2" /end AXIS_DESCR
 FORMAT "%.2" /end CHARACTERISTIC
/begin CHARACTERISTIC Torque_Increment_General_M101 "通用AD修正转矩给定每周期增量" CURVE 0xF2312 ECTEK_Curve_s16s16 0 NO_FORMULA -100 100
 /begin AXIS_DESCR STD_AXIS NO_INPUT_QUANTITY Vmh10ms 11 -1000 1000 DEPOSIT ABSOLUTE FORMAT "%.2" /end AXIS_DESCR
 FORMAT "%.2" /end CHARACTERISTIC
/begin CHARACTERISTIC Speed_Vmh10ms_D_Park_M101 "D档驻坡 转速-AD曲线 rpm----mh10ms" CURVE 0xF2340 ECTEK_Curve_s16s16 0 Vmh10ms -500 500
 /begin AXIS_DESCR STD_AXIS NO_INPUT_QUANTITY rpm1-1 12 -15000 15000 DEPOSIT ABSOLUTE FORMAT "%.2" /end AXIS_DESCR
 FORMAT "%.2" /end CHARACTERISTIC
/begin CHARACTERISTIC Torque_Increment_D_Park_M101 "D档驻坡AD修正转矩给定每周期增量" CURVE 0xF2372 ECTEK_Curve_s16s16 0 NO_FORMULA -100 100
 /begin AXIS_DESCR STD_AXIS NO_INPUT_QUANTITY Vmh10ms 11 -1000 1000 DEPOSIT ABSOLUTE FORMAT "%.2" /end AXIS_DESCR
 FORMAT "%.2" /end CHARACTERISTIC
/begin CHARACTERISTIC Motor_Speed_Torque_Break_M101 "电机最大制动力矩" CURVE 0xF23A0 ECTEK_Curve_s16s16 0 NO_FORMULA -5000 5000
 /begin AXIS_DESCR STD_AXIS NO_INPUT_QUANTITY rpm1-1 14 -15000 15000 DEPOSIT ABSOLUTE FORMAT "%.2" /end AXIS_DESCR
 FORMAT "%.2" /end CHARACTERISTIC
/begin CHARACTERISTIC FeedBack_Coast_D_Torque_M101 "D档滑行回馈 速度-力矩 定点" CURVE 0xF23DA ECTEK_Curve_s16s16 0 NO_FORMULA -5000 5000
 /begin AXIS_DESCR STD_AXIS NO_INPUT_QUANTITY rpm1-1 8 -15000 15000 DEPOSIT ABSOLUTE FORMAT "%.2" /end AXIS_DESCR
 FORMAT "%.2" /end CHARACTERISTIC
/begin CHARACTERISTIC FeedBack_Break_D_Torque_M101 "D档制动回馈 速度-力矩 定点" CURVE 0xF23FC ECTEK_Curve_s16s16 0 NO_FORMULA -5000 5000
 /begin AXIS_DESCR STD_AXIS NO_INPUT_QUANTITY rpm1-1 8 -15000 15000 DEPOSIT ABSOLUTE FORMAT "%.2" /end AXIS_DESCR
 FORMAT "%.2" /end CHARACTERISTIC
/begin CHARACTERISTIC Speed_Efficieny_M101 "电机速度-转换效率曲线 驱动" CURVE 0xF241E ECTEK_Curve_u16u16 0 rFactor100_PWM 0 100
 /begin AXIS_DESCR STD_AXIS NO_INPUT_QUANTITY rpm1-1 11 0 15000 DEPOSIT ABSOLUTE FORMAT "%.2" /end AXIS_DESCR
 FORMAT "%.2" /end CHARACTERISTIC
/begin CHARACTERISTIC Speed_Efficieny_FeedBack_M101 "电机速度-转换效率曲线 发电" CURVE 0xF244C ECTEK_Curve_u16u16 0 rFactor100_PWM 0 150
 /begin AXIS_DESCR STD_AXIS NO_INPUT_QUANTITY rpm1-1 20 0 15000 DEPOSIT ABSOLUTE FORMAT "%.2" /end AXIS_DESCR
 FORMAT "%.2" /end CHARACTERISTIC
/begin CHARACTERISTIC AutoPark_Motor_Speed_Torque_M101 "驻坡最大力矩" CURVE 0xF249E ECTEK_Curve_u16s16 0 NO_FORMULA 0 5000
 /begin AXIS_DESCR STD_AXIS NO_INPUT_QUANTITY rpm1-1 8 -15000 15000 DEPOSIT ABSOLUTE FORMAT "%.2" /end AXIS_DESCR
 FORMAT "%.2" /end CHARACTERISTIC
/begin CHARACTERISTIC Motor_Vehicle_Speed_Scale_M11 "转速-车速比例， 优优114.411 D11 36.632 D07 62.111 A9 95.064 D07L 68.836 70 7.66后桥" VALUE 0xF24C0 ECTEK_Value_u8 0 NO_FORMULA 0 255 FORMAT "%.2" /end CHARACTERISTIC
/begin CHARACTERISTIC Demand_Limit_High_M11 "转速上线 *4" VALUE 0xF24C1 ECTEK_Value_u16 0 NO_FORMULA -0 4095 FORMAT "%.2" /end CHARACTERISTIC
/begin CHARACTERISTIC Demand_Limit_Low_M11 "速度下限" VALUE 0xF24C3 ECTEK_Value_u16 0 NO_FORMULA -0 4095 FORMAT "%.2" /end CHARACTERISTIC
/begin CHARACTERISTIC Crawl_D_Speed_Max_M11 "D蠕动最大速度 从其他状态进入蠕动的速度" VALUE 0xF24C5 ECTEK_Value_u16 0 rpm1-1 -0 1000 FORMAT "%.2" /end CHARACTERISTIC
/begin CHARACTERISTIC Crawl_D_Torque_Delay_Max_M11 "蠕动更新间隔 单位10ms" VALUE 0xF24C7 ECTEK_Value_u8 0 NO_FORMULA -0 255 FORMAT "%.2" /end CHARACTERISTIC
/begin CHARACTERISTIC Crawl_D_Torque_Delay_Start_Max_M11 "起步蠕动更新间隔 单位10ms" VALUE 0xF24C8 ECTEK_Value_u8 0 NO_COMPU_METHOD -4294967296 4294967296 FORMAT "%.2" /end CHARACTERISTIC
/begin CHARACTERISTIC Speed_Buffer_Number_M11 "10ms车辆速度采样缓冲次数" VALUE 0xF24C9 ECTEK_Value_u8 0 NO_FORMULA 1 69 FORMAT "%.2" /end CHARACTERISTIC
/begin CHARACTERISTIC Speed_Average_Number_M11 "10ms平均车速缓冲次数" VALUE 0xF24CA ECTEK_Value_u8 0 NO_FORMULA 1 69 FORMAT "%.2" /end CHARACTERISTIC
/begin CHARACTERISTIC Torque_Buffer_Number_AutoPark_M11 "10ms平均转矩缓冲次数" VALUE 0xF24CB ECTEK_Value_u8 0 NO_FORMULA -0 69 FORMAT "%.2" /end CHARACTERISTIC
/begin CHARACTERISTIC D_Park_Start_Speed_M11 "D驻坡触发转速" VALUE 0xF24CC ECTEK_Value_u8 0 rpm1-1 -0 255 FORMAT "%.2" /end CHARACTERISTIC
/begin CHARACTERISTIC Auto_Park_Speed_Acc_Max_M11 "激活D驻坡最大退行转速累加" VALUE 0xF24CD ECTEK_Value_s16 0 NO_FORMULA -32767 32768 FORMAT "%.2" /end CHARACTERISTIC
/begin CHARACTERISTIC Auto_Park_Speed_Times_Max_M11 "激活D驻坡最大退行增速时间 单位10ms" VALUE 0xF24CF ECTEK_Value_u16 0 NO_FORMULA -0 65535 FORMAT "%.2" /end CHARACTERISTIC
/begin CHARACTERISTIC Auto_Torque_Min_M11 "自动转矩最小正值" VALUE 0xF24D1 ECTEK_Value_s16 0 NO_FORMULA 0 150 FORMAT "%.2" /end CHARACTERISTIC
/begin CHARACTERISTIC Auto_Torque_Max_M11 "自动转矩最大负值" VALUE 0xF24D3 ECTEK_Value_s16 0 NO_FORMULA -150 0 FORMAT "%.2" /end CHARACTERISTIC
/begin CHARACTERISTIC R_Vhms_Average_Ratio_M11 "R档Vhms平均值缓冲比例" VALUE 0xF24D5 ECTEK_Value_u16 0 NO_FORMULA 1 500 FORMAT "%.2" /end CHARACTERISTIC
/begin CHARACTERISTIC D_Vhms_Average_Ratio_M11 "D档Vhms平均值缓冲比例" VALUE 0xF24D7 ECTEK_Value_u16 0 NO_FORMULA 1 500 FORMAT "%.2" /end CHARACTERISTIC
/begin CHARACTERISTIC Motor_Speed_Torque_M11 "转速_最大转矩 大地和 30KW 150N 95" CURVE 0xF24D9 ECTEK_Curve_u16s16 0 NO_FORMULA -5000 5000
 /begin AXIS_DESCR STD_AXIS NO_INPUT_QUANTITY rpm1-1 26 -15000 15000 DEPOSIT ABSOLUTE FORMAT "%.2" /end AXIS_DESCR
 FORMAT "%.2" /end CHARACTERISTIC
/begin CHARACTERISTIC AccPed_Rip_M11 "油门曲线" CURVE 0xF2543 ECTEK_Curve_u16u16 0 rFactor100_PWM -0 100
 /begin AXIS_DESCR STD_AXIS NO_INPUT_QUANTITY rFactor100_PWM 11 -0 100 DEPOSIT ABSOLUTE FORMAT "%.2" /end AXIS_DESCR
 FORMAT "%.2" /end CHARACTERISTIC
/begin CHARACTERISTIC Speed_Vmh10ms_Crawl_D_M11 "D档蠕动 转速-AD曲线 rpm----mh10ms" CURVE 0xF2571 ECTEK_Curve_s16s16 0 Vmh10ms -500 500
 /begin AXIS_DESCR STD_AXIS NO_INPUT_QUANTITY rpm1-1 10 -15000 15000 DEPOSIT ABSOLUTE FORMAT "%.2" /end AXIS_DESCR
 FORMAT "%.2" /end CHARACTERISTIC
/begin CHARACTERISTIC Torque_Increment_Crawl_D_M11 "D档蠕动 AD修正转矩给定每周期增量" CURVE 0xF259B ECTEK_Curve_s16s16 0 NO_FORMULA -100 100
 /begin AXIS_DESCR STD_AXIS NO_INPUT_QUANTITY Vmh10ms 11 -1000 1000 DEPOSIT ABSOLUTE FORMAT "%.2" /end AXIS_DESCR
 FORMAT "%.2" /end CHARACTERISTIC
/begin CHARACTERISTIC Speed_Max_Torque_Crawl_D_M11 "D档蠕行模式最大力矩" CURVE 0xF25C9 ECTEK_Curve_u16s16 0 NO_FORMULA -5000 5000
 /begin AXIS_DESCR STD_AXIS NO_INPUT_QUANTITY rpm1-1 9 -15000 15000 DEPOSIT ABSOLUTE FORMAT "%.2" /end AXIS_DESCR
 FORMAT "%.2" /end CHARACTERISTIC
/begin CHARACTERISTIC Speed_Max_Torque_Crawl_D_Break_M11 "D档蠕行制动状态下最大驱动力矩" CURVE 0xF25EF ECTEK_Curve_u16s16 0 NO_FORMULA -1000 1000
 /begin AXIS_DESCR STD_AXIS NO_INPUT_QUANTITY rpm1-1 9 -15000 15000 DEPOSIT ABSOLUTE FORMAT "%.2" /end AXIS_DESCR
 FORMAT "%.2" /end CHARACTERISTIC
/begin CHARACTERISTIC Speed_Vmh10ms_General_M11 "通用相对转速-AD曲线 rpm----mh10ms" CURVE 0xF2615 ECTEK_Curve_s16s16 0 Vmh10ms -500 500
 /begin AXIS_DESCR STD_AXIS NO_INPUT_QUANTITY rpm1-1 11 -30000 30000 DEPOSIT ABSOLUTE FORMAT "%.2" /end AXIS_DESCR
 FORMAT "%.2" /end CHARACTERISTIC
/begin CHARACTERISTIC Torque_Increment_General_M11 "通用AD修正转矩给定每周期增量" CURVE 0xF2643 ECTEK_Curve_s16s16 0 NO_FORMULA -100 100
 /begin AXIS_DESCR STD_AXIS NO_INPUT_QUANTITY Vmh10ms 11 -1000 1000 DEPOSIT ABSOLUTE FORMAT "%.2" /end AXIS_DESCR
 FORMAT "%.2" /end CHARACTERISTIC
/begin CHARACTERISTIC Speed_Vmh10ms_D_Park_M11 "D档驻坡 转速-AD曲线 rpm----mh10ms" CURVE 0xF2671 ECTEK_Curve_s16s16 0 Vmh10ms -500 500
 /begin AXIS_DESCR STD_AXIS NO_INPUT_QUANTITY rpm1-1 12 -15000 15000 DEPOSIT ABSOLUTE FORMAT "%.2" /end AXIS_DESCR
 FORMAT "%.2" /end CHARACTERISTIC
/begin CHARACTERISTIC Torque_Increment_D_Park_M11 "D档驻坡AD修正转矩给定每周期增量" CURVE 0xF26A3 ECTEK_Curve_s16s16 0 NO_FORMULA -100 100
 /begin AXIS_DESCR STD_AXIS NO_INPUT_QUANTITY Vmh10ms 11 -1000 1000 DEPOSIT ABSOLUTE FORMAT "%.2" /end AXIS_DESCR
 FORMAT "%.2" /end CHARACTERISTIC
/begin CHARACTERISTIC Motor_Speed_Torque_Break_M11 "电机最大制动力矩" CURVE 0xF26D1 ECTEK_Curve_s16s16 0 NO_FORMULA -5000 5000
 /begin AXIS_DESCR STD_AXIS NO_INPUT_QUANTITY rpm1-1 14 -15000 15000 DEPOSIT ABSOLUTE FORMAT "%.2" /end AXIS_DESCR
 FORMAT "%.2" /end CHARACTERISTIC
/begin CHARACTERISTIC FeedBack_Coast_D_Torque_M11 "D档滑行回馈 速度-力矩 定点" CURVE 0xF270B ECTEK_Curve_s16s16 0 NO_FORMULA -5000 5000
 /begin AXIS_DESCR STD_AXIS NO_INPUT_QUANTITY rpm1-1 8 -15000 15000 DEPOSIT ABSOLUTE FORMAT "%.2" /end AXIS_DESCR
 FORMAT "%.2" /end CHARACTERISTIC
/begin CHARACTERISTIC FeedBack_Break_D_Torque_M11 "D档制动回馈 速度-力矩 定点" CURVE 0xF272D ECTEK_Curve_s16s16 0 NO_FORMULA -5000 5000
 /begin AXIS_DESCR STD_AXIS NO_INPUT_QUANTITY rpm1-1 8 -15000 15000 DEPOSIT ABSOLUTE FORMAT "%.2" /end AXIS_DESCR
 FORMAT "%.2" /end CHARACTERISTIC
/begin CHARACTERISTIC Speed_Efficieny_M11 "电机速度-转换效率曲线 驱动" CURVE 0xF274F ECTEK_Curve_u16u16 0 rFactor100_PWM 0 100
 /begin AXIS_DESCR STD_AXIS NO_INPUT_QUANTITY rpm1-1 20 0 15000 DEPOSIT ABSOLUTE FORMAT "%.2" /end AXIS_DESCR
 FORMAT "%.2" /end CHARACTERISTIC
/begin CHARACTERISTIC Speed_Efficieny_FeedBack_M11 "电机速度-转换效率曲线 发电" CURVE 0xF27A1 ECTEK_Curve_u16u16 0 rFactor100_PWM 0 150
 /begin AXIS_DESCR STD_AXIS NO_INPUT_QUANTITY rpm1-1 20 0 15000 DEPOSIT ABSOLUTE FORMAT "%.2" /end AXIS_DESCR
 FORMAT "%.2" /end CHARACTERISTIC
/begin CHARACTERISTIC AutoPark_Motor_Speed_Torque_M11 "驻坡最大力矩" CURVE 0xF27F3 ECTEK_Curve_u16s16 0 NO_FORMULA 0 5000
 /begin AXIS_DESCR STD_AXIS NO_INPUT_QUANTITY rpm1-1 8 -15000 15000 DEPOSIT ABSOLUTE FORMAT "%.2" /end AXIS_DESCR
 FORMAT "%.2" /end CHARACTERISTIC
/begin CHARACTERISTIC AccPedCD_rUW_CUR_M11 "油门开度" CURVE 0xF2815 ECTEK_Curve_u16u16 0 rFactor100_PWM 0 100
 /begin AXIS_DESCR STD_AXIS NO_INPUT_QUANTITY u5V 7 0 5 DEPOSIT ABSOLUTE FORMAT "%.2" /end AXIS_DESCR
 FORMAT "%.2" /end CHARACTERISTIC
/begin CHARACTERISTIC AccPedCD_rUW_CUR2_M11 "油门2开度" CURVE 0xF2833 ECTEK_Curve_u16u16 0 rFactor100_PWM 0 100
 /begin AXIS_DESCR STD_AXIS NO_INPUT_QUANTITY u5V 7 0 5 DEPOSIT ABSOLUTE FORMAT "%.2" /end AXIS_DESCR
 FORMAT "%.2" /end CHARACTERISTIC
/begin CHARACTERISTIC AC_Condenser_Temp_M11 "空调蒸发器温度 上拉100K 下拉10K" CURVE 0xF2851 ECTEK_Curve_s16u16 0 Temp -100 150
 /begin AXIS_DESCR STD_AXIS NO_INPUT_QUANTITY NO_FORMULA 31 0 4095 DEPOSIT ABSOLUTE FORMAT "%.2" /end AXIS_DESCR
 FORMAT "%.2" /end CHARACTERISTIC
/begin CHARACTERISTIC AC_Condenser_Temp_M11_ACES "空调蒸发器温度_奥易克斯 上拉2.74K 下拉500K" CURVE 0xF28CF ECTEK_Curve_s16u16 0 Temp -100 150
 /begin AXIS_DESCR STD_AXIS NO_INPUT_QUANTITY NO_FORMULA 29 0 4095 DEPOSIT ABSOLUTE FORMAT "%.2" /end AXIS_DESCR
 FORMAT "%.2" /end CHARACTERISTIC
/begin CHARACTERISTIC INS_Scale "临时仪表类型速比 程序内部已经除100" VALUE 0xF2945 ECTEK_Value_u8 0 NO_FORMULA 1 255 FORMAT "%.2" /end CHARACTERISTIC
/begin CHARACTERISTIC Air_Pump_Cmd_Speed_Debug "Debug 气泵转速指令 -6000~6000 rpm" VALUE 0xF2946 ECTEK_Value_s16 0 rpm1-1 -6000 6000 FORMAT "%.2" /end CHARACTERISTIC
/begin CHARACTERISTIC Air_Pump_Cmd_Torque_Debug "Debug 气泵转矩指令 0.01N.m -100~100" VALUE 0xF2948 ECTEK_Value_s16 0 rr100 -100 100 /end CHARACTERISTIC
/begin CHARACTERISTIC Air_Pump_Fault_Reset_Debug "Debug 气泵故障复位命令" VALUE 0xF294A ECTEK_Value_u8 0 NO_FORMULA 0 1 FORMAT "%.2" /end CHARACTERISTIC
/begin CHARACTERISTIC Air_Pump_Cmd_Mode_Debug "Debug 气泵运行模式指令 0 停止 1 转矩模式 2 转速模式" VALUE 0xF294B ECTEK_Value_u8 0 NO_FORMULA 0 2 FORMAT "%.2" /end CHARACTERISTIC
/begin CHARACTERISTIC Air_Pump_Debug "气泵Debug模式 0 禁用 1 激活" VALUE 0xF294C ECTEK_Value_u8 0 NO_FORMULA 0 1 FORMAT "%.2" /end CHARACTERISTIC
/begin CHARACTERISTIC Oil_Pump_Cmd_Speed_Debug "Debug 油泵转速指令 -6000~6000 rpm" VALUE 0xF294D ECTEK_Value_s16 0 rpm1-1 -6000 6000 FORMAT "%.2" /end CHARACTERISTIC
/begin CHARACTERISTIC Oil_Pump_Cmd_Torque_Debug "Debug 油泵转矩指令 0.01N.m -100~100" VALUE 0xF294F ECTEK_Value_s16 0 rr100 -100 100 /end CHARACTERISTIC
/begin CHARACTERISTIC Oil_Pump_Fault_Reset_Debug "Debug 油泵故障复位命令" VALUE 0xF2951 ECTEK_Value_u8 0 NO_FORMULA 0 1 FORMAT "%.2" /end CHARACTERISTIC
/begin CHARACTERISTIC Oil_Pump_Cmd_Mode_Debug "Debug 油泵运行模式指令 0 停止 1 转矩模式 2 转速模式" VALUE 0xF2952 ECTEK_Value_u8 0 NO_FORMULA 0 2 FORMAT "%.2" /end CHARACTERISTIC
/begin CHARACTERISTIC Oil_Pump_Debug "油泵Debug模式 0 禁用 1 激活" VALUE 0xF2953 ECTEK_Value_u8 0 NO_FORMULA 0 1 FORMAT "%.2" /end CHARACTERISTIC
/begin CHARACTERISTIC Debug_Gear_Torque_Rate "使用变速箱输出转矩指令" VALUE 0xF2954 ECTEK_Value_u8 0 NO_FORMULA 0 1 FORMAT "%.2" /end CHARACTERISTIC
/begin CHARACTERISTIC Shift_Gears_Enable_Debug "变速箱换档手动指令 0 不允许 1 允许 2 关闭DEBUG" VALUE 0xF2955 ECTEK_Value_u8 0 NO_FORMULA 0 2 FORMAT "%.2" /end CHARACTERISTIC
/begin CHARACTERISTIC Gears_Mode_Debug "变速箱换档模式手动指令 00 NOMAL 01 ECO 02 SPORT 03 坡道模式 4关闭DEBUG" VALUE 0xF2956 ECTEK_Value_u8 0 NO_FORMULA 0 4 FORMAT "%.2" /end CHARACTERISTIC
/begin CHARACTERISTIC Oil_Pump_Speed_Step "油泵转速调节步进100ms 0 up 1 down" VAL_BLK 0xF2957 ECTEK_ValueBlock2_u16 0 rpm1-1 0 65535 FORMAT "%.2" NUMBER 2 /end CHARACTERISTIC
/begin CHARACTERISTIC Air_Pump_Speed_Step "气泵转速调节步进100ms 0 up 1 down" VAL_BLK 0xF295B ECTEK_ValueBlock2_u16 0 rpm1-1 0 65535 FORMAT "%.2" NUMBER 2 /end CHARACTERISTIC
/begin CHARACTERISTIC Air_Pump_Low_Pressure "压力罐低压报警 Mpa" VALUE 0xF295F ECTEK_Value_u16 0 rr100 0 1 /end CHARACTERISTIC
/begin CHARACTERISTIC Motor_Vehicle_Speed_Scale_M12 "转速-车速比例， 变速器输出轴速比" VALUE 0xF2961 ECTEK_Value_u16 0 NO_FORMULA 0 65535 BIT_MASK 0xFF FORMAT "%.2" /end CHARACTERISTIC
/begin CHARACTERISTIC Motor_Vehicle_Speed_Scale_Gears_M12 "转速-车速比例 各档位 2:1.00 1:2.73" VAL_BLK 0xF2963 ECTEK_ValueBlock3_u16 0 NO_FORMULA 0 65535 FORMAT "%.2" NUMBER 3 /end CHARACTERISTIC
/begin CHARACTERISTIC Demand_Limit_High_M12 "转速上线 *4" VALUE 0xF2969 ECTEK_Value_u16 0 NO_FORMULA -0 4095 FORMAT "%.2" /end CHARACTERISTIC
/begin CHARACTERISTIC Demand_Limit_Low_M12 "速度下限" VALUE 0xF296B ECTEK_Value_u16 0 NO_FORMULA -0 4095 FORMAT "%.2" /end CHARACTERISTIC
/begin CHARACTERISTIC Crawl_D_Speed_Max_M12 "D蠕动最大速度 从其他状态进入蠕动的速度" VALUE 0xF296D ECTEK_Value_u16 0 rpm1-1 -0 1000 FORMAT "%.2" /end CHARACTERISTIC
/begin CHARACTERISTIC Crawl_D_Torque_Delay_Max_M12 "蠕动更新间隔 单位10ms" VALUE 0xF296F ECTEK_Value_u8 0 NO_FORMULA -0 255 FORMAT "%.2" /end CHARACTERISTIC
/begin CHARACTERISTIC Crawl_D_Torque_Delay_Start_Max_M12 "起步蠕动更新间隔 单位10ms" VALUE 0xF2970 ECTEK_Value_u8 0 NO_COMPU_METHOD -4294967296 4294967296 FORMAT "%.2" /end CHARACTERISTIC
/begin CHARACTERISTIC Speed_Buffer_Number_M12 "10ms车辆速度采样缓冲次数" VALUE 0xF2971 ECTEK_Value_u8 0 NO_FORMULA 1 69 FORMAT "%.2" /end CHARACTERISTIC
/begin CHARACTERISTIC Speed_Average_Number_M12 "10ms平均车速缓冲次数" VALUE 0xF2972 ECTEK_Value_u8 0 NO_FORMULA 1 69 FORMAT "%.2" /end CHARACTERISTIC
/begin CHARACTERISTIC Torque_Buffer_Number_AutoPark_M12 "10ms平均转矩缓冲次数" VALUE 0xF2973 ECTEK_Value_u8 0 NO_FORMULA -0 69 FORMAT "%.2" /end CHARACTERISTIC
/begin CHARACTERISTIC D_Park_Start_Speed_M12 "D驻坡触发转速" VALUE 0xF2974 ECTEK_Value_u8 0 rpm1-1 -0 255 FORMAT "%.2" /end CHARACTERISTIC
/begin CHARACTERISTIC Auto_Park_Speed_Acc_Max_M12 "激活D驻坡最大退行转速累加" VALUE 0xF2975 ECTEK_Value_s16 0 NO_FORMULA -32767 32768 FORMAT "%.2" /end CHARACTERISTIC
/begin CHARACTERISTIC Auto_Park_Speed_Times_Max_M12 "激活D驻坡最大退行增速时间 单位10ms" VALUE 0xF2977 ECTEK_Value_u16 0 NO_FORMULA -0 65535 FORMAT "%.2" /end CHARACTERISTIC
/begin CHARACTERISTIC Auto_Torque_Min_M12 "自动转矩最小正值" VALUE 0xF2979 ECTEK_Value_s16 0 NO_FORMULA 0 150 FORMAT "%.2" /end CHARACTERISTIC
/begin CHARACTERISTIC Auto_Torque_Max_M12 "自动转矩最大负值" VALUE 0xF297B ECTEK_Value_s16 0 NO_FORMULA -150 0 FORMAT "%.2" /end CHARACTERISTIC
/begin CHARACTERISTIC R_Vhms_Average_Ratio_M12 "R档Vhms平均值缓冲比例" VALUE 0xF297D ECTEK_Value_u16 0 NO_FORMULA 1 500 FORMAT "%.2" /end CHARACTERISTIC
/begin CHARACTERISTIC D_Vhms_Average_Ratio_M12 "D档Vhms平均值缓冲比例" VALUE 0xF297F ECTEK_Value_u16 0 NO_FORMULA 1 500 FORMAT "%.2" /end CHARACTERISTIC
/begin CHARACTERISTIC Motor_Speed_Torque_M12 "转速_最大转矩 大地和 30KW 150N 95" CURVE 0xF2981 ECTEK_Curve_u16s16 0 NO_FORMULA -5000 5000
 /begin AXIS_DESCR STD_AXIS NO_INPUT_QUANTITY rpm1-1 19 -15000 15000 DEPOSIT ABSOLUTE FORMAT "%.2" /end AXIS_DESCR
 FORMAT "%.2" /end CHARACTERISTIC
/begin CHARACTERISTIC AccPed_Rip_M12 "油门曲线" CURVE 0xF29CF ECTEK_Curve_u16u16 0 rFactor100_PWM -0 100
 /begin AXIS_DESCR STD_AXIS NO_INPUT_QUANTITY rFactor100_PWM 11 -0 100 DEPOSIT ABSOLUTE FORMAT "%.2" /end AXIS_DESCR
 FORMAT "%.2" /end CHARACTERISTIC
/begin CHARACTERISTIC Speed_Vmh10ms_Crawl_D_M12 "D档蠕动 转速-AD曲线 rpm----mh10ms" CURVE 0xF29FD ECTEK_Curve_s16s16 0 Vmh10ms -500 500
 /begin AXIS_DESCR STD_AXIS NO_INPUT_QUANTITY rpm1-1 12 -15000 15000 DEPOSIT ABSOLUTE FORMAT "%.2" /end AXIS_DESCR
 FORMAT "%.2" /end CHARACTERISTIC
/begin CHARACTERISTIC Torque_Increment_Crawl_D_M12 "D档蠕动 AD修正转矩给定每周期增量" CURVE 0xF2A2F ECTEK_Curve_s16s16 0 NO_FORMULA -100 100
 /begin AXIS_DESCR STD_AXIS NO_INPUT_QUANTITY Vmh10ms 11 -1000 1000 DEPOSIT ABSOLUTE FORMAT "%.2" /end AXIS_DESCR
 FORMAT "%.2" /end CHARACTERISTIC
/begin CHARACTERISTIC Speed_Max_Torque_Crawl_D_M12 "D档蠕行模式最大力矩" CURVE 0xF2A5D ECTEK_Curve_u16s16 0 NO_FORMULA -5000 5000
 /begin AXIS_DESCR STD_AXIS NO_INPUT_QUANTITY rpm1-1 9 -15000 15000 DEPOSIT ABSOLUTE FORMAT "%.2" /end AXIS_DESCR
 FORMAT "%.2" /end CHARACTERISTIC
/begin CHARACTERISTIC Speed_Max_Torque_Crawl_D_Break_M12 "D档蠕行制动状态下最大驱动力矩" CURVE 0xF2A83 ECTEK_Curve_u16s16 0 NO_FORMULA -1000 1000
 /begin AXIS_DESCR STD_AXIS NO_INPUT_QUANTITY rpm1-1 9 -15000 15000 DEPOSIT ABSOLUTE FORMAT "%.2" /end AXIS_DESCR
 FORMAT "%.2" /end CHARACTERISTIC
/begin CHARACTERISTIC Speed_Vmh10ms_General_M12 "通用相对转速-AD曲线 rpm----mh10ms" CURVE 0xF2AA9 ECTEK_Curve_s16s16 0 Vmh10ms -500 500
 /begin AXIS_DESCR STD_AXIS NO_INPUT_QUANTITY rpm1-1 11 -30000 30000 DEPOSIT ABSOLUTE FORMAT "%.2" /end AXIS_DESCR
 FORMAT "%.2" /end CHARACTERISTIC
/begin CHARACTERISTIC Torque_Increment_General_M12 "通用AD修正转矩给定每周期增量" CURVE 0xF2AD7 ECTEK_Curve_s16s16 0 NO_FORMULA -100 100
 /begin AXIS_DESCR STD_AXIS NO_INPUT_QUANTITY Vmh10ms 11 -1000 1000 DEPOSIT ABSOLUTE FORMAT "%.2" /end AXIS_DESCR
 FORMAT "%.2" /end CHARACTERISTIC
/begin CHARACTERISTIC Speed_Vmh10ms_D_Park_M12 "D档驻坡 转速-AD曲线 rpm----mh10ms" CURVE 0xF2B05 ECTEK_Curve_s16s16 0 Vmh10ms -500 500
 /begin AXIS_DESCR STD_AXIS NO_INPUT_QUANTITY rpm1-1 12 -15000 15000 DEPOSIT ABSOLUTE FORMAT "%.2" /end AXIS_DESCR
 FORMAT "%.2" /end CHARACTERISTIC
/begin CHARACTERISTIC Torque_Increment_D_Park_M12 "D档驻坡AD修正转矩给定每周期增量" CURVE 0xF2B37 ECTEK_Curve_s16s16 0 NO_FORMULA -100 100
 /begin AXIS_DESCR STD_AXIS NO_INPUT_QUANTITY Vmh10ms 11 -1000 1000 DEPOSIT ABSOLUTE FORMAT "%.2" /end AXIS_DESCR
 FORMAT "%.2" /end CHARACTERISTIC
/begin CHARACTERISTIC Motor_Speed_Torque_Break_M12 "电机最大制动力矩" CURVE 0xF2B65 ECTEK_Curve_s16s16 0 NO_FORMULA -5000 5000
 /begin AXIS_DESCR STD_AXIS NO_INPUT_QUANTITY rpm1-1 14 -15000 15000 DEPOSIT ABSOLUTE FORMAT "%.2" /end AXIS_DESCR
 FORMAT "%.2" /end CHARACTERISTIC
/begin CHARACTERISTIC FeedBack_Coast_D_Torque_M12 "D档滑行回馈 速度-力矩 定点" CURVE 0xF2B9F ECTEK_Curve_s16s16 0 NO_FORMULA -5000 5000
 /begin AXIS_DESCR STD_AXIS NO_INPUT_QUANTITY rpm1-1 8 -15000 15000 DEPOSIT ABSOLUTE FORMAT "%.2" /end AXIS_DESCR
 FORMAT "%.2" /end CHARACTERISTIC
/begin CHARACTERISTIC FeedBack_Break_D_Torque_M12 "D档制动回馈 速度-力矩 定点" CURVE 0xF2BC1 ECTEK_Curve_s16s16 0 NO_FORMULA -5000 5000
 /begin AXIS_DESCR STD_AXIS NO_INPUT_QUANTITY rpm1-1 8 -15000 15000 DEPOSIT ABSOLUTE FORMAT "%.2" /end AXIS_DESCR
 FORMAT "%.2" /end CHARACTERISTIC
/begin CHARACTERISTIC Speed_Efficieny_M12 "电机速度-转换效率曲线 驱动" CURVE 0xF2BE3 ECTEK_Curve_u16u16 0 rFactor100_PWM 0 100
 /begin AXIS_DESCR STD_AXIS NO_INPUT_QUANTITY rpm1-1 20 0 15000 DEPOSIT ABSOLUTE FORMAT "%.2" /end AXIS_DESCR
 FORMAT "%.2" /end CHARACTERISTIC
/begin CHARACTERISTIC Speed_Efficieny_FeedBack_M12 "电机速度-转换效率曲线 发电" CURVE 0xF2C35 ECTEK_Curve_u16u16 0 rFactor100_PWM 0 150
 /begin AXIS_DESCR STD_AXIS NO_INPUT_QUANTITY rpm1-1 20 0 15000 DEPOSIT ABSOLUTE FORMAT "%.2" /end AXIS_DESCR
 FORMAT "%.2" /end CHARACTERISTIC
/begin CHARACTERISTIC AutoPark_Motor_Speed_Torque_M12 "驻坡最大力矩" CURVE 0xF2C87 ECTEK_Curve_u16s16 0 NO_FORMULA 0 5000
 /begin AXIS_DESCR STD_AXIS NO_INPUT_QUANTITY rpm1-1 8 -15000 15000 DEPOSIT ABSOLUTE FORMAT "%.2" /end AXIS_DESCR
 FORMAT "%.2" /end CHARACTERISTIC
/begin CHARACTERISTIC AccPedCD_rUW_CUR_M12 "油门开度" CURVE 0xF2CA9 ECTEK_Curve_u16u16 0 rFactor100_PWM 0 100
 /begin AXIS_DESCR STD_AXIS NO_INPUT_QUANTITY u5V 7 0 5 DEPOSIT ABSOLUTE FORMAT "%.2" /end AXIS_DESCR
 FORMAT "%.2" /end CHARACTERISTIC
/begin CHARACTERISTIC AccPedCD_rUW_CUR2_M12 "油门2开度" CURVE 0xF2CC7 ECTEK_Curve_u16u16 0 rFactor100_PWM 0 100
 /begin AXIS_DESCR STD_AXIS NO_INPUT_QUANTITY u5V 7 0 5 DEPOSIT ABSOLUTE FORMAT "%.2" /end AXIS_DESCR
 FORMAT "%.2" /end CHARACTERISTIC
/begin CHARACTERISTIC AC_Condenser_Temp_M12 "空调蒸发器温度 上拉100K 下拉10K" CURVE 0xF2CE5 ECTEK_Curve_s16u16 0 Temp -100 150
 /begin AXIS_DESCR STD_AXIS NO_INPUT_QUANTITY NO_FORMULA 31 0 4095 DEPOSIT ABSOLUTE FORMAT "%.2" /end AXIS_DESCR
 FORMAT "%.2" /end CHARACTERISTIC
/begin CHARACTERISTIC AC_Condenser_Temp_M12_ACES "空调蒸发器温度_奥易克斯 上拉2.74K 下拉500K" CURVE 0xF2D63 ECTEK_Curve_s16u16 0 Temp -100 150
 /begin AXIS_DESCR STD_AXIS NO_INPUT_QUANTITY NO_FORMULA 29 0 4095 DEPOSIT ABSOLUTE FORMAT "%.2" /end AXIS_DESCR
 FORMAT "%.2" /end CHARACTERISTIC
/begin CHARACTERISTIC Air_Pump_Speed_DrapDown_M12 "堵转跌落转速检测阀值" VALUE 0xF2DD9 ECTEK_Value_s16 0 rpm1-1 -32768 32767 FORMAT "%.2" /end CHARACTERISTIC
/begin CHARACTERISTIC Air_Pump_Torque_DrapDown_M12 "排气力矩检测阀值" VALUE 0xF2DDB ECTEK_Value_s16 0 rr100 -32768 32767 /end CHARACTERISTIC
/begin CHARACTERISTIC Air_Start_Press_Rate_M12 "气泵启动目标压力百分比" VALUE 0xF2DDD ECTEK_Value_u8 0 NO_FORMULA 0 100 FORMAT "%.2" /end CHARACTERISTIC
/begin CHARACTERISTIC Air_Over_Reset_M12 "气泵排气复位压力百分比" VALUE 0xF2DDE ECTEK_Value_u8 0 NO_FORMULA 0 100 FORMAT "%.2" /end CHARACTERISTIC
/begin CHARACTERISTIC Air_Pressure_Delay_Max_M12 "排气后气泵持续工作时间 0.1S" VALUE 0xF2DDF ECTEK_Value_u16 0 rFactor10_VSSPlaus 0 65535 FORMAT "%.2" /end CHARACTERISTIC
/begin CHARACTERISTIC Air_Pump_WorkTime_M12 "气泵连续工作时间 0.1秒" VALUE 0xF2DE1 ECTEK_Value_u16 0 rFactor10_VSSPlaus 0 65535 FORMAT "%.2" /end CHARACTERISTIC
/begin CHARACTERISTIC Air_Pump_Fan_Delay_M12 "气泵风扇关闭延迟 0.1S" VALUE 0xF2DE3 ECTEK_Value_u16 0 rFactor10_VSSPlaus 0 65535 FORMAT "%.2" /end CHARACTERISTIC
/begin CHARACTERISTIC Air_Pump_Taget_Pressure_M12 "压力罐目标压力 Mpa" VALUE 0xF2DE5 ECTEK_Value_u16 0 rr100 0 1 /end CHARACTERISTIC
/begin CHARACTERISTIC Air_Pump_Speed_Limit_M12 "气泵转速限制" VALUE 0xF2DE7 ECTEK_Value_s16 0 rpm1-1 -3000 3000 FORMAT "%.2" /end CHARACTERISTIC
/begin CHARACTERISTIC Air_Pump_Torque_Limit_M12 "气泵转矩限制" VALUE 0xF2DE9 ECTEK_Value_u16 0 rr100 0 65535 /end CHARACTERISTIC
/begin CHARACTERISTIC Oil_Pump_Speed_VSpeed_M12 "油泵转速-车速曲线" CURVE 0xF2DEB ECTEK_Curve_s16s16 0 rpm1-1 -32768 32767
 /begin AXIS_DESCR STD_AXIS NO_INPUT_QUANTITY Speed 11 -32768 32767 DEPOSIT ABSOLUTE FORMAT "%.2" /end AXIS_DESCR
 FORMAT "%.2" /end CHARACTERISTIC
/begin CHARACTERISTIC Oil_Pump_Speed_Limit_M12 "油泵转速限制" VALUE 0xF2E19 ECTEK_Value_s16 0 rpm1-1 -3000 3000 FORMAT "%.2" /end CHARACTERISTIC
/begin CHARACTERISTIC Oil_Pump_Torque_Limit_M12 "油泵转矩限制" VALUE 0xF2E1B ECTEK_Value_u16 0 rr100 0 65535 /end CHARACTERISTIC
/begin CHARACTERISTIC Fan_Rate_Temp "D15风扇电控温度-PWM曲线" CURVE 0xF2E1D ECTEK_Curve_u16u16 0 rr100 0 10000
 /begin AXIS_DESCR STD_AXIS NO_INPUT_QUANTITY NO_FORMULA 5 0 65535 DEPOSIT ABSOLUTE FORMAT "%.2" /end AXIS_DESCR
/end CHARACTERISTIC
/begin CHARACTERISTIC Fan_Pwm "斯太尔风机手动PWM 0 关闭DEBUG" VALUE 0xF2E33 ECTEK_Value_u16 0 PWM_Hz100 0 65535 /end CHARACTERISTIC
/begin CHARACTERISTIC Motor_Vehicle_Speed_Scale_M13 "转速-车速比例， 变速器输出轴速比 限速80" VALUE 0xF2E35 ECTEK_Value_u16 0 NO_FORMULA 0 65535 BIT_MASK 0xFF FORMAT "%.2" /end CHARACTERISTIC
/begin CHARACTERISTIC Motor_Vehicle_Speed_Scale_Gears_M13 "转速-车速比例" VAL_BLK 0xF2E37 ECTEK_ValueBlock10_u16 0 NO_FORMULA 0 65535 FORMAT "%.2" NUMBER 10 /end CHARACTERISTIC
/begin CHARACTERISTIC Demand_Limit_High_M13 "转速上线 *4" VALUE 0xF2E4B ECTEK_Value_u16 0 NO_FORMULA -0 4095 FORMAT "%.2" /end CHARACTERISTIC
/begin CHARACTERISTIC Demand_Limit_Low_M13 "速度下限" VALUE 0xF2E4D ECTEK_Value_u16 0 NO_FORMULA -0 4095 FORMAT "%.2" /end CHARACTERISTIC
/begin CHARACTERISTIC Crawl_D_Speed_Max_M13 "D蠕动最大速度 从其他状态进入蠕动的速度" VALUE 0xF2E4F ECTEK_Value_u16 0 rpm1-1 -0 2000 FORMAT "%.2" /end CHARACTERISTIC
/begin CHARACTERISTIC Crawl_D_Torque_Delay_Max_M13 "蠕动更新间隔 单位10ms" VALUE 0xF2E51 ECTEK_Value_u8 0 NO_FORMULA -0 255 FORMAT "%.2" /end CHARACTERISTIC
/begin CHARACTERISTIC Speed_Buffer_Number_M13 "10ms车辆速度采样缓冲次数" VALUE 0xF2E52 ECTEK_Value_u8 0 NO_FORMULA 1 69 FORMAT "%.2" /end CHARACTERISTIC
/begin CHARACTERISTIC Speed_Average_Number_M13 "10ms平均车速缓冲次数" VALUE 0xF2E53 ECTEK_Value_u8 0 NO_FORMULA 1 69 FORMAT "%.2" /end CHARACTERISTIC
/begin CHARACTERISTIC Torque_Buffer_Number_AutoPark_M13 "10ms平均转矩缓冲次数" VALUE 0xF2E54 ECTEK_Value_u8 0 NO_FORMULA -0 69 FORMAT "%.2" /end CHARACTERISTIC
/begin CHARACTERISTIC D_Park_Start_Speed_M13 "D驻坡触发转速" VALUE 0xF2E55 ECTEK_Value_u8 0 rpm1-1 -0 255 FORMAT "%.2" /end CHARACTERISTIC
/begin CHARACTERISTIC Auto_Park_Speed_Acc_Max_M13 "激活D驻坡最大退行转速累加" VALUE 0xF2E56 ECTEK_Value_s16 0 NO_FORMULA -32767 32768 FORMAT "%.2" /end CHARACTERISTIC
/begin CHARACTERISTIC Auto_Park_Speed_Times_Max_M13 "激活D驻坡最大退行增速时间 单位10ms" VALUE 0xF2E58 ECTEK_Value_u16 0 NO_FORMULA -0 65535 FORMAT "%.2" /end CHARACTERISTIC
/begin CHARACTERISTIC Auto_Torque_Min_M13 "自动转矩最小正值" VALUE 0xF2E5A ECTEK_Value_s16 0 NO_FORMULA 0 150 FORMAT "%.2" /end CHARACTERISTIC
/begin CHARACTERISTIC Crawl_D_Torque_Delay_Start_Max_M13 "起步蠕动更新间隔 单位10ms" VALUE 0xF2E5C ECTEK_Value_u8 0 NO_COMPU_METHOD -4294967296 4294967296 FORMAT "%.2" /end CHARACTERISTIC
/begin CHARACTERISTIC Auto_Torque_Max_M13 "自动转矩最大负值" VALUE 0xF2E5D ECTEK_Value_s16 0 NO_FORMULA -150 0 FORMAT "%.2" /end CHARACTERISTIC
/begin CHARACTERISTIC R_Vhms_Average_Ratio_M13 "R档Vhms平均值缓冲比例" VALUE 0xF2E5F ECTEK_Value_u16 0 NO_FORMULA 1 500 FORMAT "%.2" /end CHARACTERISTIC
/begin CHARACTERISTIC D_Vhms_Average_Ratio_M13 "D档Vhms平均值缓冲比例" VALUE 0xF2E61 ECTEK_Value_u16 0 NO_FORMULA 1 500 FORMAT "%.2" /end CHARACTERISTIC
/begin CHARACTERISTIC Motor_Speed_Torque_M13 "转速_最大转矩 大地和 30KW 150N 95" CURVE 0xF2E63 ECTEK_Curve_u16s16 0 NO_FORMULA -5000 5000
 /begin AXIS_DESCR STD_AXIS NO_INPUT_QUANTITY rpm1-1 19 -15000 15000 DEPOSIT ABSOLUTE FORMAT "%.2" /end AXIS_DESCR
 FORMAT "%.2" /end CHARACTERISTIC
/begin CHARACTERISTIC AccPed_Rip_M13 "油门曲线" CURVE 0xF2EB1 ECTEK_Curve_u16u16 0 rFactor100_PWM -0 100
 /begin AXIS_DESCR STD_AXIS NO_INPUT_QUANTITY rFactor100_PWM 11 -0 100 DEPOSIT ABSOLUTE FORMAT "%.2" /end AXIS_DESCR
 FORMAT "%.2" /end CHARACTERISTIC
/begin CHARACTERISTIC Speed_Vmh10ms_Crawl_D_M13 "D档蠕动 转速-AD曲线 rpm----mh10ms" CURVE 0xF2EDF ECTEK_Curve_s16s16 0 Vmh10ms -500 500
 /begin AXIS_DESCR STD_AXIS NO_INPUT_QUANTITY rpm1-1 12 -15000 15000 DEPOSIT ABSOLUTE FORMAT "%.2" /end AXIS_DESCR
 FORMAT "%.2" /end CHARACTERISTIC
/begin CHARACTERISTIC Torque_Increment_Crawl_D_M13 "D档蠕动 AD修正转矩给定每周期增量" CURVE 0xF2F11 ECTEK_Curve_s16s16 0 NO_FORMULA -100 100
 /begin AXIS_DESCR STD_AXIS NO_INPUT_QUANTITY Vmh10ms 11 -1000 1000 DEPOSIT ABSOLUTE FORMAT "%.2" /end AXIS_DESCR
 FORMAT "%.2" /end CHARACTERISTIC
/begin CHARACTERISTIC Speed_Max_Torque_Crawl_D_M13 "D档蠕行模式最大力矩" CURVE 0xF2F3F ECTEK_Curve_u16s16 0 NO_FORMULA -5000 5000
 /begin AXIS_DESCR STD_AXIS NO_INPUT_QUANTITY rpm1-1 9 -15000 15000 DEPOSIT ABSOLUTE FORMAT "%.2" /end AXIS_DESCR
 FORMAT "%.2" /end CHARACTERISTIC
/begin CHARACTERISTIC Speed_Max_Torque_Crawl_D_Break_M13 "D档蠕行制动状态下最大驱动力矩" CURVE 0xF2F65 ECTEK_Curve_u16s16 0 NO_FORMULA -1000 1000
 /begin AXIS_DESCR STD_AXIS NO_INPUT_QUANTITY rpm1-1 9 -15000 15000 DEPOSIT ABSOLUTE FORMAT "%.2" /end AXIS_DESCR
 FORMAT "%.2" /end CHARACTERISTIC
/begin CHARACTERISTIC Speed_Vmh10ms_General_M13 "通用相对转速-AD曲线 rpm----mh10ms" CURVE 0xF2F8B ECTEK_Curve_s16s16 0 Vmh10ms -500 500
 /begin AXIS_DESCR STD_AXIS NO_INPUT_QUANTITY rpm1-1 11 -30000 30000 DEPOSIT ABSOLUTE FORMAT "%.2" /end AXIS_DESCR
 FORMAT "%.2" /end CHARACTERISTIC
/begin CHARACTERISTIC Torque_Increment_General_M13 "通用AD修正转矩给定每周期增量" CURVE 0xF2FB9 ECTEK_Curve_s16s16 0 NO_FORMULA -100 100
 /begin AXIS_DESCR STD_AXIS NO_INPUT_QUANTITY Vmh10ms 11 -1000 1000 DEPOSIT ABSOLUTE FORMAT "%.2" /end AXIS_DESCR
 FORMAT "%.2" /end CHARACTERISTIC
/begin CHARACTERISTIC Speed_Vmh10ms_D_Park_M13 "D档驻坡 转速-AD曲线 rpm----mh10ms" CURVE 0xF2FE7 ECTEK_Curve_s16s16 0 Vmh10ms -500 500
 /begin AXIS_DESCR STD_AXIS NO_INPUT_QUANTITY rpm1-1 12 -15000 15000 DEPOSIT ABSOLUTE FORMAT "%.2" /end AXIS_DESCR
 FORMAT "%.2" /end CHARACTERISTIC
/begin CHARACTERISTIC Torque_Increment_D_Park_M13 "D档驻坡AD修正转矩给定每周期增量" CURVE 0xF3019 ECTEK_Curve_s16s16 0 NO_FORMULA -100 100
 /begin AXIS_DESCR STD_AXIS NO_INPUT_QUANTITY Vmh10ms 11 -1000 1000 DEPOSIT ABSOLUTE FORMAT "%.2" /end AXIS_DESCR
 FORMAT "%.2" /end CHARACTERISTIC
/begin CHARACTERISTIC Motor_Speed_Torque_Break_M13 "电机最大制动力矩" CURVE 0xF3047 ECTEK_Curve_s16s16 0 NO_FORMULA -5000 5000
 /begin AXIS_DESCR STD_AXIS NO_INPUT_QUANTITY rpm1-1 14 -15000 15000 DEPOSIT ABSOLUTE FORMAT "%.2" /end AXIS_DESCR
 FORMAT "%.2" /end CHARACTERISTIC
/begin CHARACTERISTIC FeedBack_Coast_D_Torque_M13 "D档滑行回馈 速度-力矩 定点 标定值为输出轴扭矩与转速" CURVE 0xF3081 ECTEK_Curve_s16s16 0 NO_FORMULA -32000 32000
 /begin AXIS_DESCR STD_AXIS NO_INPUT_QUANTITY rpm1-1 8 -5000 5000 DEPOSIT ABSOLUTE FORMAT "%.2" /end AXIS_DESCR
 FORMAT "%.2" /end CHARACTERISTIC
/begin CHARACTERISTIC FeedBack_Break_D_Torque_M13 "D档制动回馈 速度-力矩 定点 标定值为输出轴扭矩与转速" CURVE 0xF30A3 ECTEK_Curve_s16s16 0 NO_FORMULA -32000 32000
 /begin AXIS_DESCR STD_AXIS NO_INPUT_QUANTITY rpm1-1 8 -5000 5000 DEPOSIT ABSOLUTE FORMAT "%.2" /end AXIS_DESCR
 FORMAT "%.2" /end CHARACTERISTIC
/begin CHARACTERISTIC Speed_Efficieny_M13 "电机速度-转换效率曲线 驱动" CURVE 0xF30C5 ECTEK_Curve_u16u16 0 rFactor100_PWM 0 100
 /begin AXIS_DESCR STD_AXIS NO_INPUT_QUANTITY rpm1-1 20 0 15000 DEPOSIT ABSOLUTE FORMAT "%.2" /end AXIS_DESCR
 FORMAT "%.2" /end CHARACTERISTIC
/begin CHARACTERISTIC Speed_Efficieny_FeedBack_M13 "电机速度-转换效率曲线 发电" CURVE 0xF3117 ECTEK_Curve_u16u16 0 rFactor100_PWM 0 150
 /begin AXIS_DESCR STD_AXIS NO_INPUT_QUANTITY rpm1-1 20 0 15000 DEPOSIT ABSOLUTE FORMAT "%.2" /end AXIS_DESCR
 FORMAT "%.2" /end CHARACTERISTIC
/begin CHARACTERISTIC AutoPark_Motor_Speed_Torque_M13 "驻坡最大力矩" CURVE 0xF3169 ECTEK_Curve_u16s16 0 NO_FORMULA 0 5000
 /begin AXIS_DESCR STD_AXIS NO_INPUT_QUANTITY rpm1-1 8 -15000 15000 DEPOSIT ABSOLUTE FORMAT "%.2" /end AXIS_DESCR
 FORMAT "%.2" /end CHARACTERISTIC
/begin CHARACTERISTIC AccPedCD_rUW_CUR_M13 "油门开度" CURVE 0xF318B ECTEK_Curve_u16u16 0 rFactor100_PWM 0 100
 /begin AXIS_DESCR STD_AXIS NO_INPUT_QUANTITY u5V 7 0 5 DEPOSIT ABSOLUTE FORMAT "%.2" /end AXIS_DESCR
 FORMAT "%.2" /end CHARACTERISTIC
/begin CHARACTERISTIC AccPedCD_rUW_CUR2_M13 "油门2开度" CURVE 0xF31A9 ECTEK_Curve_u16u16 0 rFactor100_PWM 0 100
 /begin AXIS_DESCR STD_AXIS NO_INPUT_QUANTITY u5V 7 0 5 DEPOSIT ABSOLUTE FORMAT "%.2" /end AXIS_DESCR
 FORMAT "%.2" /end CHARACTERISTIC
/begin CHARACTERISTIC AC_Condenser_Temp_M13 "空调蒸发器温度 上拉100K 下拉10K" CURVE 0xF31C7 ECTEK_Curve_s16u16 0 Temp -100 150
 /begin AXIS_DESCR STD_AXIS NO_INPUT_QUANTITY NO_FORMULA 31 0 4095 DEPOSIT ABSOLUTE FORMAT "%.2" /end AXIS_DESCR
 FORMAT "%.2" /end CHARACTERISTIC
/begin CHARACTERISTIC AC_Condenser_Temp_M13_ACES "空调蒸发器温度_奥易克斯 上拉2.74K 下拉500K" CURVE 0xF3245 ECTEK_Curve_s16u16 0 Temp -100 150
 /begin AXIS_DESCR STD_AXIS NO_INPUT_QUANTITY NO_FORMULA 29 0 4095 DEPOSIT ABSOLUTE FORMAT "%.2" /end AXIS_DESCR
 FORMAT "%.2" /end CHARACTERISTIC
/begin CHARACTERISTIC Air_Pump_Speed_DrapDown_M13 "堵转跌落转速检测阀值" VALUE 0xF32BB ECTEK_Value_s16 0 rpm1-1 -32768 32767 FORMAT "%.2" /end CHARACTERISTIC
/begin CHARACTERISTIC Air_Pump_Torque_DrapDown_M13 "排气力矩检测阀值" VALUE 0xF32BD ECTEK_Value_s16 0 rr100 -32768 32767 /end CHARACTERISTIC
/begin CHARACTERISTIC Air_Start_Press_Rate_M13 "气泵启动目标压力百分比" VALUE 0xF32BF ECTEK_Value_u8 0 NO_FORMULA 0 100 FORMAT "%.2" /end CHARACTERISTIC
/begin CHARACTERISTIC Air_Over_Reset_M13 "气泵排气复位压力百分比" VALUE 0xF32C0 ECTEK_Value_u8 0 NO_FORMULA 0 100 FORMAT "%.2" /end CHARACTERISTIC
/begin CHARACTERISTIC Air_Pressure_Delay_Max_M13 "排气后气泵持续工作时间 0.1S" VALUE 0xF32C1 ECTEK_Value_u16 0 rFactor10_VSSPlaus 0 65535 FORMAT "%.2" /end CHARACTERISTIC
/begin CHARACTERISTIC Air_Pump_WorkTime_M13 "气泵连续工作时间 0.1秒" VALUE 0xF32C3 ECTEK_Value_u16 0 rFactor10_VSSPlaus 0 65535 FORMAT "%.2" /end CHARACTERISTIC
/begin CHARACTERISTIC Air_Pump_Fan_Delay_M13 "气泵风扇关闭延迟 0.1S" VALUE 0xF32C5 ECTEK_Value_u16 0 rFactor10_VSSPlaus 0 65535 FORMAT "%.2" /end CHARACTERISTIC
/begin CHARACTERISTIC Air_Pump_Taget_Pressure_M13 "压力罐目标压力 Mpa" VALUE 0xF32C7 ECTEK_Value_u16 0 rr100 0 1.2 /end CHARACTERISTIC
/begin CHARACTERISTIC Air_Pump_Speed_Limit_M13 "气泵转速限制" VALUE 0xF32C9 ECTEK_Value_s16 0 rpm1-1 -3000 3000 FORMAT "%.2" /end CHARACTERISTIC
/begin CHARACTERISTIC Air_Pump_Torque_Limit_M13 "气泵转矩限制" VALUE 0xF32CB ECTEK_Value_u16 0 rr100 0 65535 /end CHARACTERISTIC
/begin CHARACTERISTIC Oil_Pump_Speed_VSpeed_M13 "油泵转速-车速曲线" CURVE 0xF32CD ECTEK_Curve_s16s16 0 rpm1-1 -32768 32767
 /begin AXIS_DESCR STD_AXIS NO_INPUT_QUANTITY Speed 11 -32768 32767 DEPOSIT ABSOLUTE FORMAT "%.2" /end AXIS_DESCR
 FORMAT "%.2" /end CHARACTERISTIC
/begin CHARACTERISTIC Oil_Pump_Speed_Limit_M13 "油泵转速限制" VALUE 0xF32FB ECTEK_Value_s16 0 rpm1-1 -3000 3000 FORMAT "%.2" /end CHARACTERISTIC
/begin CHARACTERISTIC Oil_Pump_Torque_Limit_M13 "油泵转矩限制" VALUE 0xF32FD ECTEK_Value_u16 0 rr100 0 65535 /end CHARACTERISTIC
/begin CHARACTERISTIC Motor_Vehicle_Speed_Scale_M14 "转速-车速比例， 变速器输出轴速比 限速80" VALUE 0xF32FF ECTEK_Value_u16 0 NO_FORMULA 0 65535 BIT_MASK 0xFF FORMAT "%.2" /end CHARACTERISTIC
/begin CHARACTERISTIC Motor_Vehicle_Speed_Scale_Gears_M14 "转速-车速比例" VAL_BLK 0xF3301 ECTEK_ValueBlock4_u16 0 NO_FORMULA 0 65535 FORMAT "%.2" NUMBER 4 /end CHARACTERISTIC
/begin CHARACTERISTIC Demand_Limit_High_M14 "转速上限 *4" VALUE 0xF3309 ECTEK_Value_u16 0 NO_FORMULA -0 4095 FORMAT "%.2" /end CHARACTERISTIC
/begin CHARACTERISTIC Demand_Limit_Low_M14 "速度下限" VALUE 0xF330B ECTEK_Value_u16 0 NO_FORMULA -0 4095 FORMAT "%.2" /end CHARACTERISTIC
/begin CHARACTERISTIC Crawl_D_Speed_Max_M14 "D蠕动最大速度 从其他状态进入蠕动的速度" VALUE 0xF330D ECTEK_Value_u16 0 rpm1-1 -0 1000 FORMAT "%.2" /end CHARACTERISTIC
/begin CHARACTERISTIC Crawl_D_Torque_Delay_Max_M14 "蠕动更新间隔 单位10ms" VALUE 0xF330F ECTEK_Value_u8 0 NO_FORMULA -0 255 FORMAT "%.2" /end CHARACTERISTIC
/begin CHARACTERISTIC Crawl_D_Torque_Delay_Start_Max_M14 "起步蠕动更新间隔 单位10ms" VALUE 0xF3310 ECTEK_Value_u8 0 NO_COMPU_METHOD -4294967296 4294967296 FORMAT "%.2" /end CHARACTERISTIC
/begin CHARACTERISTIC Speed_Buffer_Number_M14 "10ms车辆速度采样缓冲次数" VALUE 0xF3311 ECTEK_Value_u8 0 NO_FORMULA 1 69 FORMAT "%.2" /end CHARACTERISTIC
/begin CHARACTERISTIC Speed_Average_Number_M14 "10ms平均车速缓冲次数" VALUE 0xF3312 ECTEK_Value_u8 0 NO_FORMULA 1 69 FORMAT "%.2" /end CHARACTERISTIC
/begin CHARACTERISTIC Torque_Buffer_Number_AutoPark_M14 "10ms平均转矩缓冲次数" VALUE 0xF3313 ECTEK_Value_u8 0 NO_FORMULA -0 69 FORMAT "%.2" /end CHARACTERISTIC
/begin CHARACTERISTIC D_Park_Start_Speed_M14 "D驻坡触发转速" VALUE 0xF3314 ECTEK_Value_u8 0 rpm1-1 -0 255 FORMAT "%.2" /end CHARACTERISTIC
/begin CHARACTERISTIC Auto_Park_Speed_Acc_Max_M14 "激活D驻坡最大退行转速累加" VALUE 0xF3315 ECTEK_Value_s16 0 NO_FORMULA -32767 32768 FORMAT "%.2" /end CHARACTERISTIC
/begin CHARACTERISTIC Auto_Park_Speed_Times_Max_M14 "激活D驻坡最大退行增速时间 单位10ms" VALUE 0xF3317 ECTEK_Value_u16 0 NO_FORMULA -0 65535 FORMAT "%.2" /end CHARACTERISTIC
/begin CHARACTERISTIC Auto_Torque_Min_M14 "自动转矩最小正值" VALUE 0xF3319 ECTEK_Value_s16 0 NO_FORMULA 0 150 FORMAT "%.2" /end CHARACTERISTIC
/begin CHARACTERISTIC Auto_Torque_Max_M14 "自动转矩最大负值" VALUE 0xF331B ECTEK_Value_s16 0 NO_FORMULA -150 0 FORMAT "%.2" /end CHARACTERISTIC
/begin CHARACTERISTIC R_Vhms_Average_Ratio_M14 "R档Vhms平均值缓冲比例" VALUE 0xF331D ECTEK_Value_u16 0 NO_FORMULA 1 500 FORMAT "%.2" /end CHARACTERISTIC
/begin CHARACTERISTIC D_Vhms_Average_Ratio_M14 "D档Vhms平均值缓冲比例" VALUE 0xF331F ECTEK_Value_u16 0 NO_FORMULA 1 500 FORMAT "%.2" /end CHARACTERISTIC
/begin CHARACTERISTIC Motor_Speed_Torque_M14 "转速_最大转矩 大地和 30KW 150N 95" CURVE 0xF3321 ECTEK_Curve_u16s16 0 NO_FORMULA -5000 5000
 /begin AXIS_DESCR STD_AXIS NO_INPUT_QUANTITY rpm1-1 19 -15000 15000 DEPOSIT ABSOLUTE FORMAT "%.2" /end AXIS_DESCR
 FORMAT "%.2" /end CHARACTERISTIC
/begin CHARACTERISTIC AccPed_Rip_M14 "油门曲线" CURVE 0xF336F ECTEK_Curve_u16u16 0 rFactor100_PWM -0 100
 /begin AXIS_DESCR STD_AXIS NO_INPUT_QUANTITY rFactor100_PWM 11 -0 100 DEPOSIT ABSOLUTE FORMAT "%.2" /end AXIS_DESCR
 FORMAT "%.2" /end CHARACTERISTIC
/begin CHARACTERISTIC Speed_Vmh10ms_Crawl_D_M14 "D档蠕动 转速-AD曲线 rpm----mh10ms" CURVE 0xF339D ECTEK_Curve_s16s16 0 Vmh10ms -500 500
 /begin AXIS_DESCR STD_AXIS NO_INPUT_QUANTITY rpm1-1 12 -15000 15000 DEPOSIT ABSOLUTE FORMAT "%.2" /end AXIS_DESCR
 FORMAT "%.2" /end CHARACTERISTIC
/begin CHARACTERISTIC Torque_Increment_Crawl_D_M14 "D档蠕动 AD修正转矩给定每周期增量" CURVE 0xF33CF ECTEK_Curve_s16s16 0 NO_FORMULA -100 100
 /begin AXIS_DESCR STD_AXIS NO_INPUT_QUANTITY Vmh10ms 11 -1000 1000 DEPOSIT ABSOLUTE FORMAT "%.2" /end AXIS_DESCR
 FORMAT "%.2" /end CHARACTERISTIC
/begin CHARACTERISTIC Speed_Max_Torque_Crawl_D_M14 "D档蠕行模式最大力矩" CURVE 0xF33FD ECTEK_Curve_u16s16 0 NO_FORMULA -5000 5000
 /begin AXIS_DESCR STD_AXIS NO_INPUT_QUANTITY rpm1-1 9 -15000 15000 DEPOSIT ABSOLUTE FORMAT "%.2" /end AXIS_DESCR
 FORMAT "%.2" /end CHARACTERISTIC
/begin CHARACTERISTIC Speed_Max_Torque_Crawl_D_Break_M14 "D档蠕行制动状态下最大驱动力矩" CURVE 0xF3423 ECTEK_Curve_u16s16 0 NO_FORMULA -1000 1000
 /begin AXIS_DESCR STD_AXIS NO_INPUT_QUANTITY rpm1-1 9 -15000 15000 DEPOSIT ABSOLUTE FORMAT "%.2" /end AXIS_DESCR
 FORMAT "%.2" /end CHARACTERISTIC
/begin CHARACTERISTIC Speed_Vmh10ms_General_M14 "通用相对转速-AD曲线 rpm----mh10ms" CURVE 0xF3449 ECTEK_Curve_s16s16 0 Vmh10ms -500 500
 /begin AXIS_DESCR STD_AXIS NO_INPUT_QUANTITY rpm1-1 11 -30000 30000 DEPOSIT ABSOLUTE FORMAT "%.2" /end AXIS_DESCR
 FORMAT "%.2" /end CHARACTERISTIC
/begin CHARACTERISTIC Torque_Increment_General_M14 "通用AD修正转矩给定每周期增量" CURVE 0xF3477 ECTEK_Curve_s16s16 0 NO_FORMULA -100 100
 /begin AXIS_DESCR STD_AXIS NO_INPUT_QUANTITY Vmh10ms 11 -1000 1000 DEPOSIT ABSOLUTE FORMAT "%.2" /end AXIS_DESCR
 FORMAT "%.2" /end CHARACTERISTIC
/begin CHARACTERISTIC Speed_Vmh10ms_D_Park_M14 "D档驻坡 转速-AD曲线 rpm----mh10ms" CURVE 0xF34A5 ECTEK_Curve_s16s16 0 Vmh10ms -500 500
 /begin AXIS_DESCR STD_AXIS NO_INPUT_QUANTITY rpm1-1 12 -15000 15000 DEPOSIT ABSOLUTE FORMAT "%.2" /end AXIS_DESCR
 FORMAT "%.2" /end CHARACTERISTIC
/begin CHARACTERISTIC Torque_Increment_D_Park_M14 "D档驻坡AD修正转矩给定每周期增量" CURVE 0xF34D7 ECTEK_Curve_s16s16 0 NO_FORMULA -100 100
 /begin AXIS_DESCR STD_AXIS NO_INPUT_QUANTITY Vmh10ms 11 -1000 1000 DEPOSIT ABSOLUTE FORMAT "%.2" /end AXIS_DESCR
 FORMAT "%.2" /end CHARACTERISTIC
/begin CHARACTERISTIC Motor_Speed_Torque_Break_M14 "电机最大制动力矩" CURVE 0xF3505 ECTEK_Curve_s16s16 0 NO_FORMULA -5000 5000
 /begin AXIS_DESCR STD_AXIS NO_INPUT_QUANTITY rpm1-1 14 -15000 15000 DEPOSIT ABSOLUTE FORMAT "%.2" /end AXIS_DESCR
 FORMAT "%.2" /end CHARACTERISTIC
/begin CHARACTERISTIC FeedBack_Coast_D_Torque_M14 "D档滑行回馈 速度-力矩 定点" CURVE 0xF353F ECTEK_Curve_s16s16 0 NO_FORMULA -5000 5000
 /begin AXIS_DESCR STD_AXIS NO_INPUT_QUANTITY rpm1-1 8 -15000 15000 DEPOSIT ABSOLUTE FORMAT "%.2" /end AXIS_DESCR
 FORMAT "%.2" /end CHARACTERISTIC
/begin CHARACTERISTIC FeedBack_Break_D_Torque_M14 "D档制动回馈 速度-力矩 定点" CURVE 0xF3561 ECTEK_Curve_s16s16 0 NO_FORMULA -5000 5000
 /begin AXIS_DESCR STD_AXIS NO_INPUT_QUANTITY rpm1-1 8 -15000 15000 DEPOSIT ABSOLUTE FORMAT "%.2" /end AXIS_DESCR
 FORMAT "%.2" /end CHARACTERISTIC
/begin CHARACTERISTIC Speed_Efficieny_M14 "电机速度-转换效率曲线 驱动" CURVE 0xF3583 ECTEK_Curve_u16u16 0 rFactor100_PWM 0 100
 /begin AXIS_DESCR STD_AXIS NO_INPUT_QUANTITY rpm1-1 20 0 15000 DEPOSIT ABSOLUTE FORMAT "%.2" /end AXIS_DESCR
 FORMAT "%.2" /end CHARACTERISTIC
/begin CHARACTERISTIC Speed_Efficieny_FeedBack_M14 "电机速度-转换效率曲线 发电" CURVE 0xF35D5 ECTEK_Curve_u16u16 0 rFactor100_PWM 0 150
 /begin AXIS_DESCR STD_AXIS NO_INPUT_QUANTITY rpm1-1 20 0 15000 DEPOSIT ABSOLUTE FORMAT "%.2" /end AXIS_DESCR
 FORMAT "%.2" /end CHARACTERISTIC
/begin CHARACTERISTIC AutoPark_Motor_Speed_Torque_M14 "驻坡最大力矩" CURVE 0xF3627 ECTEK_Curve_u16s16 0 NO_FORMULA 0 5000
 /begin AXIS_DESCR STD_AXIS NO_INPUT_QUANTITY rpm1-1 8 -15000 15000 DEPOSIT ABSOLUTE FORMAT "%.2" /end AXIS_DESCR
 FORMAT "%.2" /end CHARACTERISTIC
/begin CHARACTERISTIC AccPedCD_rUW_CUR_M14 "油门开度" CURVE 0xF3649 ECTEK_Curve_u16u16 0 rFactor100_PWM 0 100
 /begin AXIS_DESCR STD_AXIS NO_INPUT_QUANTITY u5V 7 0 5 DEPOSIT ABSOLUTE FORMAT "%.2" /end AXIS_DESCR
 FORMAT "%.2" /end CHARACTERISTIC
/begin CHARACTERISTIC AccPedCD_rUW_CUR2_M14 "油门2开度" CURVE 0xF3667 ECTEK_Curve_u16u16 0 rFactor100_PWM 0 100
 /begin AXIS_DESCR STD_AXIS NO_INPUT_QUANTITY u5V 7 0 5 DEPOSIT ABSOLUTE FORMAT "%.2" /end AXIS_DESCR
 FORMAT "%.2" /end CHARACTERISTIC
/begin CHARACTERISTIC AC_Condenser_Temp_M14 "空调蒸发器温度 上拉100K 下拉10K" CURVE 0xF3685 ECTEK_Curve_s16u16 0 Temp -100 150
 /begin AXIS_DESCR STD_AXIS NO_INPUT_QUANTITY NO_FORMULA 31 0 4095 DEPOSIT ABSOLUTE FORMAT "%.2" /end AXIS_DESCR
 FORMAT "%.2" /end CHARACTERISTIC
/begin CHARACTERISTIC AC_Condenser_Temp_M14_ACES "空调蒸发器温度_奥易克斯 上拉2.74K 下拉500K" CURVE 0xF3703 ECTEK_Curve_s16u16 0 Temp -100 150
 /begin AXIS_DESCR STD_AXIS NO_INPUT_QUANTITY NO_FORMULA 29 0 4095 DEPOSIT ABSOLUTE FORMAT "%.2" /end AXIS_DESCR
 FORMAT "%.2" /end CHARACTERISTIC
/begin CHARACTERISTIC Air_Pump_Speed_DrapDown_M14 "堵转跌落转速检测阀值" VALUE 0xF3779 ECTEK_Value_s16 0 rpm1-1 -32768 32767 FORMAT "%.2" /end CHARACTERISTIC
/begin CHARACTERISTIC Air_Pump_Torque_DrapDown_M14 "排气力矩检测阀值" VALUE 0xF377B ECTEK_Value_s16 0 rr100 -32768 32767 /end CHARACTERISTIC
/begin CHARACTERISTIC Air_Start_Press_Rate_M14 "气泵启动目标压力百分比" VALUE 0xF377D ECTEK_Value_u8 0 NO_FORMULA 0 100 FORMAT "%.2" /end CHARACTERISTIC
/begin CHARACTERISTIC Air_Over_Reset_M14 "气泵排气复位压力百分比" VALUE 0xF377E ECTEK_Value_u8 0 NO_FORMULA 0 100 FORMAT "%.2" /end CHARACTERISTIC
/begin CHARACTERISTIC Air_Pressure_Delay_Max_M14 "排气后气泵持续工作时间 0.1S" VALUE 0xF377F ECTEK_Value_u16 0 rFactor10_VSSPlaus 0 65535 FORMAT "%.2" /end CHARACTERISTIC
/begin CHARACTERISTIC Air_Pump_WorkTime_M14 "气泵连续工作时间 0.1秒" VALUE 0xF3781 ECTEK_Value_u16 0 rFactor10_VSSPlaus 0 65535 FORMAT "%.2" /end CHARACTERISTIC
/begin CHARACTERISTIC Air_Pump_Fan_Delay_M14 "气泵风扇关闭延迟 0.1S" VALUE 0xF3783 ECTEK_Value_u16 0 rFactor10_VSSPlaus 0 65535 FORMAT "%.2" /end CHARACTERISTIC
/begin CHARACTERISTIC Air_Pump_Taget_Pressure_M14 "压力罐目标压力 Mpa" VALUE 0xF3785 ECTEK_Value_u16 0 rr100 0 1.2 /end CHARACTERISTIC
/begin CHARACTERISTIC Air_Pump_Speed_Limit_M14 "气泵转速限制" VALUE 0xF3787 ECTEK_Value_s16 0 rpm1-1 -3000 3000 FORMAT "%.2" /end CHARACTERISTIC
/begin CHARACTERISTIC Air_Pump_Torque_Limit_M14 "气泵转矩限制" VALUE 0xF3789 ECTEK_Value_u16 0 rr100 0 65535 /end CHARACTERISTIC
/begin CHARACTERISTIC Oil_Pump_Speed_VSpeed_M14 "油泵转速-车速曲线" CURVE 0xF378B ECTEK_Curve_s16s16 0 rpm1-1 -32768 32767
 /begin AXIS_DESCR STD_AXIS NO_INPUT_QUANTITY Speed 11 -32768 32767 DEPOSIT ABSOLUTE FORMAT "%.2" /end AXIS_DESCR
 FORMAT "%.2" /end CHARACTERISTIC
/begin CHARACTERISTIC Oil_Pump_Speed_Limit_M14 "油泵转速限制" VALUE 0xF37B9 ECTEK_Value_s16 0 rpm1-1 -3000 3000 FORMAT "%.2" /end CHARACTERISTIC
/begin CHARACTERISTIC Oil_Pump_Torque_Limit_M14 "油泵转矩限制" VALUE 0xF37BB ECTEK_Value_u16 0 rr100 0 65535 /end CHARACTERISTIC
/begin CHARACTERISTIC Fan_Rate_Temp_M14 "Fan_Rate_Temp_M14" CURVE 0xF37BD ECTEK_Curve_u16u16 0 rr100 0 65535
 /begin AXIS_DESCR STD_AXIS NO_INPUT_QUANTITY NO_FORMULA 5 0 65535 DEPOSIT ABSOLUTE FORMAT "%.2" /end AXIS_DESCR
/end CHARACTERISTIC
/begin RECORD_LAYOUT TEST_Cur_u16u16 ALIGNMENT_BYTE 1 ALIGNMENT_FLOAT32_IEEE 4 ALIGNMENT_FLOAT64_IEEE 4 ALIGNMENT_LONG 4 ALIGNMENT_WORD 2 AXIS_PTS_X 2 UWORD INDEX_INCR DIRECT FNC_VALUES 3 UWORD ROW_DIR DIRECT NO_AXIS_PTS_X 1 UWORD /end RECORD_LAYOUT
/begin RECORD_LAYOUT Test_Map_u16u16u16 ALIGNMENT_BYTE 1 ALIGNMENT_FLOAT32_IEEE 4 ALIGNMENT_FLOAT64_IEEE 4 ALIGNMENT_LONG 4 ALIGNMENT_WORD 2 AXIS_PTS_X 3 UWORD INDEX_INCR DIRECT AXIS_PTS_Y 4 UWORD INDEX_INCR DIRECT FNC_VALUES 5 UWORD COLUMN_DIR DIRECT NO_AXIS_PTS_X 1 UWORD NO_AXIS_PTS_Y 2 UWORD /end RECORD_LAYOUT
/begin RECORD_LAYOUT Test_ValueBlock10_16bit ALIGNMENT_BYTE 1 ALIGNMENT_FLOAT32_IEEE 4 ALIGNMENT_FLOAT64_IEEE 4 ALIGNMENT_LONG 4 ALIGNMENT_WORD 2 FIX_NO_AXIS_PTS_X 10 FNC_VALUES 1 UWORD COLUMN_DIR DIRECT /end RECORD_LAYOUT
/begin RECORD_LAYOUT Test_ValueBlock12_16bit ALIGNMENT_FLOAT32_IEEE 4 ALIGNMENT_FLOAT64_IEEE 8 ALIGNMENT_LONG 4 ALIGNMENT_WORD 2 FIX_NO_AXIS_PTS_X 16 FNC_VALUES 1 UWORD COLUMN_DIR DIRECT /end RECORD_LAYOUT
/begin RECORD_LAYOUT Test_ValueBlock12_8bit ALIGNMENT_BYTE 1 ALIGNMENT_FLOAT32_IEEE 4 ALIGNMENT_FLOAT64_IEEE 4 ALIGNMENT_LONG 4 ALIGNMENT_WORD 2 FIX_NO_AXIS_PTS_X 12 FNC_VALUES 1 UBYTE COLUMN_DIR DIRECT /end RECORD_LAYOUT
/begin RECORD_LAYOUT Test_ValueBlock16_16bit ALIGNMENT_BYTE 1 ALIGNMENT_FLOAT32_IEEE 4 ALIGNMENT_FLOAT64_IEEE 4 ALIGNMENT_LONG 4 ALIGNMENT_WORD 2 FIX_NO_AXIS_PTS_X 16 FNC_VALUES 1 UWORD COLUMN_DIR DIRECT /end RECORD_LAYOUT
/begin RECORD_LAYOUT Test_ValueBlock16_8bit ALIGNMENT_BYTE 1 ALIGNMENT_FLOAT32_IEEE 4 ALIGNMENT_FLOAT64_IEEE 4 ALIGNMENT_LONG 4 ALIGNMENT_WORD 2 FIX_NO_AXIS_PTS_X 16 FNC_VALUES 1 UBYTE COLUMN_DIR DIRECT /end RECORD_LAYOUT
/begin RECORD_LAYOUT Test_ValueBlock2_16bit ALIGNMENT_BYTE 1 ALIGNMENT_FLOAT32_IEEE 4 ALIGNMENT_FLOAT64_IEEE 4 ALIGNMENT_LONG 4 ALIGNMENT_WORD 2 FIX_NO_AXIS_PTS_X 2 FNC_VALUES 1 UWORD COLUMN_DIR DIRECT /end RECORD_LAYOUT
/begin RECORD_LAYOUT __UBYTE_Z FNC_VALUES 1 UBYTE ROW_DIR DIRECT /end RECORD_LAYOUT
/begin RECORD_LAYOUT __UWORD_Z FNC_VALUES 1 UWORD ROW_DIR DIRECT /end RECORD_LAYOUT
/begin RECORD_LAYOUT __ULONG_Z FNC_VALUES 1 ULONG ROW_DIR DIRECT /end RECORD_LAYOUT
/begin RECORD_LAYOUT __SBYTE_Z FNC_VALUES 1 SBYTE ROW_DIR DIRECT /end RECORD_LAYOUT
/begin RECORD_LAYOUT __SWORD_Z FNC_VALUES 1 SWORD ROW_DIR DIRECT /end RECORD_LAYOUT
/begin RECORD_LAYOUT __SLONG_Z FNC_VALUES 1 SLONG ROW_DIR DIRECT /end RECORD_LAYOUT
/begin RECORD_LAYOUT __FLOAT32_IEEE_Z FNC_VALUES 1 FLOAT32_IEEE ROW_DIR DIRECT /end RECORD_LAYOUT
/begin RECORD_LAYOUT __FLOAT64_IEEE_Z FNC_VALUES 1 FLOAT32_IEEE ROW_DIR DIRECT /end RECORD_LAYOUT
/begin RECORD_LAYOUT __UBYTE_S FNC_VALUES 1 UBYTE COLUMN_DIR DIRECT /end RECORD_LAYOUT
/begin RECORD_LAYOUT __UWORD_S FNC_VALUES 1 UWORD COLUMN_DIR DIRECT /end RECORD_LAYOUT
/begin RECORD_LAYOUT __ULONG_S FNC_VALUES 1 ULONG COLUMN_DIR DIRECT /end RECORD_LAYOUT
/begin RECORD_LAYOUT __SBYTE_S FNC_VALUES 1 SBYTE COLUMN_DIR DIRECT /end RECORD_LAYOUT
/begin RECORD_LAYOUT __SWORD_S FNC_VALUES 1 SWORD COLUMN_DIR DIRECT /end RECORD_LAYOUT
/begin RECORD_LAYOUT __SLONG_S FNC_VALUES 1 SLONG COLUMN_DIR DIRECT /end RECORD_LAYOUT
/begin RECORD_LAYOUT __FLOAT32_IEEE_S FNC_VALUES 1 FLOAT32_IEEE COLUMN_DIR DIRECT /end RECORD_LAYOUT
/begin RECORD_LAYOUT __FLOAT64_IEEE_S FNC_VALUES 1 FLOAT32_IEEE COLUMN_DIR DIRECT /end RECORD_LAYOUT
/begin RECORD_LAYOUT SSV__UBYTE_S AXIS_PTS_X 1 UBYTE INDEX_INCR DIRECT /end RECORD_LAYOUT
/begin RECORD_LAYOUT SSV__UWORD_S AXIS_PTS_X 1 UWORD INDEX_INCR DIRECT /end RECORD_LAYOUT
/begin RECORD_LAYOUT SSV__ULONG_S AXIS_PTS_X 1 ULONG INDEX_INCR DIRECT /end RECORD_LAYOUT
/begin RECORD_LAYOUT SSV__SBYTE_S AXIS_PTS_X 1 SBYTE INDEX_INCR DIRECT /end RECORD_LAYOUT
/begin RECORD_LAYOUT SSV__SWORD_S AXIS_PTS_X 1 SWORD INDEX_INCR DIRECT /end RECORD_LAYOUT
/begin RECORD_LAYOUT SSV__SLONG_S AXIS_PTS_X 1 SLONG INDEX_INCR DIRECT /end RECORD_LAYOUT
/begin RECORD_LAYOUT SSV__FLOAT32_IEEE_S AXIS_PTS_X 1 FLOAT32_IEEE INDEX_INCR DIRECT /end RECORD_LAYOUT
/begin RECORD_LAYOUT SSV__FLOAT64_IEEE_S AXIS_PTS_X 1 FLOAT32_IEEE INDEX_INCR DIRECT /end RECORD_LAYOUT
/begin RECORD_LAYOUT ECTEK_Value_u16 ALIGNMENT_BYTE 1 ALIGNMENT_FLOAT32_IEEE 1 ALIGNMENT_FLOAT64_IEEE 1 ALIGNMENT_LONG 1 ALIGNMENT_WORD 1 FNC_VALUES 1 UWORD ROW_DIR DIRECT /end RECORD_LAYOUT
/begin RECORD_LAYOUT ECTEK_Value_u8 ALIGNMENT_BYTE 1 ALIGNMENT_FLOAT32_IEEE 1 ALIGNMENT_FLOAT64_IEEE 1 ALIGNMENT_LONG 1 ALIGNMENT_WORD 1 FNC_VALUES 1 UBYTE ROW_DIR DIRECT /end RECORD_LAYOUT
/begin RECORD_LAYOUT ECTEK_Value_u32 ALIGNMENT_BYTE 1 ALIGNMENT_FLOAT32_IEEE 1 ALIGNMENT_FLOAT64_IEEE 1 ALIGNMENT_LONG 1 ALIGNMENT_WORD 1 FNC_VALUES 1 ULONG ROW_DIR DIRECT /end RECORD_LAYOUT
/begin RECORD_LAYOUT ECTEK_ValueBlock3_u16 ALIGNMENT_BYTE 1 ALIGNMENT_FLOAT32_IEEE 1 ALIGNMENT_FLOAT64_IEEE 1 ALIGNMENT_LONG 1 ALIGNMENT_WORD 1 FIX_NO_AXIS_PTS_X 3 FNC_VALUES 1 UWORD COLUMN_DIR DIRECT /end RECORD_LAYOUT
/begin RECORD_LAYOUT ECTEK_ValueBlock4_u16 ALIGNMENT_BYTE 1 ALIGNMENT_FLOAT32_IEEE 1 ALIGNMENT_FLOAT64_IEEE 1 ALIGNMENT_LONG 1 ALIGNMENT_WORD 1 FIX_NO_AXIS_PTS_X 4 FNC_VALUES 1 UWORD COLUMN_DIR DIRECT /end RECORD_LAYOUT
/begin RECORD_LAYOUT ECTEK_Curve_u16u16 ALIGNMENT_BYTE 1 ALIGNMENT_FLOAT32_IEEE 1 ALIGNMENT_FLOAT64_IEEE 1 ALIGNMENT_LONG 1 ALIGNMENT_WORD 1 AXIS_PTS_X 2 UWORD INDEX_INCR DIRECT FNC_VALUES 3 UWORD ROW_DIR DIRECT NO_AXIS_PTS_X 1 UWORD /end RECORD_LAYOUT
/begin RECORD_LAYOUT ECTEK_Value_s16 ALIGNMENT_BYTE 1 ALIGNMENT_FLOAT32_IEEE 1 ALIGNMENT_FLOAT64_IEEE 1 ALIGNMENT_LONG 1 ALIGNMENT_WORD 1 FNC_VALUES 1 SWORD ROW_DIR DIRECT /end RECORD_LAYOUT
/begin RECORD_LAYOUT ECTEK_Curve_u16s16 ALIGNMENT_BYTE 1 ALIGNMENT_FLOAT32_IEEE 1 ALIGNMENT_FLOAT64_IEEE 1 ALIGNMENT_LONG 1 ALIGNMENT_WORD 1 AXIS_PTS_X 2 SWORD INDEX_INCR DIRECT FNC_VALUES 3 UWORD ROW_DIR DIRECT NO_AXIS_PTS_X 1 UWORD /end RECORD_LAYOUT
/begin RECORD_LAYOUT ECTEK_Curve_s16s16 ALIGNMENT_BYTE 1 ALIGNMENT_FLOAT32_IEEE 1 ALIGNMENT_FLOAT64_IEEE 1 ALIGNMENT_LONG 1 ALIGNMENT_WORD 1 AXIS_PTS_X 2 SWORD INDEX_INCR DIRECT FNC_VALUES 3 SWORD ROW_DIR DIRECT NO_AXIS_PTS_X 1 UWORD /end RECORD_LAYOUT
/begin RECORD_LAYOUT ECTEK_Value_s8 ALIGNMENT_BYTE 1 ALIGNMENT_FLOAT32_IEEE 1 ALIGNMENT_FLOAT64_IEEE 1 ALIGNMENT_LONG 1 ALIGNMENT_WORD 1 FNC_VALUES 1 SBYTE ROW_DIR DIRECT /end RECORD_LAYOUT
/begin RECORD_LAYOUT ECTEK_Curve_s16u16 ALIGNMENT_BYTE 1 ALIGNMENT_FLOAT32_IEEE 1 ALIGNMENT_FLOAT64_IEEE 1 ALIGNMENT_LONG 1 ALIGNMENT_WORD 1 AXIS_PTS_X 2 UWORD INDEX_INCR DIRECT FNC_VALUES 3 SWORD ROW_DIR DIRECT NO_AXIS_PTS_X 1 UWORD /end RECORD_LAYOUT
/begin RECORD_LAYOUT ECTEK_ValueBlock2_u16 ALIGNMENT_BYTE 1 ALIGNMENT_FLOAT32_IEEE 1 ALIGNMENT_FLOAT64_IEEE 1 ALIGNMENT_LONG 1 ALIGNMENT_WORD 1 FIX_NO_AXIS_PTS_X 2 FNC_VALUES 1 UWORD COLUMN_DIR DIRECT /end RECORD_LAYOUT
/begin RECORD_LAYOUT ECTEK_ValueBlock10_u16 ALIGNMENT_BYTE 1 ALIGNMENT_FLOAT32_IEEE 1 ALIGNMENT_FLOAT64_IEEE 1 ALIGNMENT_LONG 1 ALIGNMENT_WORD 1 FIX_NO_AXIS_PTS_X 10 FNC_VALUES 1 UWORD COLUMN_DIR DIRECT /end RECORD_LAYOUT
/end MODULE
/end PROJECT
