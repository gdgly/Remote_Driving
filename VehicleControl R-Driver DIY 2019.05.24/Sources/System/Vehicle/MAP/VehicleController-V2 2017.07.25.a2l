ASAP2_VERSION 1 51
/begin PROJECT EUP ""
/begin MODULE CPP ""
/begin MOD_COMMON "" BYTE_ORDER MSB_FIRST ALIGNMENT_BYTE 1 ALIGNMENT_WORD 2 ALIGNMENT_LONG 4 ALIGNMENT_FLOAT32_IEEE 4 ALIGNMENT_FLOAT64_IEEE 8 /end MOD_COMMON
/begin IF_DATA ASAP1B_CCP
 /begin SOURCE "10ms" 0x4 0x1
  /begin QP_BLOB 0x0 LENGTH 0x14 CAN_ID_FIXED 0x101 RASTER 0x0 FIRST_PID 0x0 /end QP_BLOB
 /end SOURCE
 /begin SOURCE "100ms" 0x4 0xA
  /begin QP_BLOB 0x1 LENGTH 0x14 CAN_ID_FIXED 0x101 RASTER 0x1 FIRST_PID 0x14 /end QP_BLOB
 /end SOURCE
 /begin RASTER "10ms" "10ms" 0x0 0x4 0x1 /end RASTER
 /begin RASTER "100ms" "100ms" 0x1 0x4 0xA /end RASTER
 /begin TP_BLOB 0x201 0x206 0x100 0x101 0x100 0x1 BAUDRATE 0x3D090 SAMPLE_POINT 0x4B SAMPLE_RATE 0x1 BTL_CYCLES 0x8 SJW 0x2 SYNC_EDGE SINGLE DAQ_MODE BURST CONSISTENCY ODT ADDRESS_EXTENSION DAQ /begin CHECKSUM_PARAM 0xFFFF8007 0x10000 CHECKSUM_CALCULATION ACTIVE_PAGE /end CHECKSUM_PARAM /begin DEFINED_PAGES 0x1 "ROM_PAGE" 0x0 0x7D0000 0x4000 ROM /end DEFINED_PAGES /begin DEFINED_PAGES 0x2 "RAM" 0x0 0xF0000 0x4000 RAM RAM_INIT_BY_ECU /end DEFINED_PAGES OPTIONAL_CMD 0x9 OPTIONAL_CMD 0xE OPTIONAL_CMD 0x11 OPTIONAL_CMD 0xC OPTIONAL_CMD 0xD OPTIONAL_CMD 0xF OPTIONAL_CMD 0x23 OPTIONAL_CMD 0x8 /end TP_BLOB
/end IF_DATA
/begin MOD_PAR "整车控制器105E" ADDR_EPK 0x13F6A7
 /begin MEMORY_SEGMENT EFLASHDATA "" DATA FLASH EXTERN 0x7D0000 0x4000 -1 -1 -1 -1 -1 /end MEMORY_SEGMENT
 /begin MEMORY_SEGMENT ERAMDATA "" DATA RAM EXTERN 0xF0000 0x4000 -1 -1 -1 -1 -1 /end MEMORY_SEGMENT
 NO_OF_INTERFACES 1 /end MOD_PAR
/begin COMPU_VTAB EGR_NOX "" TAB_VERB 5 0 "OK" 1 "Below3" 2 "Over3Below5" 3 "Over5Below7" 4 "Over7" /end COMPU_VTAB
/begin COMPU_VTAB EGR_OBD "" TAB_VERB 2 0 "OK" 1 "STUCK" /end COMPU_VTAB
/begin COMPU_VTAB EGR_VALVE "" TAB_VERB 2 0 "OK" 1 "STUCK" /end COMPU_VTAB
/begin COMPU_VTAB bCondition "" TAB_VERB 2 0 "否(No)" 1 "是(Yes)" DEFAULT_VALUE "0" /end COMPU_VTAB
/begin COMPU_VTAB bFunctionActive "" TAB_VERB 2 0 "功能禁止(Inactive)" 1 "功能启用(Active)" /end COMPU_VTAB
/begin COMPU_VTAB bSwitch "开关" TAB_VERB 2 0 "关(Close)" 1 "开(Open)" /end COMPU_VTAB
/begin COMPU_VTAB idxAccPedType "油门类型" TAB_VERB 4 0 "不配备(Without)" 1 "双油门(Dual Analog)" 2 "带怠速开关(With Idle Switch)" 3 "单油门(Single Analog)" /end COMPU_VTAB
/begin COMPU_VTAB idxAirHeaterTempSel "进气加热温度选择情况" TAB_VERB 6 0 "机油温度(Oil Temperature)" 1 "进气温度(Intake Air Temperature)" 2 "燃油温度(Fuel Temperature)" 3 "环境温度(Environment Temperature)" 4 "冷却水温(Coolant Temperature)" 255 "没有选中(None)" /end COMPU_VTAB
/begin COMPU_VTAB idxDDRCType "" TAB_VERB 4 0 "TimeInRow" 1 "EventInRow" 2 "TimeUpDown" 3 "EventUpDown" DEFAULT_VALUE "TimeInRow" /end COMPU_VTAB
/begin COMPU_VTAB idxDFC "" TAB_VERB 151 0 "无故障(None)" 1 "曲轴信号缺失(Crankshaft No Sig)" 2 "曲轴信号错误(Crankshaft Err Sig)" 3 "凸轮轴信号缺失(Camshaft No Sig)" 4 "凸轮轴信号错误(Camshaft Err Sig)" 5 "未知名故障(Unkown)" 6 "未知名故障(Unkown)" 7 "未知名故障(Unkown)" 8 "未知名故障(Unkown)" 9 "未知名故障(Unkown)" 10 "未知名故障(Unkown)" 11 "大气压力SRC高(APS SRC High)" 12 "大气压力SRC低(APS SRC Low)" 13 "大气压力合理性故障(APS Npl)" 14 "增压压力SRC高(BPS SRC High)" 15 "增压压力SRC低(BPS SRC Low)" 16 "增压压力合理性故障(BPS Npl)" 17 "增压温度SRC高(IATS SRC High)" 18 "增压温度SRC低(IATS SRC Low)" 19 "冷却水温SRC高(CTS SRC High)" 20 "冷却水温SRC低(CTS SRC Low)" 21 "冷却水温合理性故障(CTS Npl )" 22 "冷却水温动态测试故障(CTS DynTest Err)" 23 "燃油温度SRC高(FTS SRC High)" 24 "燃油温度SRC低(FTS SRC Low)" 25 "油门踏板1SRC高(AccPed1 SRC High)" 26 "油门踏板1SRC低(AccPed1 SRC Low)" 27 "油门踏板1合理性故障(AccPed1 Npl)" 28 "油门踏板2SRC高(AccPed2 SRC High)'" 29 "油门踏板2SRC低(AccPed2 SRC Low)" 30 "油门踏板2合理性故障(AccPed2 Npl)" 31 "环境温度SRC高(ETS SRC High)" 32 "环境温度SRC低(ETS SRC Low)" 33 "机油压力SRC高(OPS SRC High)" 34 "机油压力SRC低(OPS SRC Low)" 35 "机油压力合理性低故障(OPS LNpl)" 36 "机油压力合理性高故障(OPS HNpl)" 37 "机油温度SRC高(OTS SRC Sigh)" 38 "机油温度SRC低(OTS SRC Low)" 39 "机油温度合理性故障(OTS Npl)" 40 "机油温度超过最大值(OTS SIGMax)" 41 "EGR位置传感器SRC高" 42 "EGR位置传感器SRC低" 43 "POC压差传感器SRC高" 44 "POC压差传感器SRC低" 45 "轨压传感器SRC高" 46 "轨压传感器SRC低" 47 "未知名故障(Unkown)" 48 "未知名故障(Unkown)" 49 "未知名故障(Unkown)" 50 "未知名故障(Unkown)" 51 "第一缸短路(Cyl1 ShortCircuit)" 52 "第一缸断路(Cyl1 OpenLoad)" 53 "第一缸不合理(Cyl1 Npl)" 54 "第二缸短路(Cyl2 ShortCircuit)" 55 "第二缸断路(Cyl2 OpenLoad)" 56 "第二缸不合理(Cyl2 Npl)" 57 "第三缸短路(Cyl3 ShortCircuit)" 58 "第三缸断路(Cyl3 OpenLoad)" 59 "第三缸不合理(Cyl3 Npl)" 60 "第四缸短路(Cyl4 ShortCircuit)" 61 "第四缸断路(Cyl4 OpenLoad)" 62 "第四缸不合理(Cyl4 Npl)" 63 "第五缸短路(Cyl5 ShortCircuit)" 64 "第五缸断路(Cyl5 OpenLoad)" 65 "第五缸不合理(Cyl5 Npl)" 66 "第六缸短路(Cyl6 ShortCircuit)" 67 "第六缸断路(Cyl6 OpenLoad)" 68 "第六缸不合理(Cyl6 Npl)" 69 "第一缸无始点(Cyl1 BIT No)" 70 "第一缸无始点(Cyl1 BIT Npl)" 71 "第二缸无始点(Cy12 BIT No)" 72 "第二缸始点不合理(Cy12 BIT Err)" 73 "第三缸无始点(Cy13 BIT No)" 74 "第三缸始点不合理(Cy13 BIT Npl)" 75 "第四缸无始点(Cy14 BIT No)" 76 "第四缸始点不合理(Cy14 BIT Err)" 77 "第五缸无始点(Cy15 BIT No)" 78 "第五缸始点不合理(Cy15 BIT Err)" 79 "第六缸无始点(Cy16 BIT No)" 80 "第六缸始点不合理(Cy16 BIT Err)" 81 "空调继电器短路(AC Relay ShortCircuit)" 82 "空调继电器断路(AC Relay OpenLoad)" 83 "排气制动阀短路(EB Realy ShortCircuit)" 84 "排气制动阀断路(EB Relay OpenLoad)" 85 "排气制动指示灯短路(EB Lamp ShortCircuit)" 86 "排气制动指示灯断路(EB Lamp OpenLoad)" 87 "进气加热继电器短路(CS Realy ShortCircuit)" 88 "进气加热继电器断路(CS Realy Openload)" 89 "进气加热指示灯短路(CS Lamp ShortCircuit)" 90 "进气加热指示灯断路(CS Lamp OpenLoad)" 91 "OBD故障灯短路(OBD Lamp ShortCircuit)" 92 "OBD故障灯断路(OBD Lamp OpenLoad)" 93 "SVS灯短路(SVS Lamp ShortCircuit)" 94 "SVS灯断路(SVS Lamp OpenLoad)" 95 "主继电器短路(MainRelay ShortCircuit)" 96 "主继电器断路(MainRelay OpenCircuit)" 97 "EGR电机供电故障" 98 "EGR电机短路到电源" 99 "EGR电机短路到地" 100 "EGR电机开路" 101 "EGR电机过热" 102 "EGR阀流量过大" 103 "EGR阀NOx限值1超标" 104 "EGR阀NOx限值2超标" 105 "DOC/POC压差故障" 106 "轨压控制器正偏差超过上限" 107 "轨压控制器负偏差超过下限" 108 "高压油泵油量过大" 109 "油压低于下限" 110 "油压高于上限" 111 "怠速时轨压控制器开度不合适" 112 "未知名故障(Unkown)" 113 "未知名故障(Unkown)" 114 "未知名故障(Unkown)" 115 "未知名故障(Unkown)" 116 "未知名故障(Unkown)" 117 "未知名故障(Unkown)" 118 "未知名故障(Unkown)" 119 "未知名故障(Unkown)" 120 "未知名故障(Unkown)" 121 "EEPROM不可用(EEPROM Defect)" 122 "部分EEPROM不可用(EEPROM Preliminary Defect)" 123 "AD参考电压过高(AD Reference High)" 124 "AD参考电压过低(AD Reference Low)" 125 "未知名故障(Unkown)" 126 "未知名故障(Unkown)" 127 "未知名故障(Unkown)" 128 "未知名故障(Unkown)" 129 "未知名故障(Unkown)" 130 "未知名故障(Unkown)" 131 "未知名故障(Unkown)" 132 "未知名故障(Unkown)" 133 "未知名故障(Unkown)" 134 "未知名故障(Unkown)" 135 "未知名故障(Unkown)" 136 "未知名故障(Unkown)" 137 "未知名故障(Unkown)" 138 "未知名故障(Unkown)" 139 "未知名故障(Unkown)" 140 "未知名故障(Unkown)" 141 "电池电压高(Battery Voltage High)" 142 "电池电压低(Battery Voltage Low)" 143 "DCDC电压高(DCDC Voltage High)" 144 "DCDC电压低(DCDC Voltage Low)" 145 "DCDC电压不合理(DCDC Voltage Npl)" 146 "未知名故障(Unkown)" 147 "未知名故障(Unkown)" 148 "未知名故障(Unkown)" 149 "未知名故障(Unkown)" 150 "未知名故障(Unkown)" DEFAULT_VALUE "未知名故障(Unkown)" /end COMPU_VTAB
/begin COMPU_VTAB idxDFC2 "" TAB_VERB 151 0 "曲轴信号缺失(Crankshaft No Sig)" 1 "曲轴信号错误(Crankshaft Err Sig)" 2 "凸轮轴信号缺失(Camshaft No Sig)" 3 "凸轮轴信号错误(Camshaft Err Sig)" 4 "未知名故障(Unkown)" 5 "未知名故障(Unkown)" 6 "未知名故障(Unkown)" 7 "未知名故障(Unkown)" 8 "未知名故障(Unkown)" 9 "未知名故障(Unkown)" 10 "大气压力SRC高(APS SRC High)" 11 "大气压力SRC低(APS SRC Low)" 12 "大气压力合理性故障(APS Npl)" 13 "增压压力SRC高(BPS SRC High)" 14 "增压压力SRC低(BPS SRC Low)" 15 "增压压力合理性故障(BPS Npl)" 16 "增压温度SRC高(IATS SRC High)" 17 "增压温度SRC低(IATS SRC Low)" 18 "冷却水温SRC高(CTS SRC High)" 19 "冷却水温SRC低(CTS SRC Low)" 20 "冷却水温合理性故障(CTS Npl )" 21 "冷却水温动态测试故障(CTS DynTest Err)" 22 "燃油温度SRC高(FTS SRC High)" 23 "燃油温度SRC低(FTS SRC Low)" 24 "油门踏板1SRC高(AccPed1 SRC High)" 25 "油门踏板1SRC低(AccPed1 SRC Low)" 26 "油门踏板1合理性故障(AccPed1 Npl)" 27 "油门踏板2SRC高(AccPed2 SRC High)'" 28 "油门踏板2SRC低(AccPed2 SRC Low)" 29 "油门踏板2合理性故障(AccPed2 Npl)" 30 "环境温度SRC高(ETS SRC High)" 31 "环境温度SRC低(ETS SRC Low)" 32 "机油压力SRC高(OPS SRC High)" 33 "机油压力SRC低(OPS SRC Low)" 34 "机油压力合理性低故障(OPS LNpl)" 35 "机油压力合理性高故障(OPS HNpl)" 36 "机油温度SRC高(OTS SRC Sigh)" 37 "机油温度SRC低(OTS SRC Low)" 38 "机油温度合理性故障(OTS Npl)" 39 "机油温度超过最大值(OTS SIGMax)" 40 "EGR位置传感器SRC高" 41 "EGR位置传感器SRC低" 42 "POC压差传感器SRC高" 43 "POC压差传感器SRC低" 44 "轨压传感器SRC高" 45 "轨压传感器SRC低" 46 "未知名故障(Unkown)" 47 "未知名故障(Unkown)" 48 "未知名故障(Unkown)" 49 "未知名故障(Unkown)" 50 "第一缸短路(Cyl1 ShortCircuit)" 51 "第一缸断路(Cyl1 OpenLoad)" 52 "第一缸不合理(Cyl1 Npl)" 53 "第二缸短路(Cyl2 ShortCircuit)" 54 "第二缸断路(Cyl2 OpenLoad)" 55 "第二缸不合理(Cyl2 Npl)" 56 "第三缸短路(Cyl3 ShortCircuit)" 57 "第三缸断路(Cyl3 OpenLoad)" 58 "第三缸不合理(Cyl3 Npl)" 59 "第四缸短路(Cyl4 ShortCircuit)" 60 "第四缸断路(Cyl4 OpenLoad)" 61 "第四缸不合理(Cyl4 Npl)" 62 "第五缸短路(Cyl5 ShortCircuit)" 63 "第五缸断路(Cyl5 OpenLoad)" 64 "第五缸不合理(Cyl5 Npl)" 65 "第六缸短路(Cyl6 ShortCircuit)" 66 "第六缸断路(Cyl6 OpenLoad)" 67 "第六缸不合理(Cyl6 Npl)" 68 "第一缸无始点(Cyl1 BIT No)" 69 "第一缸无始点(Cyl1 BIT Npl)" 70 "第二缸无始点(Cy12 BIT No)" 71 "第二缸始点不合理(Cy12 BIT Err)" 72 "第三缸无始点(Cy13 BIT No)" 73 "第三缸始点不合理(Cy13 BIT Npl)" 74 "第四缸无始点(Cy14 BIT No)" 75 "第四缸始点不合理(Cy14 BIT Err)" 76 "第五缸无始点(Cy15 BIT No)" 77 "第五缸始点不合理(Cy15 BIT Err)" 78 "第六缸无始点(Cy16 BIT No)" 79 "第六缸始点不合理(Cy16 BIT Err)" 80 "空调继电器短路(AC Relay ShortCircuit)" 81 "空调继电器断路(AC Relay OpenLoad)" 82 "排气制动阀短路(EB Realy ShortCircuit)" 83 "排气制动阀断路(EB Relay OpenLoad)" 84 "排气制动指示灯短路(EB Lamp ShortCircuit)" 85 "排气制动指示灯断路(EB Lamp OpenLoad)" 86 "进气加热继电器短路(CS Realy ShortCircuit)" 87 "进气加热继电器断路(CS Realy Openload)" 88 "进气加热指示灯短路(CS Lamp ShortCircuit)" 89 "进气加热指示灯断路(CS Lamp OpenLoad)" 90 "OBD故障灯短路(OBD Lamp ShortCircuit)" 91 "OBD故障灯断路(OBD Lamp OpenLoad)" 92 "SVS灯短路(SVS Lamp ShortCircuit)" 93 "SVS灯断路(SVS Lamp OpenLoad)" 94 "主继电器短路(MainRelay ShortCircuit)" 95 "主继电器断路(MainRelay OpenCircuit)" 96 "EGR电机供电故障" 97 "EGR电机短路到电源" 98 "EGR电机短路到地" 99 "EGR电机开路" 100 "EGR电机过热" 101 "EGR阀流量过大" 102 "EGR阀NOx限值1超标" 103 "EGR阀NOx限值2超标" 104 "DOC/POC压差故障" 105 "轨压控制器正偏差超过上限" 106 "轨压控制器负偏差超过下限" 107 "高压油泵油量过大" 108 "油压低于下限" 109 "油压高于上限" 110 "怠速时轨压控制器开度不合适" 111 "未知名故障(Unkown)" 112 "未知名故障(Unkown)" 113 "未知名故障(Unkown)" 114 "未知名故障(Unkown)" 115 "未知名故障(Unkown)" 116 "未知名故障(Unkown)" 117 "未知名故障(Unkown)" 118 "未知名故障(Unkown)" 119 "未知名故障(Unkown)" 120 "EEPROM不可用(EEPROM Defect)" 121 "部分EEPROM不可用(EEPROM Preliminary Defect)" 122 "AD参考电压过高(AD Reference High)" 123 "AD参考电压过低(AD Reference Low)" 124 "未知名故障(Unkown)" 125 "未知名故障(Unkown)" 126 "未知名故障(Unkown)" 127 "未知名故障(Unkown)" 128 "未知名故障(Unkown)" 129 "未知名故障(Unkown)" 130 "未知名故障(Unkown)" 131 "未知名故障(Unkown)" 132 "未知名故障(Unkown)" 133 "未知名故障(Unkown)" 134 "未知名故障(Unkown)" 135 "未知名故障(Unkown)" 136 "未知名故障(Unkown)" 137 "未知名故障(Unkown)" 138 "未知名故障(Unkown)" 139 "未知名故障(Unkown)" 140 "电池电压高(Battery Voltage High)" 141 "电池电压低(Battery Voltage Low)" 142 "DCDC电压高(DCDC Voltage High)" 143 "DCDC电压低(DCDC Voltage Low)" 144 "DCDC电压不合理(DCDC Voltage Npl)" 145 "未知名故障(Unkown)" 146 "未知名故障(Unkown)" 147 "未知名故障(Unkown)" 148 "未知名故障(Unkown)" 149 "未知名故障(Unkown)" 65535 "DFC_Notused" DEFAULT_VALUE "DFC_Notused" /end COMPU_VTAB
/begin COMPU_VTAB idxDINHLevel "" TAB_VERB 21 0 "LevlNotUsed" 1 "Tested" 2 "NotTested" 3 "Def0Deb0" 4 "Def25Deb0" 5 "Def50Deb0" 6 "Def50Deb25" 7 "Def50Deb50" 8 "Def50Deb75" 9 "Def50Deb100" 10 "Def75Deb0" 11 "Def75Deb25" 12 "Def75Deb50" 13 "Def75Deb75" 14 "Def75Deb100" 15 "Def1000Deb0" 16 "Def100Deb25" 17 "Def100Deb50" 18 "Def100Deb75" 19 "Def100Deb100" 20 "MemoryEntryStatus" DEFAULT_VALUE "LevlNotUsed" /end COMPU_VTAB
/begin COMPU_VTAB idxDSMSigList "" TAB_VERB 14 1 "冷却水温(Coolant Temperature)" 2 "增压压力(Boost Pressure)" 3 "发动机转速(Engine Speed)" 4 "车速(Vehicle Speed)" 5 "进气温度(Intake Air Temperature)" 6 "环境温度(Abmient Temperature)" 7 "发动机起动后时间(Engine Running Time)" 8 "轨压(Rail Pressure)" 9 "控制模块电压(Battery Voltage)" 16 "油门位置1" 19 "目标EGR率(Target EGR Rate)" 20 "EGR率差别(EGR Rate Err)" 21 "大气压力(Ambient Pressure)" 255 "没有信号(None)" DEFAULT_VALUE "没有信号" /end COMPU_VTAB
/begin COMPU_VTAB stDFCDisblMsk "" TAB_VERB 2 0 "允许" 128 "禁止" /end COMPU_VTAB
/begin COMPU_VTAB stDFCDisblMsk2 "" TAB_VERB 2 0 "允许" 128 "禁止" /end COMPU_VTAB
/begin COMPU_VTAB idxDFESClsMIL "" TAB_VERB 2 0 "OBD灯不相关" 1 "OBD灯需要点亮" /end COMPU_VTAB
/begin COMPU_VTAB idxDFESClsSvs "" TAB_VERB 2 0 "Svs灯不相关" 1 "Svs灯点亮" /end COMPU_VTAB
/begin COMPU_VTAB idxDFESClsPrio "" TAB_VERB 8 4 "Invisible" 32 "ServiceLow" 40 "ServiceHigh" 96 "OBDLow" 104 "OBDHigh" 168 "ServiceHigh_Max" 224 "ServiceHigh_OBDLow_Max" 232 "ServiceHigh_OBDHigh_Max" /end COMPU_VTAB
/begin COMPU_VTAB idxDurationType "" TAB_VERB 2 0 "角度表示(Time Duration)" 1 "时间表示(Angle Duration)" DEFAULT_VALUE "0" /end COMPU_VTAB
/begin COMPU_VTAB idxEGRCleanProcessing "" TAB_VERB 3 0 "Waiting" 1 "Processing" 2 "Processed" /end COMPU_VTAB
/begin COMPU_VTAB idxEGRControlState "EGR控制状态" TAB_VERB 3 0 "KeyOn" 1 "Normal" 2 "KeyOff" DEFAULT_VALUE "1" /end COMPU_VTAB
/begin COMPU_VTAB idxEGRLearnProcess "EGR学习状态" TAB_VERB 3 0 "Waiting" 1 "Processing" 2 "Processed" DEFAULT_VALUE "1" /end COMPU_VTAB
/begin COMPU_VTAB idxEGRPositionControl "EGR位置控制方式" TAB_VERB 2 0 "PositionPID" 1 "OpenLoop" /end COMPU_VTAB
/begin COMPU_VTAB idxEISGovFunction "" TAB_VERB 4 0 "低怠速(Low Idle)" 1 "高怠速(High Idle)" 2 "保留(Reserved)" 255 "没有活跃的功能(None)" /end COMPU_VTAB
/begin COMPU_VTAB idxEdgeType "边沿捕捉" TAB_VERB 4 0 "不捕捉(None)" 1 "上升沿(Rising Edge)" 2 "下降沿(Falling Edge)" 3 "所有边沿(All)" DEFAULT_VALUE "0" /end COMPU_VTAB
/begin COMPU_VTAB idxFID "" TAB_VERB 21 0 "使用机油温度计算水温(OTS Replace CTS Enable)" 1 "使用水温来诊断油温(CTS OTS Diag Enable)" 2 "水温动态测试(CTS DynTest Enable)" 3 "机油压力合理性检测(OPS Npl Enable)" 4 "空调允许被打开(AirCondition Enable)" 5 "空调控制允许干预油量(AirConditon Fuel Predef Enable)" 6 "油门1与油门2 合理性检测(Accped Npl Diag Enable)" 7 "系统错误油量限制1(Err1 Limit)" 8 "系统错误油量限制2(Err2 Limit)" 9 "系统错误油量限制3(Err3 Limit)" 10 "系统错误油量限制4(Err4 Limit)" 11 "DCDC电压与蓄电池电压差异诊断(Batt DCDC NPL Diag Enable)" 12 "第一缸始点诊断(Cyl1 BIT Enable)" 13 "第二缸始点诊断(Cyl2 BIT Enable)" 14 "第三缸始点诊断(Cyl3 BIT Enable)" 15 "第四缸始点诊断(Cyl4 BIT Enable)" 16 "第五缸始点诊断(Cyl5 BIT Enable)" 17 "第六缸始点诊断(Cyl6 BIT Enable)" 18 "电池电压怠速转速修正(Batt Idle Speed Correction Enable)" 19 "油门故障怠速修正(AccPed Err Idle Speed Correction Enable)" 255 "FID_Notused" DEFAULT_VALUE "FID_Notused" /end COMPU_VTAB
/begin COMPU_VTAB idxFaultEntryType "" TAB_VERB 16 0 "NoEntry" 1 "Erased" 2 "PrivateTemp" 3 "FreeFramOnly" 4 "DelayActiveDefect" 5 "DelayActiveNoDefect" 6 "ServiceNoDefect" 7 "ServiceDefect" 8 "ServiceHistoryDefect" 9 "ServiceHistoryNoDefect" 10 "PendingDefect" 11 "DebouncedDefect" 12 "DealingNoDefect" 13 "HistoryNoDefect" 14 "HistoryPending" 15 "NotUsed" /end COMPU_VTAB
/begin COMPU_VTAB idxGrpDSMRdy "" TAB_VERB 11 0 "Misfire" 1 "FuelSystem" 2 "ComprehensiveComponent" 3 "Catalyst" 4 "HeatedCatalyst" 5 "EvaporativeSystem" 6 "SecondaryAirSystem" 7 "ACSystemRefrigerant" 8 "OxygenSensor" 9 "OxygenSensorHeater" 10 "EGRSystem" DEFAULT_VALUE "Misfire" /end COMPU_VTAB
/begin COMPU_VTAB idxHIGovSetPoint "高怠速目标转速选择" TAB_VERB 2 0 "正常转速选择(Normal)" 1 "档位转速选择(Gear)" /end COMPU_VTAB
/begin COMPU_VTAB idxManualResetType "" TAB_VERB 15 0 "非自动复位(Not Manual)" 1 "RAM测试(RAM Test Err)" 10 "PLL丢失同步(PLL Lost)" 11 "CRG时钟错误(CRG Err)" 12 "PIT时钟错误(PIT Err)" 20 "EEPROM ACCERR错误(EEPROM ACCERR)" 21 "EEPROM GSTAT错误(EEPROM GSTAT)" 22 "EEPROM Partition错误(EEPROM Parition Err)" 23 "Flash双位错误(Flash DoubleBit Err)" 30 "KWP2000复位(KWP2000 Reset)" 31 "Flash编程复位(FlashProgram Reset)" 40 "ATD队列错误(ATD Queue Err)" 50 "不可识别中断源(Unimplemented)" 60 "XGATE软件错误(XGATE Software Err)" 70 "MPU错误(MPU Err)" DEFAULT_VALUE "0" /end COMPU_VTAB
/begin COMPU_VTAB idxResetType "" TAB_VERB 7 1 "上电复位(PowerUp)" 2 "低电压(LowVoltage)" 3 "时钟(ClockMonitor)" 4 "看门狗(WatchDog)" 5 "非法地址(IllegalAddress)" 6 "系统复位(SystemReset)" 7 "不可识别(Unimplemented)" /end COMPU_VTAB
/begin COMPU_VTAB idxSOIMode "" TAB_VERB 3 0 "始点反馈禁止(Disable)" 1 "始点反馈使能，而且补偿(Enable,w/o Correction)" 2 "始点反馈使能，不补偿(Enable,with Correction)" /end COMPU_VTAB
/begin COMPU_VTAB idxSOIZeroQMode "小油量修正" TAB_VERB 2 0 "小油量下不修正(No Correction)" 1 "统一按照50us修正(Using 50us)" /end COMPU_VTAB
/begin COMPU_VTAB idxSwitchType "开关类型" TAB_VERB 4 0 "接电源常开(Power Open)" 1 "接电源常闭(Power Close)" 2 "接地常开(Ground Open)" 3 "接地常闭(Ground Close)" DEFAULT_VALUE "0" /end COMPU_VTAB
/begin COMPU_VTAB idxTestBenchMode "" TAB_VERB 2 0 "指定油量(Fuel Quantity)" 1 "指定脉宽(Injection Duration)" /end COMPU_VTAB
/begin COMPU_VTAB idxToothType "曲轴齿形" TAB_VERB 2 1 "多齿(Add Tooth)" 2 "缺齿(Miss Tooth)" DEFAULT_VALUE "2" /end COMPU_VTAB
/begin COMPU_VTAB idxTriggerType "" TAB_VERB 10 0 "AlwaysTrue" 1 "NoTrigger" 2 "Time" 3 "WarmUpCycle" 4 "DrivingCycleFLC" 5 "DrivingCycleHLC" 6 "SimilarCondition" 7 "Project1" 8 "Project2" 9 "OneHour" DEFAULT_VALUE "1" /end COMPU_VTAB
/begin COMPU_VTAB idxVREGAcq "" TAB_VERB 3 0 "不采集(None)" 1 "采集CPU温度(CPU Temperature Acq)" 2 "采集1.2V参考电压(1.2V Acq)" /end COMPU_VTAB
/begin COMPU_VTAB stAirCondition "" TAB_VERB 6 0 "关闭(ShutOff)" 1 "等待开启(WaitForSwitchOn)" 2 "关闭锁止(SwitchOffLock)" 3 "等待关闭(WaitForShutOff)" 4 "开启(SwitchOn)" 5 "开启禁止(SwitchOnDisable)" /end COMPU_VTAB
/begin COMPU_VTAB stAirHeater "进气加热状态" TAB_VERB 9 0 "读取数据(Reading)" 1 "前预热(PreHeating)" 2 "停机预热(StandbyHeating)" 3 "停机(Standby)" 4 "起动预热(CrankingHeating)" 5 "起动(Cranking)" 6 "后预热(PostHeating)" 7 "预热结束(End)" 8 "停机后处理(Afterrun)" /end COMPU_VTAB
/begin COMPU_VTAB stAirHeaterTempSel "" TAB_VERB 32 0 "没有选中(None)" 1 "机油温度(OTS)" 2 "进气温度(IATS)" 3 "进气温度，机油温度(IATS,OTS)" 4 "燃油温度(FTS)" 5 "燃油温度，机油温度(FTS,OTS)" 6 "燃油温度，进气温度(FTS,IATS)" 7 "燃油温度，进气温度，机油温度(FTS,IATS,OTS)" 8 "环境温度(ETS)" 9 "环境温度，机油温度(ETS,OTS)" 10 "环境温度，进气温度(ETS,IATS)" 11 "环境温度，进气温度，机油温度(ETS,IATS,OTS)" 12 "环境温度，燃油温度(ETS,FTS)" 13 "环境温度，燃油温度，机油温度(ETS,FTS,OTS)" 14 "环境温度，燃油温度，进气温度(ETS,FTS,IATS)" 15 "环境温度，燃油温度，进气温度，机油温度(ETS,FTS,IATS,OTS)" 16 "冷却水温(CTS)" 17 "冷却水温，机油温度(CTS,OTS)" 18 "冷却水温，进气温度(CTS,IATS)" 19 "冷却水温，进气温度，机油温度(CTS,IATS,OTS)" 20 "冷却水温，燃油温度(CTS,FTS)" 21 "冷却水温，燃油温度，机油温度(CTS,FTS,OTS)" 22 "冷却水温，燃油温度，进气温度(CTS,FTS,IATS)" 23 "冷却水温，燃油温度，进气温度，机油温度(CTS,FTS,IATS,OTS)" 24 "冷却水温，环境温度(CTS,ETS)" 25 "冷却水温，环境温度，机油温度(CTS,ETS,OTS)" 26 "冷却水温，环境温度，进气温度(CTS,ETS,IATS)" 27 "冷却水温，环境温度，进气温度，机油温度(CTS,ETS,IATS,OTS)" 28 "冷却水温，环境温度，燃油温度(CTS,ETS,FTS)" 29 "冷却水温，环境温度，燃油温度，机油温度(CTS,ETS,FTS,OTS)" 30 "冷却水温，环境温度，燃油温度，进气温度(CTS,ETS,FTS,IATS)" 31 "冷却水温，环境温度，燃油温度，进气温度，机油温度(CTS,ETS,FTS,IATS,OTS)" /end COMPU_VTAB
/begin COMPU_VTAB stCamNoCrk "" TAB_VERB 7 0 "Init" 4 "OneTooth" 5 "MatchTooth" 6 "WaitForSyn" 8 "Syn" 10 "Tooth" 11 "LastTooth" /end COMPU_VTAB
/begin COMPU_VTAB stCamshaft "" TAB_VERB 5 1 "Cam_NoCrk" 2 "Cam_Search" 4 "Cam_Verify" 8 "Cam_Switchoff" 16 "Cam_Diag" /end COMPU_VTAB
/begin COMPU_VTAB stCrankshaft "" TAB_VERB 7 0 "Crk_Init" 4 "Crk_OneTooth" 5 "Crk_MatchTooth" 6 "Crk_WaitForSyn" 8 "Crk_Syn" 10 "Crk_Tooth" 11 "Crk_LastTooth" /end COMPU_VTAB
/begin COMPU_VTAB stDFC "" TAB_VERB 5 0 "诊断未开始(None)" 1 "部分错误(Preliminary Err)" 2 "完全错误(Err)" 3 "部分正常(Preliminary Heal)" 4 "完全正常(Heal)" /end COMPU_VTAB
/begin COMPU_VTAB stEGRRationSetPointRampState "EGR控制目标开度ramp状态" TAB_VERB 3 0 "PT1" 1 "PosRamp" 2 "NegRamp" /end COMPU_VTAB
/begin COMPU_VTAB stEngErrLim "" TAB_VERB 5 0 "没有限制(None)" 1 "90%功率限制(90% Limit)" 2 "85%功率限制(85% Limit)" 4 "80%功率限制(80% Limit)" 8 "70%功率限制(70% Limit)" DEFAULT_VALUE "0" /end COMPU_VTAB
/begin COMPU_VTAB stEngFuelLim "" TAB_VERB 6 0 "无限制(None)" 1 "冒烟限制(Air System Limit)" 2 "发动机保护限制(Engine Protect Limit)" 4 "发动机故障限制(Engine Err Limit)" 8 "最大油量限制(Fuel System Max Limit)" 16 "最小油量限制(Fuel System Min Limit)" DEFAULT_VALUE "0" /end COMPU_VTAB
/begin COMPU_VTAB stEngPrtLim "" TAB_VERB 3 0 "没有限制(None)" 1 "发动机过热保护(OverHeat Protect)" 2 "发动机机械保护(Mechanic Protect)" DEFAULT_VALUE "0" /end COMPU_VTAB
/begin COMPU_VTAB stEngine "" TAB_VERB 7 0 "初始化(Eng_Init)" 1 "停机(Eng_StandBy)" 2 "等待起动(Eng_Ready)" 3 "起动(Eng_Cranking)" 4 "正常运转(Eng_Running)" 5 "Eng_Stopping" 6 "Eng_Finish" /end COMPU_VTAB
/begin COMPU_VTAB stEpm "" TAB_VERB 4 0 "没有同步(Epm_NoSyn)" 2 "凸轮轴同步(Epm_CamSyn)" 8 "曲轴同步(Epm_CrkSyn)" 32 "完全同步(Epm_FullSyn)" /end COMPU_VTAB
/begin COMPU_VTAB stHIGovIFreeze "高怠速I冻结转速状态" TAB_VERB 2 0 "转速低于起始转速" 1 "转速大于或等于起始转速" /end COMPU_VTAB
/begin COMPU_VTAB stInjection "" TAB_VERB 6 0 "Inj_Wait" 1 "Inj_Verify" 2 "Inj_OK" 4 "Inj_BackCrk" 8 "Inj_BackCam" 16 "Inj_Err" /end COMPU_VTAB
/begin COMPU_VTAB stLIGovPreDef "低怠速前馈油量锁状态" TAB_VERB 2 0 "锁(Lock)" 1 "解锁(Unlock)" /end COMPU_VTAB
/begin COMPU_VTAB stLowIdleSetPoint "" TAB_VERB 5 1 "蓄电池电压低怠速(Battery Voltage Low)" 2 "空调怠速(Air Condition)" 4 "油门踏板故障怠速(Accped Defect)" 8 "水温怠速(Coolant)" 16 "档位怠速(Gear)" DEFAULT_VALUE "8" /end COMPU_VTAB
/begin COMPU_VTAB stMechPrtLim "" TAB_VERB 6 0 "没有限制(None)" 1 "增压器保护(Turbine Protect)" 2 "最大车速限制(Vehicle Speed Protect)" 4 "最大发动机转速限制(Engine Speed Protect)" 8 "最大爆发压力限制(Boost Presure Protect)" 16 "OBD限制" DEFAULT_VALUE "0" /end COMPU_VTAB
/begin COMPU_VTAB stOvhtPrtLim "" TAB_VERB 4 0 "没有限制(None)" 1 "水温限制(Coolant Temperature Limit)" 2 "燃油温度限制(Fuel Temperature Limit)" 4 "机油温度限制(Oil Temperature Limit)" DEFAULT_VALUE "0" /end COMPU_VTAB
/begin COMPU_VTAB stPostDrive "" TAB_VERB 9 0 "禁止(Inactive)" 1 "等待(Wait)" 2 "诊断开始(DSMBegin)" 3 "EEPROM开始(EEPBegin)" 4 "等待2(Wait2)" 5 "DSM结束(DSM End)" 6 "EEPROM结束(EEP End)" 7 "最小时间(MinTime)" 8 "结束(Done)" /end COMPU_VTAB
/begin COMPU_VTAB stPreDrive "" TAB_VERB 2 0 "禁止(Inactive)" 1 "结束(Done)" /end COMPU_VTAB
/begin COMPU_VTAB stRamp "" TAB_VERB 2 0 "结束(End)" 1 "正在进行(Begin)" /end COMPU_VTAB
/begin COMPU_VTAB stShutOff "" TAB_VERB 5 0 "禁止(Inactive)" 1 "DSM(DSM)" 2 "EEPROM(EEP)" 3 "主继电器关闭(MainRelay)" 4 " 结束(Done)" /end COMPU_VTAB
/begin COMPU_VTAB stStartSysCtl "起动控制状态" TAB_VERB 3 0 "初始化(Init)" 1 "起动进行中(Begin)" 2 "起动成功(End)" /end COMPU_VTAB
/begin COMPU_VTAB stSysConMon "" TAB_VERB 5 0 "初始化(Init)" 1 "关闭(Off)" 2 "起动(Boot)" 3 "执行(Exec)" 4 "关闭(Shutdown)" /end COMPU_VTAB
/begin COMPU_VTAB stSysConSub "" TAB_VERB 6 0 "初始化(Init)" 1 "硬件初始化(HardwareInit)" 2 "管理系统初始化(ManageInit)" 3 "PreDrive(PreDrive)" 4 "Drive(Drive)" 5 "PostDrive(PostDrive)" /end COMPU_VTAB
/begin COMPU_VTAB stTestInj "" TAB_VERB 5 0 "TestInj_Void" 1 "TestInj_Inj" 2 "TestInj_Calc" 3 "TestInj_Syn" 4 "TestInj_NoSyn" /end COMPU_VTAB
/begin COMPU_VTAB swtComponentInput "输入是否使用，信号来源" TAB_VERB 2 0 "不使用(Inactive)" 1 "使用(Active)" /end COMPU_VTAB
/begin COMPU_VTAB swtComponentOutput "输出设备是否使用" TAB_VERB 2 0 "不使用(Inactive)" 1 "使用(Active)" /end COMPU_VTAB
/begin COMPU_VTAB idxDIType "" TAB_VERB 2 0 "低电平有效" 1 "高电平有效" /end COMPU_VTAB
/begin COMPU_VTAB idxBaudRate "" TAB_VERB 3 0 "125kbps" 1 "250kbps" 2 "500kbps" /end COMPU_VTAB
/begin COMPU_VTAB idxTorque_ModeType "运行模式标识" TAB_VERB 11 0 "自由滑行" 1 "D档蠕动" 2 "D档滑行回馈" 3 "D档制动回馈" 4 "D档坡道驻车" 5 "R档蠕动" 6 "R档滑行回馈" 7 "R档制动回馈" 8 "R档坡道驻车" 9 "前行(油门给定力矩）" 10 "倒车(油门给定力矩）" DEFAULT_VALUE "0" /end COMPU_VTAB
/begin COMPU_VTAB idxVehco_StateType "车辆上下电状态标识" TAB_VERB 11 0 "关机" 1 "ON档,等待STAR信号" 2 "预充阶段" 3 "BMS上电完成,电机使能指令" 4 "电机READY" 5 "ON消失,自动减速中" 6 "下电指令" 7 "主动放电指令" 8 "主动放电中" 9 "放电完成,去使能指令" 10 "关机准备完成，下控制电" DEFAULT_VALUE "0" /end COMPU_VTAB
/begin COMPU_VTAB idxDang_StateType "档位转换表" TAB_VERB 4 0 "N档" 1 "P档" 5 "R档" 10 "D档" DEFAULT_VALUE "0" /end COMPU_VTAB
/begin COMPU_METHOD NO_FORMULA "" RAT_FUNC "%2.0" "" COEFFS 0 1 0 0 0 1 /end COMPU_METHOD
/begin COMPU_METHOD aFactor32 "" RAT_FUNC "%3.2" "米/秒^2" COEFFS 0 32 -0 0 0 1 /end COMPU_METHOD
/begin COMPU_METHOD bCondition "" TAB_VERB "%3.0" "" COMPU_TAB_REF bCondition /end COMPU_METHOD
/begin COMPU_METHOD bFunctionActive "" TAB_VERB "%3.1" "" COMPU_TAB_REF bFunctionActive /end COMPU_METHOD
/begin COMPU_METHOD bSwitch "开关" TAB_VERB "%3.1" "" COMPU_TAB_REF bSwitch /end COMPU_METHOD
/begin COMPU_METHOD ctTimes "计数次数" RAT_FUNC "%3.1" "次" COEFFS 0 1 0 0 0 1 /end COMPU_METHOD
/begin COMPU_METHOD dnFactor1 "" RAT_FUNC "%3.1" "转/分" COEFFS 0 1 0 0 0 1 /end COMPU_METHOD
/begin COMPU_METHOD dpFactor32 "" RAT_FUNC "%3.2" "" COEFFS 0 32 -0 0 0 1 /end COMPU_METHOD
/begin COMPU_METHOD dqFactor128 "" RAT_FUNC "%3.2" "毫克" COEFFS 0 128 -0 0 0 1 /end COMPU_METHOD
/begin COMPU_METHOD drFactor256_AccPed "油门踏板变化率" RAT_FUNC "%3.1" "%/秒" COEFFS 0 256 -0 0 0 1 /end COMPU_METHOD
/begin COMPU_METHOD dtFactor256 "" RAT_FUNC "%3.2" "度" COEFFS 0 256 -0 0 0 1 /end COMPU_METHOD
/begin COMPU_METHOD fFactor1 "9825,9362控制频率" RAT_FUNC "%3.0" "Hz" COEFFS 0 1 0 0 0 1 /end COMPU_METHOD
/begin COMPU_METHOD facFactor1000_Flt "滤波参数" RAT_FUNC "%3.3" "" COEFFS 0 1000 -0 0 0 1 /end COMPU_METHOD
/begin COMPU_METHOD facFactor100_Correction "修正系数" RAT_FUNC "%3.3" "%" COEFFS 0 100 -0 0 0 1 /end COMPU_METHOD
/begin COMPU_METHOD facFactor100_PID "PID参数" RAT_FUNC "%3.3" "" COEFFS 0 100 -0 0 0 1 /end COMPU_METHOD
/begin COMPU_METHOD facFactor256 "" RAT_FUNC "%3.2" "" COEFFS 0 256 -0 0 0 1 /end COMPU_METHOD
/begin COMPU_METHOD idxAccPedType "油门类型" TAB_VERB "%3.1" "" COMPU_TAB_REF idxAccPedType /end COMPU_METHOD
/begin COMPU_METHOD idxBaudRate "" TAB_VERB "%3.0" "" COMPU_TAB_REF idxBaudRate /end COMPU_METHOD
/begin COMPU_METHOD idxDIType "" TAB_VERB "%1.0" "" COMPU_TAB_REF idxDIType /end COMPU_METHOD
/begin COMPU_METHOD idxEdgeType "边沿捕捉" TAB_VERB "%3.1" "" COMPU_TAB_REF idxEdgeType /end COMPU_METHOD
/begin COMPU_METHOD idxManualResetType "" TAB_VERB "%3.2" "" COMPU_TAB_REF idxManualResetType /end COMPU_METHOD
/begin COMPU_METHOD idxResetType "" TAB_VERB "%3.2" "" COMPU_TAB_REF idxResetType /end COMPU_METHOD
/begin COMPU_METHOD idxSwitchType "开关类型" TAB_VERB "%3.1" "" COMPU_TAB_REF idxSwitchType /end COMPU_METHOD
/begin COMPU_METHOD idxTriggerType "" TAB_VERB "%3.1" "" COMPU_TAB_REF idxTriggerType /end COMPU_METHOD
/begin COMPU_METHOD idxVREGAcq "" TAB_VERB "%3.1" "" COMPU_TAB_REF idxVREGAcq /end COMPU_METHOD
/begin COMPU_METHOD nFactor1 "" RAT_FUNC "%3.1" "转/分" COEFFS 0 1 0 0 0 1 /end COMPU_METHOD
/begin COMPU_METHOD numFactor256 "" RAT_FUNC "%3.2" "脉冲" COEFFS 0 256 -0 0 0 1 /end COMPU_METHOD
/begin COMPU_METHOD pFactor32_kPa "" RAT_FUNC "%3.2" "千帕" COEFFS 0 32 -0 0 0 1 /end COMPU_METHOD
/begin COMPU_METHOD phiFactor32 "" RAT_FUNC "%3.2" "度" COEFFS 0 32 -0 0 0 1 /end COMPU_METHOD
/begin COMPU_METHOD qFactor128 "" RAT_FUNC "%3.2" "毫克" COEFFS 0 128 -0 0 0 1 /end COMPU_METHOD
/begin COMPU_METHOD rFactor100_PWM "9825,9362控制占空比" RAT_FUNC "%3.2" "%" COEFFS 0 100 -0 0 0 1 /end COMPU_METHOD
/begin COMPU_METHOD rFactor100_control "阀控制开度" RAT_FUNC "%3.2" "%" COEFFS 0 100 -0 0 0 1 /end COMPU_METHOD
/begin COMPU_METHOD rFactor10_VSSPlaus "车速合理性计算" RAT_FUNC "%3.1" "" COEFFS 0 10 -0 0 0 1 /end COMPU_METHOD
/begin COMPU_METHOD rFactor256_AccPed "" RAT_FUNC "%3.1" "%" COEFFS 0 256 -0 0 0 1 /end COMPU_METHOD
/begin COMPU_METHOD rFactor256_Plaus "" RAT_FUNC "%3.2" "" COEFFS 0 256 -0 0 0 1 /end COMPU_METHOD
/begin COMPU_METHOD rFactor32_GearConv "" RAT_FUNC "%3.2" "" COEFFS 0 32 -0 0 0 1 /end COMPU_METHOD
/begin COMPU_METHOD stPostDrive "" TAB_VERB "%3.1" "" COMPU_TAB_REF stPostDrive /end COMPU_METHOD
/begin COMPU_METHOD stPreDrive "" TAB_VERB "%3.1" "" COMPU_TAB_REF stPreDrive /end COMPU_METHOD
/begin COMPU_METHOD stRamp "" TAB_VERB "%3.1" "" COMPU_TAB_REF stRamp /end COMPU_METHOD
/begin COMPU_METHOD stShutOff "" TAB_VERB "%3.1" "" COMPU_TAB_REF stShutOff /end COMPU_METHOD
/begin COMPU_METHOD stSysConMon "" TAB_VERB "%3.1" "" COMPU_TAB_REF stSysConMon /end COMPU_METHOD
/begin COMPU_METHOD stSysConSub "" TAB_VERB "%3.1" "" COMPU_TAB_REF stSysConSub /end COMPU_METHOD
/begin COMPU_METHOD swtComponentInput "输入是否使用，信号来源" TAB_VERB "%3.1" "" COMPU_TAB_REF swtComponentInput /end COMPU_METHOD
/begin COMPU_METHOD swtComponentOutput "输出设备是否使用" TAB_VERB "%3.1" "" COMPU_TAB_REF swtComponentOutput /end COMPU_METHOD
/begin COMPU_METHOD tFactor256 "" RAT_FUNC "%4.2" "度" COEFFS 0 256 10240 0 0 1 /end COMPU_METHOD
/begin COMPU_METHOD tiFactor1000_1ms "" RAT_FUNC "%3.3" "秒" COEFFS 0 1000 -0 0 0 1 /end COMPU_METHOD
/begin COMPU_METHOD tiFactor100_10ms "" RAT_FUNC "%3.2" "秒" COEFFS 0 100 -0 0 0 1 /end COMPU_METHOD
/begin COMPU_METHOD tiFactor1_1us "" RAT_FUNC "%3.2" "微秒" COEFFS 0 1 0 0 0 1 /end COMPU_METHOD
/begin COMPU_METHOD tiFactor20_50ms "50ms数的时间" RAT_FUNC "%3.3" "秒" COEFFS 0 20 -0 0 0 1 /end COMPU_METHOD
/begin COMPU_METHOD tiFactor25_25MHz "ECT时钟" RAT_FUNC "%3.3" "" COEFFS 0 25 -0 0 0 1 /end COMPU_METHOD
/begin COMPU_METHOD uFactor100_Batt "" RAT_FUNC "%3.2" "伏" COEFFS 0 100 -0 0 0 1 /end COMPU_METHOD
/begin COMPU_METHOD uFactor4095 "4095->5V" RAT_FUNC "%3.3" "伏特" COEFFS 0 4095 -0 0 0 1 /end COMPU_METHOD
/begin COMPU_METHOD vFactor32 "" RAT_FUNC "%3.2" "千米/小时" COEFFS 0 32 -0 0 0 1 /end COMPU_METHOD
/begin COMPU_METHOD volFactor16 "" RAT_FUNC "%3.2" "毫克/缸" COEFFS 0 16 -0 0 0 1 /end COMPU_METHOD
/begin COMPU_METHOD fFactor256 "" RAT_FUNC "%.2" "Hz" COEFFS 0 1 -1 0 0 0.00390625 /end COMPU_METHOD
/begin COMPU_METHOD u5V "AD采样电压" RAT_FUNC "%.3" "伏" COEFFS 0 819 0 0 0 1 /end COMPU_METHOD
/begin COMPU_METHOD PWM_Hz100 "" RAT_FUNC "%.2" "Hz" COEFFS 0 100 0 0 0 1 /end COMPU_METHOD
/begin COMPU_METHOD rpm1-1 "转速1：1转换" RAT_FUNC "%.0" "rpm" COEFFS 0 1 0 0 0 1 /end COMPU_METHOD
/begin COMPU_METHOD Vmh10ms "车速变化率 每10ms车速变化量 米/小时/10ms " RAT_FUNC "%.0" "mh10ms" COEFFS 0 1 0 0 0 1 /end COMPU_METHOD
/begin COMPU_METHOD idxTorque_ModeType "运行模式标识" TAB_VERB "" "" COMPU_TAB_REF idxTorque_ModeType /end COMPU_METHOD
/begin COMPU_METHOD idxVehco_StateType "车辆上下电状态标识" TAB_VERB "" "" COMPU_TAB_REF idxVehco_StateType /end COMPU_METHOD
/begin COMPU_METHOD rr100 "" RAT_FUNC "%.2" "" COEFFS 0 100 0 0 0 1 /end COMPU_METHOD
/begin COMPU_METHOD idxDang_StateType "档位状态 0 N 1 P 5 R 10 D" TAB_VERB "" "" COMPU_TAB_REF idxDang_StateType /end COMPU_METHOD
/begin COMPU_METHOD SOC "" RAT_FUNC "%.1" "%" COEFFS 0 2 0 0 0 1 /end COMPU_METHOD
/begin COMPU_METHOD Speed "" RAT_FUNC "" "km/h" COEFFS 0 1 50 0 0 1 /end COMPU_METHOD
/begin COMPU_METHOD Avg_Cell_Voltage "F=X * 0.002" RAT_FUNC "%.3" "V" COEFFS 0 1 -0 0 0 0.002 /end COMPU_METHOD
/begin COMPU_METHOD Cell_Voltage "y=x * 0.0015" RAT_FUNC "%.4" "V" COEFFS 0 1 -0 0 0 0.0015 /end COMPU_METHOD
/begin COMPU_METHOD TEMP-40 "" RAT_FUNC "" "℃" COEFFS 0 1 40 0 0 1 /end COMPU_METHOD
/begin COMPU_METHOD Temp "线性温度转换 1：1" RAT_FUNC "%.0" "℃" COEFFS 0 1 0 0 0 1 /end COMPU_METHOD
/begin MEASUREMENT BattCD_uUW "" UWORD uFactor100_Batt 0 0 0.00 65535.00 ECU_ADDRESS 0x1881 /end MEASUREMENT
/begin MEASUREMENT VehCo_ctTestUW "" UWORD NO_FORMULA 0 0 0 65535 ECU_ADDRESS 0x13F000 /end MEASUREMENT
/begin MEASUREMENT VehCo_stAfterrunUB "" UBYTE facFactor256 -1 -1 0.00 255.00 ECU_ADDRESS 0x2288 /end MEASUREMENT
/begin MEASUREMENT bDiSatus._0_ "" UBYTE NO_FORMULA -1 -1 0.00 0.00 ECU_ADDRESS 0x2337 /end MEASUREMENT
/begin MEASUREMENT bDiSatus._1_ "" UBYTE NO_FORMULA -1 -1 0.00 0.00 ECU_ADDRESS 0x2338 /end MEASUREMENT
/begin MEASUREMENT bDiSatus._2_ "" UBYTE NO_FORMULA -1 -1 0.00 0.00 ECU_ADDRESS 0x2339 /end MEASUREMENT
/begin MEASUREMENT bDiSatus._3_ "" UBYTE NO_FORMULA -1 -1 0.00 0.00 ECU_ADDRESS 0x233A /end MEASUREMENT
/begin MEASUREMENT bDiSatus._4_ "" UBYTE NO_FORMULA -1 -1 0.00 0.00 ECU_ADDRESS 0x233B /end MEASUREMENT
/begin MEASUREMENT bDiSatus._5_ "" UBYTE NO_FORMULA -1 -1 0.00 0.00 ECU_ADDRESS 0x233C /end MEASUREMENT
/begin MEASUREMENT bDiSatus._6_ "" UBYTE NO_FORMULA -1 -1 0.00 0.00 ECU_ADDRESS 0x233D /end MEASUREMENT
/begin MEASUREMENT bDiSatus._7_ "" UBYTE NO_FORMULA -1 -1 0.00 0.00 ECU_ADDRESS 0x233E /end MEASUREMENT
/begin MEASUREMENT bDiSatus._8_ "" UBYTE NO_FORMULA -1 -1 0.00 0.00 ECU_ADDRESS 0x233F /end MEASUREMENT
/begin MEASUREMENT bDiSatus._9_ "" UBYTE NO_FORMULA -1 -1 0.00 0.00 ECU_ADDRESS 0x2340 /end MEASUREMENT
/begin MEASUREMENT bDoSatus._00 "" UBYTE NO_FORMULA -1 -1 0.00 0.00 ECU_ADDRESS 0x2373 /end MEASUREMENT
/begin MEASUREMENT bDoSatus._01 "" UBYTE NO_FORMULA -1 -1 0.00 0.00 ECU_ADDRESS 0x2374 /end MEASUREMENT
/begin MEASUREMENT bDoSatus._02 "" UBYTE NO_FORMULA -1 -1 0.00 0.00 ECU_ADDRESS 0x2375 /end MEASUREMENT
/begin MEASUREMENT bDoSatus._03 "" UBYTE NO_FORMULA -1 -1 0.00 0.00 ECU_ADDRESS 0x2376 /end MEASUREMENT
/begin MEASUREMENT bDoSatus._04 "" UBYTE NO_FORMULA -1 -1 0.00 0.00 ECU_ADDRESS 0x2377 /end MEASUREMENT
/begin MEASUREMENT bDoSatus._05 "" UBYTE NO_FORMULA -1 -1 0.00 0.00 ECU_ADDRESS 0x2378 /end MEASUREMENT
/begin MEASUREMENT bDoSatus._06 "" UBYTE NO_FORMULA -1 -1 0.00 0.00 ECU_ADDRESS 0x2379 /end MEASUREMENT
/begin MEASUREMENT bDoSatus._07 "" UBYTE NO_FORMULA -1 -1 0.00 0.00 ECU_ADDRESS 0x237A /end MEASUREMENT
/begin MEASUREMENT bDoSatus._08 "" UBYTE NO_FORMULA -1 -1 0.00 0.00 ECU_ADDRESS 0x237B /end MEASUREMENT
/begin MEASUREMENT bDoSatus._09 "" UBYTE NO_FORMULA -1 -1 0.00 0.00 ECU_ADDRESS 0x237C /end MEASUREMENT
/begin MEASUREMENT bDoSatus._10 "" UBYTE NO_FORMULA -1 -1 0.00 0.00 ECU_ADDRESS 0x237D /end MEASUREMENT
/begin MEASUREMENT bDoSatus._11 "" UBYTE NO_FORMULA -1 -1 0.00 0.00 ECU_ADDRESS 0x237E /end MEASUREMENT
/begin MEASUREMENT bDoSatus._12 "" UBYTE NO_FORMULA -1 -1 0.00 0.00 ECU_ADDRESS 0x237F /end MEASUREMENT
/begin MEASUREMENT bDoSatus._13 "" UBYTE NO_FORMULA -1 -1 0.00 0.00 ECU_ADDRESS 0x2380 /end MEASUREMENT
/begin MEASUREMENT bDoSatus._14 "" UBYTE NO_FORMULA -1 -1 0.00 0.00 ECU_ADDRESS 0x2381 /end MEASUREMENT
/begin MEASUREMENT bDoSatus._15 "" UBYTE NO_FORMULA -1 -1 0.00 0.00 ECU_ADDRESS 0x2382 /end MEASUREMENT
/begin MEASUREMENT uAD1 "" UWORD u5V -1 -1 0.00 0.00 ECU_ADDRESS 0x229B /end MEASUREMENT
/begin MEASUREMENT uAD2 "" UWORD u5V -1 -1 0.00 0.00 ECU_ADDRESS 0x229D /end MEASUREMENT
/begin MEASUREMENT AccPed1 "油门开度1" UWORD rFactor100_PWM -1 -1 0.00 0.00 ECU_ADDRESS 0x2292 /end MEASUREMENT
/begin MEASUREMENT AccPed2 "油门开度2" UWORD rFactor100_PWM -1 -1 0.00 0.00 ECU_ADDRESS 0x2294 /end MEASUREMENT
/begin MEASUREMENT bDiSatus._10_ "" UBYTE NO_FORMULA -1 -1 0.00 0.00 ECU_ADDRESS 0x2341 /end MEASUREMENT
/begin MEASUREMENT bDiSatus._11_ "" UBYTE NO_FORMULA -1 -1 0.00 0.00 ECU_ADDRESS 0x2342 /end MEASUREMENT
/begin MEASUREMENT bDiSatus._12_ "" UBYTE NO_FORMULA -1 -1 0.00 0.00 ECU_ADDRESS 0x2343 /end MEASUREMENT
/begin MEASUREMENT bDiSatus._13_ "" UBYTE NO_FORMULA -1 -1 0.00 0.00 ECU_ADDRESS 0x2344 /end MEASUREMENT
/begin MEASUREMENT bDiSatus._14_ "" UBYTE NO_FORMULA -1 -1 0.00 0.00 ECU_ADDRESS 0x2345 /end MEASUREMENT
/begin MEASUREMENT bDiSatus._15_ "" UBYTE NO_FORMULA -1 -1 0.00 0.00 ECU_ADDRESS 0x2346 /end MEASUREMENT
/begin MEASUREMENT bDiSatus._16_ "" UBYTE NO_FORMULA -1 -1 0.00 0.00 ECU_ADDRESS 0x2347 /end MEASUREMENT
/begin MEASUREMENT bDiSatus._17_ "" UBYTE NO_FORMULA -1 -1 0.00 0.00 ECU_ADDRESS 0x2348 /end MEASUREMENT
/begin MEASUREMENT Motor_Speed "" SWORD NO_FORMULA -1 -1 -15000.00 15000.00 ECU_ADDRESS 0x205F /end MEASUREMENT
/begin MEASUREMENT Motor_Torque "" SWORD NO_FORMULA -1 -1 -5000.00 5000.00 ECU_ADDRESS 0x2061 /end MEASUREMENT
/begin MEASUREMENT Motor_AC_Current "" UWORD NO_FORMULA -1 -1 0.00 10000.00 ECU_ADDRESS 0x2063 /end MEASUREMENT
/begin MEASUREMENT B_Current "电池电流 -500.00~500.00 单位： A" SWORD rr100 -1 -1 0.00 0.00 ECU_ADDRESS 0x2031 /end MEASUREMENT
/begin MEASUREMENT B_Discharge_Current "" UWORD NO_FORMULA -1 -1 0.00 0.00 ECU_ADDRESS 0x2035 /end MEASUREMENT
/begin MEASUREMENT B_Charge_Current "" UWORD NO_FORMULA -1 -1 0.00 0.00 ECU_ADDRESS 0x2033 /end MEASUREMENT
/begin MEASUREMENT B_Power "电池充放功率 -325.00~325.00 单位： kW" SWORD rr100 -1 -1 0.00 0.00 ECU_ADDRESS 0x2037 /end MEASUREMENT
/begin MEASUREMENT Isolation "" UWORD NO_FORMULA -1 -1 0.00 0.00 ECU_ADDRESS 0x2081 /end MEASUREMENT
/begin MEASUREMENT Vehicle_Speed "" UBYTE Speed -1 -1 0.00 0.00 ECU_ADDRESS 0x208F /end MEASUREMENT
/begin MEASUREMENT Err_AccPed "油门故障" UBYTE NO_FORMULA -1 -1 0.00 0.00 ECU_ADDRESS 0x22AC /end MEASUREMENT
/begin MEASUREMENT Failure_Recovery_Delay[7] "" UBYTE NO_FORMULA -1 -1 0.00 0.00 ECU_ADDRESS 0x2266 /end MEASUREMENT
/begin MEASUREMENT AccPed_Differ "" UWORD NO_FORMULA -1 -1 0.00 0.00 ECU_ADDRESS 0x2298 /end MEASUREMENT
/begin MEASUREMENT AccPed "" UWORD rFactor100_PWM -1 -1 0.00 0.00 ECU_ADDRESS 0x2296 /end MEASUREMENT
/begin MEASUREMENT Demand_Torque "" SWORD NO_COMPU_METHOD -1 -1 0 0 ECU_ADDRESS 0x20A6 FORMAT "%.0" /end MEASUREMENT
/begin MEASUREMENT Demand_Speed "" SWORD NO_COMPU_METHOD -1 -1 0.00 0.00 ECU_ADDRESS 0x20A8 /end MEASUREMENT
/begin MEASUREMENT Dang_L4bit "档位" UBYTE idxDang_StateType -1 -1 0.00 0.00 ECU_ADDRESS 0x22A9 /end MEASUREMENT
/begin MEASUREMENT Breakk "" UWORD rFactor100_PWM -1 -1 0.00 0.00 ECU_ADDRESS 0x22AA /end MEASUREMENT
/begin MEASUREMENT Torque_Mode "0 自由滑行 1 D档蠕动 2 D档滑行回馈 3 D档制动回馈 4 D档坡道驻车 5 R档蠕动 6 R档滑行回馈 7 R档制动回馈 8 R档坡道驻车 9 前行(油门给定力矩） 10 倒车 (油门给定力矩）" UBYTE idxTorque_ModeType -1 -1 0.00 0.00 ECU_ADDRESS 0x22B5 /end MEASUREMENT
/begin MEASUREMENT Vmh_Delta_Target "" SWORD Vmh10ms -1 -1 0.00 0.00 ECU_ADDRESS 0x221A /end MEASUREMENT
/begin MEASUREMENT Vmh_Delta_Vehco "" SWORD Vmh10ms -1 -1 0.00 0.00 ECU_ADDRESS 0x221C /end MEASUREMENT
/begin MEASUREMENT Torque_Increment "" SWORD NO_FORMULA -1 -1 0.00 0.00 ECU_ADDRESS 0x222C /end MEASUREMENT
/begin MEASUREMENT Vmh_Delta_Target_Crawl_D "" SWORD Vmh10ms -1 -1 0.00 0.00 ECU_ADDRESS 0x221E /end MEASUREMENT
/begin MEASUREMENT Torque_Increment_Crawl_D_Get "" SWORD NO_FORMULA -1 -1 0.00 0.00 ECU_ADDRESS 0x2220 /end MEASUREMENT
/begin MEASUREMENT Vmh_Delta_Target_Parking_D "" SWORD Vmh10ms -1 -1 0.00 0.00 ECU_ADDRESS 0x2222 /end MEASUREMENT
/begin MEASUREMENT Torque_Increment_Parking_D "" SWORD NO_FORMULA -1 -1 0.00 0.00 ECU_ADDRESS 0x2224 /end MEASUREMENT
/begin MEASUREMENT Vmh_Delta_Target_Parking_R "" SWORD Vmh10ms -1 -1 0.00 0.00 ECU_ADDRESS 0x2226 /end MEASUREMENT
/begin MEASUREMENT Torque_Increment_Parking_R "" SWORD NO_FORMULA -1 -1 0.00 0.00 ECU_ADDRESS 0x2228 /end MEASUREMENT
/begin MEASUREMENT Crawl_D_Torque_New "" SWORD NO_FORMULA -1 -1 0.00 0.00 ECU_ADDRESS 0x2230 /end MEASUREMENT
/begin MEASUREMENT Auto_Parking_D_Torque "" SWORD NO_FORMULA -1 -1 0.00 0.00 ECU_ADDRESS 0x2234 /end MEASUREMENT
/begin MEASUREMENT Auto_Parking_R_Torque "" SWORD NO_FORMULA -1 -1 0.00 0.00 ECU_ADDRESS 0x2236 /end MEASUREMENT
/begin MEASUREMENT AccPed_Torque "" SWORD NO_FORMULA -1 -1 0.00 0.00 ECU_ADDRESS 0x2232 /end MEASUREMENT
/begin MEASUREMENT Vehco_State_Debug "1 BMS不响应CR指令 不进入预充 2 预充失败 3 电机使能失效 4 5 6 电池无法下电 不能进行放电 7 电机不支持主动放电 8 3秒内放电不干净 退出放电 9 电机无法进入休眠 " UBYTE NO_FORMULA -1 -1 0.00 0.00 ECU_ADDRESS 0x22C4 /end MEASUREMENT
/begin MEASUREMENT Vehco_State "0：关机 1：ON档 2：充电中 3：BMS上电完成 电机使能指令 4：电机READY 5：ON消失 自动减速中 6：下电警告 7：主动放电指令 8：主动放电中 9：放电完成 去使能指令 10: 关机准备完成，下控制电" UBYTE idxVehco_StateType -1 -1 0.00 0.00 ECU_ADDRESS 0x22C3 /end MEASUREMENT
/begin MEASUREMENT MCU_Enable "" UBYTE NO_FORMULA -1 -1 0.00 0.00 ECU_ADDRESS 0x209D /end MEASUREMENT
/begin MEASUREMENT MCU_Control_Mode "" UBYTE NO_FORMULA -1 -1 0.00 0.00 ECU_ADDRESS 0x209F /end MEASUREMENT
/begin MEASUREMENT BMS_Power_Down_Request "" UBYTE NO_FORMULA -1 -1 0.00 0.00 ECU_ADDRESS 0x209A /end MEASUREMENT
/begin MEASUREMENT BMS_Contractor_Request "" UBYTE NO_FORMULA -1 -1 0.00 0.00 ECU_ADDRESS 0x2099 /end MEASUREMENT
/begin MEASUREMENT VCU_BMS_CMD "" UBYTE NO_FORMULA -1 -1 0.00 0.00 ECU_ADDRESS 0x2098 /end MEASUREMENT
/begin MEASUREMENT VCU_MCU_CMD_L4bit "" UBYTE NO_FORMULA -1 -1 0.00 0.00 ECU_ADDRESS 0x20A0 /end MEASUREMENT
/begin MEASUREMENT Err_Eps "EPS故障" UBYTE NO_FORMULA -1 -1 0.00 0.00 ECU_ADDRESS 0x22C7 /end MEASUREMENT
/begin MEASUREMENT Err_Air_Conditioning "空调故障" UBYTE NO_FORMULA -1 -1 0.00 0.00 ECU_ADDRESS 0x22C8 /end MEASUREMENT
/begin MEASUREMENT Err_DCDC "DCDC故障" UBYTE NO_FORMULA -1 -1 0.00 0.00 ECU_ADDRESS 0x22C9 /end MEASUREMENT
/begin MEASUREMENT Err_BatterLow "辅助电池故障" UBYTE NO_FORMULA -1 -1 0.00 0.00 ECU_ADDRESS 0x22CA /end MEASUREMENT
/begin MEASUREMENT Err_Vacuum_Tank "真空罐故障" UBYTE NO_FORMULA -1 -1 0.00 0.00 ECU_ADDRESS 0x22C6 /end MEASUREMENT
/begin MEASUREMENT LostINSCommunication "仪表通讯故障" UBYTE NO_FORMULA -1 -1 0.00 0.00 ECU_ADDRESS 0x20AC /end MEASUREMENT
/begin MEASUREMENT Isolation_Level "绝缘故障级别" UBYTE NO_FORMULA -1 -1 0.00 0.00 ECU_ADDRESS 0x207C /end MEASUREMENT
/begin MEASUREMENT LostMcuCommunication "电机通讯故障" UBYTE NO_FORMULA -1 -1 0.00 0.00 ECU_ADDRESS 0x20AA /end MEASUREMENT
/begin MEASUREMENT LostBMSCommunication "BMS通讯故障" UBYTE NO_FORMULA -1 -1 0.00 0.00 ECU_ADDRESS 0x20AB /end MEASUREMENT
/begin MEASUREMENT MCU_Fault_Level "电机故障级别" UBYTE NO_FORMULA -1 -1 0.00 0.00 ECU_ADDRESS 0x2070 /end MEASUREMENT
/begin MEASUREMENT B_Fault_Status "电池故障状态" UBYTE NO_FORMULA -1 -1 0.00 0.00 ECU_ADDRESS 0x2022 /end MEASUREMENT
/begin MEASUREMENT Ready "" UBYTE NO_FORMULA -1 -1 0.00 0.00 ECU_ADDRESS 0x22D7 /end MEASUREMENT
/begin MEASUREMENT FeedBack_Torque_Coast "" SWORD NO_FORMULA -1 -1 0.00 0.00 ECU_ADDRESS 0x223A /end MEASUREMENT
/begin MEASUREMENT FeedBack_Mode "" UBYTE NO_FORMULA -1 -1 0.00 0.00 ECU_ADDRESS 0x22D5 /end MEASUREMENT
/begin MEASUREMENT Crawl_D_ModeDelay "" UWORD NO_COMPU_METHOD -1 -1 0.00 0.00 ECU_ADDRESS 0x224F /end MEASUREMENT
/begin MEASUREMENT Crawl_D_Torque_Delay "" UWORD NO_COMPU_METHOD -1 -1 0.00 0.00 ECU_ADDRESS 0x22AE /end MEASUREMENT
/begin MEASUREMENT FeedBack_Break_Power "回馈功率" SWORD rr100 -1 -1 0.00 0.00 ECU_ADDRESS 0x224B /end MEASUREMENT
/begin MEASUREMENT Max_Charge_Power_Limit "充电功率限制" UWORD rr100 -1 -1 0.00 0.00 ECU_ADDRESS 0x2059 /end MEASUREMENT
/begin MEASUREMENT Max_Charge_Current_Limit "充电电流限制" UWORD rr100 -1 -1 0.00 0.00 ECU_ADDRESS 0x2053 /end MEASUREMENT
/begin MEASUREMENT BMS_Power "电池充放功率" SWORD rr100 -1 -1 0.00 0.00 ECU_ADDRESS 0x2037 /end MEASUREMENT
/begin MEASUREMENT Torque_Low_Limit "电机上报转矩下限" SWORD NO_FORMULA -1 -1 0.00 0.00 ECU_ADDRESS 0x206E /end MEASUREMENT
/begin MEASUREMENT Bms_Max_Torque_Break "BMS限制回馈转矩 " SWORD NO_FORMULA -1 -1 0.00 0.00 ECU_ADDRESS 0x2253 /end MEASUREMENT
/begin MEASUREMENT Motor_Max_Torque_Break "电机限制回馈转矩" SWORD NO_FORMULA -1 -1 0.00 0.00 ECU_ADDRESS 0x2255 /end MEASUREMENT
/begin MEASUREMENT FeedBack_Torque_Break "制动回馈力矩" SWORD NO_FORMULA -1 -1 0.00 0.00 ECU_ADDRESS 0x2245 /end MEASUREMENT
/begin MEASUREMENT Motor_Speed_Delta "" SWORD NO_COMPU_METHOD -1 -1 0.00 0.00 ECU_ADDRESS 0x2218 /end MEASUREMENT
/begin MEASUREMENT Motor_Speed_Average "" SWORD NO_COMPU_METHOD -1 -1 0.00 0.00 ECU_ADDRESS 0x222A /end MEASUREMENT
/begin MEASUREMENT Motor_Speed_Buffer0 "" SWORD NO_COMPU_METHOD -1 -1 0.00 0.00 ECU_ADDRESS 0x20BA /end MEASUREMENT
/begin MEASUREMENT Motor_Speed_Buffer1 "" SWORD NO_COMPU_METHOD -1 -1 0.00 0.00 ECU_ADDRESS 0x20BC /end MEASUREMENT
/begin MEASUREMENT Motor_Speed_Buffer2 "" SWORD NO_COMPU_METHOD -1 -1 0.00 0.00 ECU_ADDRESS 0x20BE /end MEASUREMENT
/begin MEASUREMENT Motor_Speed_Buffer19 "" SWORD NO_COMPU_METHOD -1 -1 0.00 0.00 ECU_ADDRESS 0x20E0 /end MEASUREMENT
/begin MEASUREMENT Motor_Vehicle_Speed_Scale_Get "" UBYTE NO_FORMULA -1 -1 0.00 0.00 ECU_ADDRESS 0x2322 /end MEASUREMENT
/begin MEASUREMENT Vehco_Type_Test "" UBYTE NO_FORMULA -1 -1 0.00 0.00 ECU_ADDRESS 0x22DF /end MEASUREMENT
/begin MEASUREMENT Soc "" UBYTE SOC -1 -1 0.00 0.00 ECU_ADDRESS 0x2025 /end MEASUREMENT
/begin MEASUREMENT MCU_System_State "" UBYTE NO_FORMULA -1 -1 0.00 0.00 ECU_ADDRESS 0x2068 /end MEASUREMENT
/begin MEASUREMENT AccPed_Torque_Buffer "" UWORD rFactor10_VSSPlaus -1 -1 0.00 0.00 ECU_ADDRESS 0x2238 /end MEASUREMENT
/begin MEASUREMENT Crawl_D_Torque_Delay_Max_Get "" UBYTE NO_COMPU_METHOD -1 -1 0.00 0.00 ECU_ADDRESS 0x2329 /end MEASUREMENT
/begin MEASUREMENT Driver_Power "电机电功率" SWORD rr100 -1 -1 0.00 0.00 ECU_ADDRESS 0x2251 /end MEASUREMENT
/begin MEASUREMENT AccPed_Slope_Delay_Num "" UBYTE NO_FORMULA -1 -1 0.00 0.00 ECU_ADDRESS 0x2209 /end MEASUREMENT
/begin MEASUREMENT FeedBack_Torque_Coast_Buffer "滑行回馈转矩 10倍" SWORD NO_FORMULA -1 -1 0.00 0.00 ECU_ADDRESS 0x223C /end MEASUREMENT
/begin MEASUREMENT FeedBack_Torque_Break_Buffer "制动回馈转矩 10倍" SWORD NO_FORMULA -1 -1 0.00 0.00 ECU_ADDRESS 0x2247 /end MEASUREMENT
/begin MEASUREMENT FeedBack_Slope_Enable "回馈起始斜坡开关" UBYTE NO_FORMULA -1 -1 0.00 0.00 ECU_ADDRESS 0x2242 /end MEASUREMENT
/begin MEASUREMENT Auto_Park_Speed_Accumulation "退行转速累加" SWORD NO_FORMULA -1 -1 0.00 0.00 ECU_ADDRESS 0x225B /end MEASUREMENT
/begin MEASUREMENT Break_Torque_Limit "回馈限制力矩" SWORD NO_FORMULA -1 -1 0.00 0.00 ECU_ADDRESS 0x220B /end MEASUREMENT
/begin MEASUREMENT Max_Discharge_Current_Limit "最大放电电流" UWORD rr100 -1 -1 0.00 0.00 ECU_ADDRESS 0x2051 /end MEASUREMENT
/begin MEASUREMENT Max_Discharge_Power_Limit "最大放电功率" UWORD rr100 -1 -1 0.00 0.00 ECU_ADDRESS 0x2057 /end MEASUREMENT
/begin MEASUREMENT Bms_Max_Torque_Driver "BMS限制驱动转矩" SWORD NO_FORMULA -1 -1 0.00 0.00 ECU_ADDRESS 0x2257 /end MEASUREMENT
/begin MEASUREMENT Motor_Max_Torque_Driver "电机限制驱动转矩" SWORD NO_FORMULA -1 -1 0.00 0.00 ECU_ADDRESS 0x2259 /end MEASUREMENT
/begin MEASUREMENT Driver_Torque_Limit "驱动限制力矩" SWORD NO_FORMULA -1 -1 0.00 0.00 ECU_ADDRESS 0x220D /end MEASUREMENT
/begin MEASUREMENT Auto_Park_Speed_Times "退行增速时间累加" UWORD NO_FORMULA -1 -1 0.00 0.00 ECU_ADDRESS 0x225D /end MEASUREMENT
/begin MEASUREMENT Bms_Max_Torque_Driver_Tmp "BMS限制驱动转矩计算值" SLONG NO_FORMULA -1 -1 0.00 0.00 ECU_ADDRESS 0x2213 /end MEASUREMENT
/begin MEASUREMENT Bms_Max_Torque_Break_Tmp "BMS限制制动转矩计算值" SLONG NO_FORMULA -1 -1 0.00 0.00 ECU_ADDRESS 0x220F /end MEASUREMENT
/begin MEASUREMENT Motor_Temperature "" UBYTE TEMP-40 -1 -1 0.00 0.00 ECU_ADDRESS 0x206A /end MEASUREMENT
/begin MEASUREMENT MCU_Temperature "" UBYTE TEMP-40 -1 -1 0.00 0.00 ECU_ADDRESS 0x206B /end MEASUREMENT
/begin MEASUREMENT B_State "" UBYTE NO_FORMULA -1 -1 0.00 0.00 ECU_ADDRESS 0x2020 /end MEASUREMENT
/begin MEASUREMENT B_Mode "" UBYTE NO_COMPU_METHOD -1 -1 0.00 0.00 ECU_ADDRESS 0x2021 /end MEASUREMENT
/begin MEASUREMENT FastDischarge_Fbd "" UBYTE NO_COMPU_METHOD -1 -1 0.00 0.00 ECU_ADDRESS 0x2066 /end MEASUREMENT
/begin MEASUREMENT Precharge_Allow "" UBYTE NO_COMPU_METHOD -1 -1 0.00 0.00 ECU_ADDRESS 0x2065 /end MEASUREMENT
/begin MEASUREMENT DC_Voltage "" UWORD rFactor10_VSSPlaus -1 -1 0.00 0.00 ECU_ADDRESS 0x2076 /end MEASUREMENT
/begin MEASUREMENT Veh_Limit_Speed "" UBYTE NO_COMPU_METHOD -1 -1 0.00 0.00 ECU_ADDRESS 0x2086 /end MEASUREMENT
/begin MEASUREMENT AccPed_Torque_ModeDelay "" UBYTE NO_COMPU_METHOD -1 -1 0.00 0.00 ECU_ADDRESS 0x2208 /end MEASUREMENT
/begin MEASUREMENT AC_Condenser_Temp "空调蒸发器温度 -10~70" SWORD NO_COMPU_METHOD -1 -1 0.00 0.00 ECU_ADDRESS 0x22B2 /end MEASUREMENT
/begin MEASUREMENT AC_ON "" UBYTE NO_COMPU_METHOD -1 -1 0.00 0.00 ECU_ADDRESS 0x22B0 /end MEASUREMENT
/begin MEASUREMENT AC_Enable "" UBYTE NO_COMPU_METHOD -1 -1 0.00 0.00 ECU_ADDRESS 0x227F /end MEASUREMENT
/begin MEASUREMENT AC_Pressure_Switch "" UBYTE NO_COMPU_METHOD -1 -1 0.00 0.00 ECU_ADDRESS 0x22B1 /end MEASUREMENT
/begin MEASUREMENT AC_Pressure_Switch_Delay "" UWORD NO_COMPU_METHOD -1 -1 0.00 0.00 ECU_ADDRESS 0x2279 /end MEASUREMENT
/begin MEASUREMENT Motor_OverHeat "" UBYTE NO_COMPU_METHOD -1 -1 0.00 0.00 ECU_ADDRESS 0x22BD /end MEASUREMENT
/begin MEASUREMENT Motor_OverHeat_High "" UBYTE NO_COMPU_METHOD -1 -1 0.00 0.00 ECU_ADDRESS 0x22BE /end MEASUREMENT
/begin MEASUREMENT Fan_Enable "" UBYTE NO_COMPU_METHOD -1 -1 0.00 0.00 ECU_ADDRESS 0x227C /end MEASUREMENT
/begin MEASUREMENT Fan_Low_Enable "" UBYTE NO_COMPU_METHOD -1 -1 0.00 0.00 ECU_ADDRESS 0x227E /end MEASUREMENT
/begin MEASUREMENT PTC_Enable "" UBYTE NO_COMPU_METHOD -1 -1 0.00 0.00 ECU_ADDRESS 0x2280 /end MEASUREMENT
/begin MEASUREMENT PTC_Switch "" UBYTE NO_COMPU_METHOD -1 -1 0.00 0.00 ECU_ADDRESS 0x22B4 /end MEASUREMENT
/begin MEASUREMENT Torque_High_Limit "电机上报转矩上限" SWORD NO_FORMULA -1 -1 0.00 0.00 ECU_ADDRESS 0x206C /end MEASUREMENT
/begin MEASUREMENT Limit_P "" UBYTE NO_COMPU_METHOD -1 -1 0.00 0.00 ECU_ADDRESS 0x2217 /end MEASUREMENT
/begin MEASUREMENT Dang_P "" UBYTE NO_COMPU_METHOD -1 -1 0.00 0.00 ECU_ADDRESS 0x22A5 /end MEASUREMENT
/begin MEASUREMENT Vmh_Delta_Vehco_Average_R "R档平均车辆AD值" SWORD Vmh10ms -1 -1 0.00 0.00 ECU_ADDRESS 0x21FA /end MEASUREMENT
/begin MEASUREMENT Vmh_Delta_Vehco_Average_D "D挡平均车辆AD值" SWORD Vmh10ms -1 -1 0.00 0.00 ECU_ADDRESS 0x21FC /end MEASUREMENT
/begin MEASUREMENT uAD4Satus._0_ "" UWORD NO_COMPU_METHOD -1 -1 0.00 0.00 ECU_ADDRESS 0x2387 /end MEASUREMENT
/begin MEASUREMENT uAD4Satus._1_ "" UWORD NO_COMPU_METHOD -1 -1 0.00 0.00 ECU_ADDRESS 0x2389 /end MEASUREMENT
/begin MEASUREMENT uAD4Satus._2_ "" UWORD NO_COMPU_METHOD -1 -1 0.00 0.00 ECU_ADDRESS 0x238B /end MEASUREMENT
/begin MEASUREMENT uAD4Satus._3_ "" UWORD NO_COMPU_METHOD -1 -1 0.00 0.00 ECU_ADDRESS 0x238D /end MEASUREMENT
/begin MEASUREMENT Key_Status "" UBYTE NO_COMPU_METHOD -1 -1 0.00 0.00 ECU_ADDRESS 0x208D /end MEASUREMENT
/begin MEASUREMENT BattCD_bLogicOnUB "" UBYTE NO_COMPU_METHOD -1 -1 0.00 0.00 ECU_ADDRESS 0x1880 /end MEASUREMENT
/begin MEASUREMENT Can_Send_Enable "" UBYTE NO_COMPU_METHOD -1 -1 0.00 0.00 ECU_ADDRESS 0x22B7 /end MEASUREMENT
/begin MEASUREMENT Rw_Vin_Times "" UBYTE NO_COMPU_METHOD -1 -1 0.00 0.00 ECU_ADDRESS 0xC09 /end MEASUREMENT
/begin MEASUREMENT Rw_Mot_Times "" UBYTE NO_COMPU_METHOD -1 -1 0.00 0.00 ECU_ADDRESS 0xC0A /end MEASUREMENT
/begin MEASUREMENT Rw_Bms_Times "" UBYTE NO_COMPU_METHOD -1 -1 0.00 0.00 ECU_ADDRESS 0xC0B /end MEASUREMENT
/begin MEASUREMENT Rw_MCU_Times "" UBYTE NO_COMPU_METHOD -1 -1 0.00 0.00 ECU_ADDRESS 0xC0C /end MEASUREMENT
/begin MEASUREMENT PowOn_Times "" UWORD NO_COMPU_METHOD -1 -1 0.00 0.00 ECU_ADDRESS 0xD8C /end MEASUREMENT
/begin MEASUREMENT Flash_Times "" UBYTE NO_COMPU_METHOD -1 -1 0.00 0.00 ECU_ADDRESS 0xD8E /end MEASUREMENT
/begin MEASUREMENT fSet "" ULONG PWM_Hz100 -1 -1 0.00 0.00 ECU_ADDRESS 0x22A1 /end MEASUREMENT
/begin MEASUREMENT HC_CMD "命令字" UBYTE NO_COMPU_METHOD -1 -1 0.00 0.00 ECU_ADDRESS 0x1EB6 /end MEASUREMENT
/begin MEASUREMENT User_Level "用户级别" UBYTE NO_COMPU_METHOD -1 -1 0.00 0.00 ECU_ADDRESS 0x2083 /end MEASUREMENT
/begin MEASUREMENT Device_Id "设备地址" UBYTE NO_COMPU_METHOD -1 -1 0.00 0.00 ECU_ADDRESS 0x1EB7 /end MEASUREMENT
/begin MEASUREMENT Device_Num "操作设备数量" UBYTE NO_COMPU_METHOD -1 -1 0.00 0.00 ECU_ADDRESS 0x1EB8 /end MEASUREMENT
/begin MEASUREMENT HC_Data_Id "数据帧ID" UBYTE NO_COMPU_METHOD -1 -1 0.00 0.00 ECU_ADDRESS 0x1EB9 /end MEASUREMENT
/begin MEASUREMENT Time_Mark "时间戳" UBYTE NO_COMPU_METHOD -1 -1 0.00 0.00 ECU_ADDRESS 0x1FF6 /end MEASUREMENT
/begin MEASUREMENT GetNewMessage_HC_CMD "收到新报文" UBYTE NO_COMPU_METHOD -1 -1 0.00 0.00 ECU_ADDRESS 0x1FF7 /end MEASUREMENT
/begin MEASUREMENT Need_HC_Data "需要接收的数据帧数" UBYTE NO_COMPU_METHOD -1 -1 0.00 0.00 ECU_ADDRESS 0x1FF8 /end MEASUREMENT
/begin MEASUREMENT Vin_Rw_Errcode "刷写故障码" UBYTE NO_COMPU_METHOD -1 -1 0.00 0.00 ECU_ADDRESS 0x23A7 /end MEASUREMENT
/begin MEASUREMENT VCU_RESPONSE "发送刷写应答帧" UBYTE NO_COMPU_METHOD -1 -1 0.00 0.00 ECU_ADDRESS 0x23A8 /end MEASUREMENT
/begin MEASUREMENT VCU_ROADCASTE "当前发送广播帧数 " UBYTE NO_COMPU_METHOD -1 -1 0.00 0.00 ECU_ADDRESS 0x23A9 /end MEASUREMENT
/begin MEASUREMENT VCU_ROADCASTE_Delay "延迟发送广播帧" UBYTE NO_COMPU_METHOD -1 -1 0.00 0.00 ECU_ADDRESS 0x23AA /end MEASUREMENT
/begin MEASUREMENT VCU_ROADCASTE_Number "需要发送广播帧数 " UBYTE NO_COMPU_METHOD -1 -1 0.00 0.00 ECU_ADDRESS 0x23AB /end MEASUREMENT
/begin MEASUREMENT LostHCCommunication_Index "通讯丢失计数" UWORD NO_COMPU_METHOD -1 -1 0.00 0.00 ECU_ADDRESS 0x23AC /end MEASUREMENT
/begin MEASUREMENT LostHCCommunication "上位机通讯丢失" UBYTE NO_COMPU_METHOD -1 -1 0.00 0.00 ECU_ADDRESS 0x23AE /end MEASUREMENT
/begin MEASUREMENT VCU_ROADCASTE_Repeat_Times "广播帧已重发次数" UBYTE NO_COMPU_METHOD -1 -1 0.00 0.00 ECU_ADDRESS 0x23AF /end MEASUREMENT
/begin MEASUREMENT Need_Flash "接收完成，需要Flash编程" UBYTE NO_COMPU_METHOD -1 -1 0.00 0.00 ECU_ADDRESS 0x23DF /end MEASUREMENT
/begin MEASUREMENT Rw_Times_Reset "" UBYTE NO_COMPU_METHOD -1 -1 0.00 0.00 ECU_ADDRESS 0x1FF9 /end MEASUREMENT
/begin MEASUREMENT Data_OK._0_ "" UBYTE NO_COMPU_METHOD -1 -1 0.00 0.00 ECU_ADDRESS 0x23B2 /end MEASUREMENT
/begin MEASUREMENT Data_OK._1_ "" UBYTE NO_COMPU_METHOD -1 -1 0.00 0.00 ECU_ADDRESS 0x23B3 /end MEASUREMENT
/begin MEASUREMENT Data_OK._2_ "" UBYTE NO_COMPU_METHOD -1 -1 0.00 0.00 ECU_ADDRESS 0x23B4 /end MEASUREMENT
/begin MEASUREMENT Data_OK._3_ "" UBYTE NO_COMPU_METHOD -1 -1 0.00 0.00 ECU_ADDRESS 0x23B5 /end MEASUREMENT
/begin MEASUREMENT ABS_Active "ABS激活信号" UBYTE NO_COMPU_METHOD -1 -1 0.00 0.00 ECU_ADDRESS 0x1FFA /end MEASUREMENT
/begin MEASUREMENT B_Version "BMS通讯协议版本" UBYTE rFactor10_VSSPlaus -1 -1 0.00 0.00 ECU_ADDRESS 0x202C /end MEASUREMENT
/begin MEASUREMENT Error_PowOn_Delay "" UBYTE NO_COMPU_METHOD -1 -1 0.00 0.00 ECU_ADDRESS 0x22B6 /end MEASUREMENT
/begin MEASUREMENT Vehicle_Mode "整车功能模式" UBYTE NO_COMPU_METHOD -1 -1 0.00 255.00 ECU_ADDRESS 0x208C /end MEASUREMENT
/begin MEASUREMENT Max_Cell_Temp "" UWORD TEMP-40 -1 -1 0.00 0.00 ECU_ADDRESS 0x2044 /end MEASUREMENT
/begin MEASUREMENT Max_Cell_Voltage "最大单体电压" UWORD Cell_Voltage -1 -1 0.00 0.00 ECU_ADDRESS 0x203C /end MEASUREMENT
/begin MEASUREMENT MCU_Fault_Reset "" UBYTE NO_COMPU_METHOD -1 -1 0.00 255.00 ECU_ADDRESS 0x209E /end MEASUREMENT
/begin MEASUREMENT MCU_Fault_Reset_Times "" UBYTE NO_COMPU_METHOD -1 -1 0.00 255.00 ECU_ADDRESS 0x22C5 /end MEASUREMENT
/begin MEASUREMENT MCU_OverHeat "" UBYTE NO_COMPU_METHOD -1 -1 0.00 255.00 ECU_ADDRESS 0x22D4 /end MEASUREMENT
/begin MEASUREMENT Min_Cell_Temp "" UWORD TEMP-40 -1 -1 0.00 0.00 ECU_ADDRESS 0x2046 /end MEASUREMENT
/begin MEASUREMENT Min_Cell_Voltage "最小单体电压" UWORD Cell_Voltage -1 -1 0.00 0.00 ECU_ADDRESS 0x203E /end MEASUREMENT
/begin MEASUREMENT Motor_Rotation_Count "" UBYTE NO_COMPU_METHOD -1 -1 0.00 255.00 ECU_ADDRESS 0x2078 /end MEASUREMENT
/begin MEASUREMENT Pack_Capacity "电池电量 0~409.5Ah" UWORD rFactor10_VSSPlaus -1 -1 0.00 65535.00 ECU_ADDRESS 0x2029 /end MEASUREMENT
/begin MEASUREMENT Pack_Res "电池内阻 0~65535 毫欧" UWORD NO_FORMULA -1 -1 0.00 65535.00 ECU_ADDRESS 0x2027 /end MEASUREMENT
/begin MEASUREMENT Pow_Down_Enable "" UBYTE NO_COMPU_METHOD -1 -1 0.00 255.00 ECU_ADDRESS 0x22B8 /end MEASUREMENT
/begin MEASUREMENT Ready_Led "" UBYTE NO_COMPU_METHOD -1 -1 0.00 255.00 ECU_ADDRESS 0x22D8 /end MEASUREMENT
/begin MEASUREMENT Soc_or_Tmp_Low "" UBYTE NO_COMPU_METHOD -1 -1 0.00 255.00 ECU_ADDRESS 0x22CD /end MEASUREMENT
/begin MEASUREMENT Vehco_State_Stop_Step "" UBYTE NO_COMPU_METHOD -1 -1 0.00 255.00 ECU_ADDRESS 0xC08 /end MEASUREMENT
/begin MEASUREMENT ESK_Signal_Type "档位信号类型 0 电平信号 1 CAN总线信号 " UBYTE NO_FORMULA -1 -1 0.00 0.00 ECU_ADDRESS 0x243E /end MEASUREMENT
/begin MEASUREMENT ESK_Type "电子换档位类型 0 拨片式、旋钮式（点动信号） 1 排档杆式、旋钮式（自锁信号）" UBYTE NO_FORMULA -1 -1 0.00 0.00 ECU_ADDRESS 0x243F /end MEASUREMENT
/begin MEASUREMENT ESK_Fault "电子换档器故障" UBYTE NO_FORMULA -1 -1 0.00 0.00 ECU_ADDRESS 0x2440 /end MEASUREMENT
/begin MEASUREMENT ESK_Live "电子换档器心跳信号 0~15" UBYTE NO_FORMULA -1 -1 0.00 0.00 ECU_ADDRESS 0x2441 /end MEASUREMENT
/begin MEASUREMENT ESK_SelfLock_Request "电子换挡器信号请求 自锁式 手刹另外硬线接入" UBYTE NO_FORMULA -1 -1 0.00 0.00 ECU_ADDRESS 0x2442 /end MEASUREMENT
/begin MEASUREMENT ESK_Inching_Request "电子换挡器信号请求 点动式 含手刹信号" UBYTE NO_FORMULA -1 -1 0.00 0.00 ECU_ADDRESS 0x2443 /end MEASUREMENT
/begin MEASUREMENT ESK_Signal "收到电子档位信号" UBYTE NO_FORMULA -1 -1 0.00 0.00 ECU_ADDRESS 0x2439 /end MEASUREMENT
/begin MEASUREMENT LostESKCommunication "" UBYTE NO_COMPU_METHOD -1 -1 0.00 0.00 ECU_ADDRESS 0x2436 /end MEASUREMENT
/begin MEASUREMENT LostESKCom_Index "" UWORD NO_COMPU_METHOD -1 -1 0.00 0.00 ECU_ADDRESS 0x2437 /end MEASUREMENT
/begin MEASUREMENT Err_Dcdc_Delay "" UWORD NO_COMPU_METHOD -1 -1 0.00 0.00 ECU_ADDRESS 0x22BF /end MEASUREMENT
/begin MEASUREMENT Avg_Cell_Voltage "平均单体电压 要* 0.002" UWORD Avg_Cell_Voltage -1 -1 0.00 0.00 ECU_ADDRESS 0x1FFC /end MEASUREMENT
/begin MEASUREMENT BatC_MODE "充电状态" UBYTE NO_COMPU_METHOD -1 -1 0.00 0.00 ECU_ADDRESS 0x20B9 /end MEASUREMENT
/begin MEASUREMENT SC_CAN0_Baudrat "波特率选择 0=125K 1=250K 2=500K 其他=250K ACES 调试CAN" UBYTE NO_COMPU_METHOD -1 -1 0.00 0.00 ECU_ADDRESS 0x78003D /end MEASUREMENT
/begin MEASUREMENT SC_CAN1_Baudrat "波特率选择 0=125K 1=250K 2=500K 其他=250K ACES 整车CAN " UBYTE NO_COMPU_METHOD -1 -1 0.00 0.00 ECU_ADDRESS 0x78003E /end MEASUREMENT
/begin MEASUREMENT SC_CAN2_Baudrat "波特率选择 0=125K 1=250K 2=500K 其他=250K ACES 充电CAN A9设置为125K " UBYTE NO_COMPU_METHOD -1 -1 0.00 0.00 ECU_ADDRESS 0x78003F /end MEASUREMENT
/begin MEASUREMENT Beep "" UBYTE NO_COMPU_METHOD -1 -1 0.00 0.00 ECU_ADDRESS 0x22CB /end MEASUREMENT
/begin MEASUREMENT Km100_Index "" UBYTE NO_COMPU_METHOD -1 -1 0.00 0.00 ECU_ADDRESS 0x22DB /end MEASUREMENT
/begin MEASUREMENT Beep_Index "" UBYTE NO_COMPU_METHOD -1 -1 0.00 0.00 ECU_ADDRESS 0x22D9 /end MEASUREMENT
/begin MEASUREMENT MCU_Model_Number "电控型号编码" UWORD NO_FORMULA -1 -1 0.00 0.00 ECU_ADDRESS 0x20B5 /end MEASUREMENT
/begin MEASUREMENT MCU_Manufacturer_Number "电控厂商编号" UBYTE NO_FORMULA -1 -1 0.00 0.00 ECU_ADDRESS 0x20B3 /end MEASUREMENT
/begin MEASUREMENT MCU_Firmware_Version "电控固件版本" UWORD NO_FORMULA -1 -1 0.00 0.00 ECU_ADDRESS 0x20B7 /end MEASUREMENT
/begin MEASUREMENT MCU_Err_Number "电控故障数量" UBYTE NO_FORMULA -1 -1 0.00 0.00 ECU_ADDRESS 0x20B4 /end MEASUREMENT
/begin MEASUREMENT Vehicle_Type_Identify_Success "自动车型识别成功标志" UBYTE NO_FORMULA -1 -1 0.00 0.00 ECU_ADDRESS 0x2283 /end MEASUREMENT
/begin MEASUREMENT Vehicle_Type_Identify_Err "电控型号不匹配故障" UBYTE NO_FORMULA -1 -1 0.00 0.00 ECU_ADDRESS 0x2284 /end MEASUREMENT
/begin MEASUREMENT APU_Demand_Power "増程器目标发电功率 0.1KW" UWORD rFactor10_VSSPlaus -1 -1 0.00 0.00 ECU_ADDRESS 0x2403 /end MEASUREMENT
/begin MEASUREMENT APU_CMD "増程器工作指令 0-停机指令；1-工作(启动)指令；2-发电指令；3-主动放电指令" UBYTE NO_FORMULA -1 -1 0.00 0.00 ECU_ADDRESS 0x2400 /end MEASUREMENT
/begin MEASUREMENT APU_Demand_Speed "目标工作转速" UWORD rpm1-1 -1 -1 0.00 0.00 ECU_ADDRESS 0x2405 /end MEASUREMENT
/begin MEASUREMENT APU_Staus "APU初始化状态" UBYTE NO_FORMULA -1 -1 0.00 0.00 ECU_ADDRESS 0x2407 /end MEASUREMENT
/begin MEASUREMENT APU_Start_Staus "APU启动成功标志位 0-未启动；1-启动成功；2-启动失败" UBYTE NO_FORMULA -1 -1 0.00 0.00 ECU_ADDRESS 0x240A /end MEASUREMENT
/begin MEASUREMENT Engine_Oil_Pressure_Alarm "发动机机油压力报警" UBYTE NO_FORMULA -1 -1 0.00 0.00 ECU_ADDRESS 0x240B /end MEASUREMENT
/begin MEASUREMENT APU_Discharged_Flag "増程器放电完成标志位" UBYTE NO_FORMULA -1 -1 0.00 0.00 ECU_ADDRESS 0x240C /end MEASUREMENT
/begin MEASUREMENT APU_Mode "増程器当前状态 0-停机状态；1-起动状态；2-拖动状态；3-怠速状态；4-发电状态；5-主动放电" UBYTE NO_FORMULA -1 -1 0.00 0.00 ECU_ADDRESS 0x240D /end MEASUREMENT
/begin MEASUREMENT APU_Fault_Status "増程器故障等级" UBYTE NO_FORMULA -1 -1 0.00 0.00 ECU_ADDRESS 0x240E /end MEASUREMENT
/begin MEASUREMENT APU_Speed "増程器转速" UWORD rpm1-1 -1 -1 0.00 0.00 ECU_ADDRESS 0x240F /end MEASUREMENT
/begin MEASUREMENT APU_Power "増程器输出功率 0.1KW" SWORD rFactor10_VSSPlaus -1 -1 0.00 0.00 ECU_ADDRESS 0x2413 /end MEASUREMENT
/begin MEASUREMENT APU_Torque "増程器输出转矩 0.1Nm" UWORD rFactor10_VSSPlaus -1 -1 0.00 0.00 ECU_ADDRESS 0x2411 /end MEASUREMENT
/begin MEASUREMENT APU_DC_Voltage "増程器母线电压 0.1V" UWORD rFactor10_VSSPlaus -1 -1 0.00 0.00 ECU_ADDRESS 0x2415 /end MEASUREMENT
/begin MEASUREMENT APU_DC_Current "増程器母线电流 0.1A" SWORD rFactor10_VSSPlaus -1 -1 0.00 0.00 ECU_ADDRESS 0x2419 /end MEASUREMENT
/begin MEASUREMENT APU_AC_Current "増程器交流电流 0.1A" SWORD rFactor10_VSSPlaus -1 -1 0.00 0.00 ECU_ADDRESS 0x241B /end MEASUREMENT
/begin MEASUREMENT APU_Power_Limit "増程器当前转速最大功率 0.1KW" UWORD rFactor10_VSSPlaus -1 -1 0.00 0.00 ECU_ADDRESS 0x2417 /end MEASUREMENT
/begin MEASUREMENT Engine_Oil_Level "发动机油箱液位 0~100.0%" UWORD rFactor10_VSSPlaus -1 -1 0.00 0.00 ECU_ADDRESS 0x241F /end MEASUREMENT
/begin MEASUREMENT Coolant_Temperature "发动机冷却液温度-48~206℃" SWORD NO_FORMULA -1 -1 0.00 0.00 ECU_ADDRESS 0x2427 /end MEASUREMENT
/begin MEASUREMENT APU_Temperature "増程器温度 -48~206℃" SWORD NO_FORMULA -1 -1 0.00 0.00 ECU_ADDRESS 0x2429 /end MEASUREMENT
/begin MEASUREMENT GCU_Temperature "増程器GCU温度 -48~206℃" SWORD NO_FORMULA -1 -1 0.00 0.00 ECU_ADDRESS 0x242B /end MEASUREMENT
/begin MEASUREMENT Fuel_Consumption_Rate "发动机瞬时燃油消耗率 0~38.912 mL/s" UWORD facFactor1000_Flt -1 -1 0.00 0.00 ECU_ADDRESS 0x2421 /end MEASUREMENT
/begin MEASUREMENT Engine_Throttle_Rate "节气门位置开度实际值 0~100.00%" UWORD rFactor100_PWM -1 -1 0.00 0.00 ECU_ADDRESS 0x2423 /end MEASUREMENT
/begin MEASUREMENT APU_Order "" UBYTE NO_FORMULA -1 -1 0.00 0.00 ECU_ADDRESS 0x23EB /end MEASUREMENT
/begin MEASUREMENT Rated_Capactiy "额定电量 0~409.5Ah" UWORD rFactor10_VSSPlaus -1 -1 0.00 0.00 ECU_ADDRESS 0x1EA8 /end MEASUREMENT
/begin MEASUREMENT Rated_Voltage "额定电压 0~819.0V" UWORD rFactor10_VSSPlaus -1 -1 0.00 0.00 ECU_ADDRESS 0x1EAA /end MEASUREMENT
/begin MEASUREMENT Rated_Energy "额定能量 0~409.5kwh" UWORD rFactor10_VSSPlaus -1 -1 0.00 0.00 ECU_ADDRESS 0x1EAC /end MEASUREMENT
/begin MEASUREMENT B_Voltage "电池电压 0~800.0 单位： V" UWORD rFactor10_VSSPlaus -1 -1 0.00 0.00 ECU_ADDRESS 0x202D /end MEASUREMENT
/begin MEASUREMENT Remaining_Mil "剩余里程 0~510KM 2km/bit" UBYTE NO_COMPU_METHOD -1 -1 0.00 0.00 ECU_ADDRESS 0x2087 /end MEASUREMENT
/begin MEASUREMENT Engine_Fault_Word._0_ "" UBYTE NO_FORMULA -1 -1 0.00 0.00 ECU_ADDRESS 0x23EC /end MEASUREMENT
/begin MEASUREMENT Engine_Fault_Word._1_ "" UBYTE NO_FORMULA -1 -1 0.00 0.00 ECU_ADDRESS 0x23ED /end MEASUREMENT
/begin MEASUREMENT Engine_Fault_Word._2_ "" UBYTE NO_FORMULA -1 -1 0.00 0.00 ECU_ADDRESS 0x23EE /end MEASUREMENT
/begin MEASUREMENT Engine_Fault_Word._3_ "" UBYTE NO_FORMULA -1 -1 0.00 0.00 ECU_ADDRESS 0x23EF /end MEASUREMENT
/begin MEASUREMENT Engine_Fault_Word._4_ "" UBYTE NO_FORMULA -1 -1 0.00 0.00 ECU_ADDRESS 0x23F0 /end MEASUREMENT
/begin MEASUREMENT Engine_Fault_Word._5_ "" UBYTE NO_FORMULA -1 -1 0.00 0.00 ECU_ADDRESS 0x23F1 /end MEASUREMENT
/begin MEASUREMENT Engine_Fault_Word._6_ "" UBYTE NO_FORMULA -1 -1 0.00 0.00 ECU_ADDRESS 0x23F2 /end MEASUREMENT
/begin MEASUREMENT Engine_Fault_Word._7_ "" UBYTE NO_FORMULA -1 -1 0.00 0.00 ECU_ADDRESS 0x23F3 /end MEASUREMENT
/begin MEASUREMENT APU_Fault_Word._0_ "" UBYTE NO_FORMULA -1 -1 0.00 0.00 ECU_ADDRESS 0x23F4 /end MEASUREMENT
/begin MEASUREMENT APU_Fault_Word._1_ "" UBYTE NO_FORMULA -1 -1 0.00 0.00 ECU_ADDRESS 0x23F5 /end MEASUREMENT
/begin MEASUREMENT APU_Fault_Word._2_ "" UBYTE NO_FORMULA -1 -1 0.00 0.00 ECU_ADDRESS 0x23F6 /end MEASUREMENT
/begin MEASUREMENT APU_Fault_Word._3_ "" UBYTE NO_FORMULA -1 -1 0.00 0.00 ECU_ADDRESS 0x23F7 /end MEASUREMENT
/begin MEASUREMENT APU_Fault_Word._4_ "" UBYTE NO_FORMULA -1 -1 0.00 0.00 ECU_ADDRESS 0x23F8 /end MEASUREMENT
/begin MEASUREMENT APU_Fault_Word._5_ "" UBYTE NO_FORMULA -1 -1 0.00 0.00 ECU_ADDRESS 0x23F9 /end MEASUREMENT
/begin MEASUREMENT APU_Fault_Word._6_ "" UBYTE NO_FORMULA -1 -1 0.00 0.00 ECU_ADDRESS 0x23FA /end MEASUREMENT
/begin MEASUREMENT APU_Fault_Word._7_ "" UBYTE NO_FORMULA -1 -1 0.00 0.00 ECU_ADDRESS 0x23FB /end MEASUREMENT
/begin GROUP ECUTest "Comment" /begin REF_CHARACTERISTIC /end REF_CHARACTERISTIC
 /begin REF_MEASUREMENT AccPed1 AccPed2 Dang_L4bit Soc Motor_Temperature MCU_Temperature Key_Status BattCD_bLogicOnUB Can_Send_Enable AccPed AccPed_Differ Breakk Failure_Recovery_Delay[7] Error_PowOn_Delay Vehicle_Mode Err_Dcdc_Delay Avg_Cell_Voltage BatC_MODE /end REF_MEASUREMENT
 ROOT
 /begin SUB_GROUP AIRCOOL APU bDiSatus bDoSatus CAN发送处理 CAN接收处理 EEPROM Other PWM Torque_Mode uAD Vehco_Error Vehco_Logic VehcoType Vin_ESK Vin_RW /end SUB_GROUP
/end GROUP
/begin GROUP AIRCOOL "" /begin REF_CHARACTERISTIC /end REF_CHARACTERISTIC
 /begin REF_MEASUREMENT AC_Condenser_Temp AC_ON AC_Enable AC_Pressure_Switch AC_Pressure_Switch_Delay Motor_OverHeat Motor_OverHeat_High Fan_Enable Fan_Low_Enable PTC_Enable PTC_Switch /end REF_MEASUREMENT
/end GROUP
/begin GROUP APU "增程器" /begin REF_CHARACTERISTIC /end REF_CHARACTERISTIC
 /begin REF_MEASUREMENT APU_Demand_Power APU_CMD APU_Demand_Speed APU_Staus APU_Start_Staus Engine_Oil_Pressure_Alarm APU_Discharged_Flag APU_Mode APU_Fault_Status APU_Speed APU_Power APU_Torque APU_DC_Voltage APU_DC_Current APU_AC_Current APU_Power_Limit Engine_Oil_Level Coolant_Temperature APU_Temperature GCU_Temperature Fuel_Consumption_Rate Engine_Throttle_Rate APU_Order /end REF_MEASUREMENT
 /begin SUB_GROUP ERROR /end SUB_GROUP
/end GROUP
/begin GROUP ERROR "" /begin REF_CHARACTERISTIC /end REF_CHARACTERISTIC
 /begin REF_MEASUREMENT Engine_Fault_Word._0_ Engine_Fault_Word._1_ Engine_Fault_Word._2_ Engine_Fault_Word._3_ Engine_Fault_Word._4_ Engine_Fault_Word._5_ Engine_Fault_Word._6_ Engine_Fault_Word._7_ APU_Fault_Word._0_ APU_Fault_Word._1_ APU_Fault_Word._2_ APU_Fault_Word._3_ APU_Fault_Word._4_ APU_Fault_Word._5_ APU_Fault_Word._6_ APU_Fault_Word._7_ /end REF_MEASUREMENT
/end GROUP
/begin GROUP bDiSatus "" /begin REF_CHARACTERISTIC /end REF_CHARACTERISTIC
 /begin REF_MEASUREMENT bDiSatus._0_ bDiSatus._1_ bDiSatus._2_ bDiSatus._3_ bDiSatus._4_ bDiSatus._5_ bDiSatus._6_ bDiSatus._7_ bDiSatus._8_ bDiSatus._9_ bDiSatus._10_ bDiSatus._11_ bDiSatus._12_ bDiSatus._13_ bDiSatus._14_ bDiSatus._15_ bDiSatus._16_ bDiSatus._17_ /end REF_MEASUREMENT
/end GROUP
/begin GROUP bDoSatus "" /begin REF_CHARACTERISTIC /end REF_CHARACTERISTIC
 /begin REF_MEASUREMENT bDoSatus._00 bDoSatus._01 bDoSatus._02 bDoSatus._03 bDoSatus._04 bDoSatus._05 bDoSatus._06 bDoSatus._07 bDoSatus._08 bDoSatus._09 bDoSatus._10 bDoSatus._11 bDoSatus._12 bDoSatus._13 bDoSatus._14 bDoSatus._15 /end REF_MEASUREMENT
/end GROUP
/begin GROUP CAN发送处理 "" /begin REF_CHARACTERISTIC /end REF_CHARACTERISTIC /begin REF_MEASUREMENT Demand_Torque Demand_Speed Remaining_Mil /end REF_MEASUREMENT /end GROUP
/begin GROUP CAN接收处理 "" /begin REF_CHARACTERISTIC /end REF_CHARACTERISTIC
 /begin REF_MEASUREMENT Motor_Speed Motor_Torque Motor_AC_Current B_Current B_Discharge_Current B_Charge_Current B_Power Isolation Vehicle_Speed B_Version B_Voltage Pack_Capacity Pack_Res Rated_Capactiy Rated_Energy Rated_Voltage /end REF_MEASUREMENT
/end GROUP
/begin GROUP EEPROM "" /begin REF_CHARACTERISTIC /end REF_CHARACTERISTIC
 /begin REF_MEASUREMENT Rw_Vin_Times Rw_Mot_Times Rw_Bms_Times Rw_MCU_Times PowOn_Times Flash_Times /end REF_MEASUREMENT
/end GROUP
/begin GROUP Other "从MAP中导入" /begin REF_CHARACTERISTIC /end REF_CHARACTERISTIC
 /begin REF_MEASUREMENT Max_Cell_Temp Max_Cell_Voltage MCU_Fault_Reset MCU_Fault_Reset_Times MCU_OverHeat Min_Cell_Temp Min_Cell_Voltage Motor_Rotation_Count Pow_Down_Enable Ready_Led Soc_or_Tmp_Low Vehco_State_Stop_Step SC_CAN0_Baudrat SC_CAN1_Baudrat SC_CAN2_Baudrat /end REF_MEASUREMENT
/end GROUP
/begin GROUP PWM "" /begin REF_CHARACTERISTIC /end REF_CHARACTERISTIC /begin REF_MEASUREMENT fSet /end REF_MEASUREMENT /end GROUP
/begin GROUP Torque_Mode "" /begin REF_CHARACTERISTIC /end REF_CHARACTERISTIC
 /begin REF_MEASUREMENT Torque_Increment Vmh_Delta_Target Vmh_Delta_Vehco Vmh_Delta_Target_Crawl_D Torque_Increment_Crawl_D_Get Vmh_Delta_Target_Parking_D Torque_Increment_Parking_D Vmh_Delta_Target_Parking_R Torque_Increment_Parking_R Crawl_D_Torque_New Auto_Parking_D_Torque Auto_Parking_R_Torque AccPed_Torque Torque_Mode FeedBack_Torque_Coast Crawl_D_ModeDelay Crawl_D_Torque_Delay AccPed_Torque_Buffer Crawl_D_Torque_Delay_Max_Get AccPed_Slope_Delay_Num Veh_Limit_Speed AccPed_Torque_ModeDelay Limit_P Dang_P Vmh_Delta_Vehco_Average_R Vmh_Delta_Vehco_Average_D ABS_Active /end REF_MEASUREMENT
 /begin SUB_GROUP AutoPark FeedBack M-Speed Torque_Power_Limit /end SUB_GROUP
/end GROUP
/begin GROUP AutoPark "" /begin REF_CHARACTERISTIC /end REF_CHARACTERISTIC /begin REF_MEASUREMENT Auto_Park_Speed_Accumulation Auto_Park_Speed_Times /end REF_MEASUREMENT /end GROUP
/begin GROUP FeedBack "" /begin REF_CHARACTERISTIC /end REF_CHARACTERISTIC
 /begin REF_MEASUREMENT FeedBack_Break_Power BMS_Power FeedBack_Torque_Break Driver_Power FeedBack_Torque_Coast_Buffer FeedBack_Torque_Break_Buffer FeedBack_Slope_Enable /end REF_MEASUREMENT
/end GROUP
/begin GROUP M-Speed "" /begin REF_CHARACTERISTIC /end REF_CHARACTERISTIC
 /begin REF_MEASUREMENT Motor_Speed_Average Motor_Speed_Buffer0 Motor_Speed_Delta Motor_Speed_Buffer1 Motor_Speed_Buffer2 Motor_Speed_Buffer19 /end REF_MEASUREMENT
/end GROUP
/begin GROUP Torque_Power_Limit "电池功率限制转矩" /begin REF_CHARACTERISTIC /end REF_CHARACTERISTIC /begin REF_MEASUREMENT Torque_Low_Limit Torque_High_Limit /end REF_MEASUREMENT /begin SUB_GROUP Break Driver /end SUB_GROUP /end GROUP
/begin GROUP Break "" /begin REF_CHARACTERISTIC /end REF_CHARACTERISTIC
 /begin REF_MEASUREMENT Bms_Max_Torque_Break Max_Charge_Current_Limit Max_Charge_Power_Limit Motor_Max_Torque_Break Break_Torque_Limit Bms_Max_Torque_Break_Tmp /end REF_MEASUREMENT
/end GROUP
/begin GROUP Driver "" /begin REF_CHARACTERISTIC /end REF_CHARACTERISTIC
 /begin REF_MEASUREMENT Max_Discharge_Current_Limit Max_Discharge_Power_Limit Bms_Max_Torque_Driver Motor_Max_Torque_Driver Driver_Torque_Limit Bms_Max_Torque_Driver_Tmp /end REF_MEASUREMENT
/end GROUP
/begin GROUP uAD "" /begin REF_CHARACTERISTIC /end REF_CHARACTERISTIC
 /begin REF_MEASUREMENT uAD1 uAD2 uAD4Satus._0_ uAD4Satus._1_ uAD4Satus._2_ uAD4Satus._3_ /end REF_MEASUREMENT
/end GROUP
/begin GROUP Vehco_Error "" /begin REF_CHARACTERISTIC /end REF_CHARACTERISTIC
 /begin REF_MEASUREMENT Err_Eps Err_Air_Conditioning Err_DCDC Err_BatterLow Err_Vacuum_Tank LostINSCommunication Isolation_Level LostMcuCommunication LostBMSCommunication MCU_Fault_Level B_Fault_Status Err_AccPed /end REF_MEASUREMENT
/end GROUP
/begin GROUP Vehco_Logic "" /begin REF_CHARACTERISTIC /end REF_CHARACTERISTIC
 /begin REF_MEASUREMENT BMS_Contractor_Request BMS_Power_Down_Request MCU_Control_Mode MCU_Enable Vehco_State Vehco_State_Debug VCU_BMS_CMD VCU_MCU_CMD_L4bit Ready FeedBack_Mode MCU_System_State Beep Km100_Index Beep_Index /end REF_MEASUREMENT
 /begin SUB_GROUP Lo /end SUB_GROUP
/end GROUP
/begin GROUP Lo "" /begin REF_CHARACTERISTIC /end REF_CHARACTERISTIC
 /begin REF_MEASUREMENT B_Mode B_State FastDischarge_Fbd Precharge_Allow DC_Voltage /end REF_MEASUREMENT
/end GROUP
/begin GROUP VehcoType "" /begin REF_CHARACTERISTIC /end REF_CHARACTERISTIC
 /begin REF_MEASUREMENT Motor_Vehicle_Speed_Scale_Get Vehco_Type_Test MCU_Model_Number MCU_Manufacturer_Number MCU_Firmware_Version MCU_Err_Number Vehicle_Type_Identify_Success Vehicle_Type_Identify_Err /end REF_MEASUREMENT
/end GROUP
/begin GROUP Vin_ESK "电子排档相关监控" /begin REF_CHARACTERISTIC /end REF_CHARACTERISTIC
 /begin REF_MEASUREMENT ESK_Signal_Type ESK_Type ESK_Fault ESK_Live ESK_SelfLock_Request ESK_Inching_Request ESK_Signal LostESKCommunication LostESKCom_Index /end REF_MEASUREMENT
/end GROUP
/begin GROUP Vin_RW "" /begin REF_CHARACTERISTIC /end REF_CHARACTERISTIC
 /begin REF_MEASUREMENT HC_CMD User_Level Device_Id Device_Num HC_Data_Id Time_Mark GetNewMessage_HC_CMD Need_HC_Data Vin_Rw_Errcode VCU_RESPONSE VCU_ROADCASTE VCU_ROADCASTE_Delay VCU_ROADCASTE_Number LostHCCommunication_Index LostHCCommunication VCU_ROADCASTE_Repeat_Times Need_Flash Rw_Times_Reset Data_OK._0_ Data_OK._1_ Data_OK._2_ Data_OK._3_ /end REF_MEASUREMENT
/end GROUP
/begin GROUP HardwareDrv "Comment" /begin REF_CHARACTERISTIC /end REF_CHARACTERISTIC /begin REF_MEASUREMENT /end REF_MEASUREMENT ROOT /begin SUB_GROUP AD AO DIO ICs Interface PulseAcq Timer VREG /end SUB_GROUP /end GROUP
/begin GROUP AD "Comment" /begin REF_CHARACTERISTIC ATDDrv_idxChanSigConfUB_CA ATDDrv_infoChanUB_CA /end REF_CHARACTERISTIC /begin REF_MEASUREMENT /end REF_MEASUREMENT /end GROUP
/begin GROUP AO "Comment" /begin REF_CHARACTERISTIC /end REF_CHARACTERISTIC /begin REF_MEASUREMENT /end REF_MEASUREMENT /end GROUP
/begin GROUP DIO "Comment"
 /begin REF_CHARACTERISTIC DIODrv_idxChanSigConfUB_CA DIODrv_idxChanSwtTypeUW_CA DIODrv_uLevelHighThresUW_C DIODrv_uLevelLowThresUW_C /end REF_CHARACTERISTIC
 /begin REF_MEASUREMENT /end REF_MEASUREMENT
/end GROUP
/begin GROUP ICs "集成芯片驱动" /begin REF_CHARACTERISTIC SigTst_bEnUW_C /end REF_CHARACTERISTIC /begin REF_MEASUREMENT /end REF_MEASUREMENT /end GROUP
/begin GROUP Interface "Comment"
 /begin REF_CHARACTERISTIC CCP_StationIdUB_CA KWPCAN_numFCWMaxUW_C KWPCAN_tiToBMaxUW_C KWPCAN_tiToCMaxUW_C /end REF_CHARACTERISTIC
 /begin REF_MEASUREMENT /end REF_MEASUREMENT
/end GROUP
/begin GROUP PulseAcq "Comment" /begin REF_CHARACTERISTIC /end REF_CHARACTERISTIC /begin REF_MEASUREMENT /end REF_MEASUREMENT /end GROUP
/begin GROUP Timer "Comment" /begin REF_CHARACTERISTIC /end REF_CHARACTERISTIC /begin REF_MEASUREMENT /end REF_MEASUREMENT /end GROUP
/begin GROUP VREG "Comment" /begin REF_CHARACTERISTIC /end REF_CHARACTERISTIC /begin REF_MEASUREMENT /end REF_MEASUREMENT /end GROUP
/begin GROUP SysCon "Comment"
 /begin REF_CHARACTERISTIC SysCon_stExtWait2MskUW_C SysCon_stExtWaitMskUW_C SysCon_stIRevShuOffMskUI_C SysCon_stRevShuOffMskUI_C SysCon_tiPostDriveMaxUI_C SysCon_tiPostDriveMinUI_C SysCon_tiShutdownMaxUI_C /end REF_CHARACTERISTIC
 /begin REF_MEASUREMENT /end REF_MEASUREMENT
 ROOT /end GROUP
/begin GROUP Vehicle "Comment" /begin REF_CHARACTERISTIC /end REF_CHARACTERISTIC /begin REF_MEASUREMENT /end REF_MEASUREMENT ROOT /begin SUB_GROUP Communication /end SUB_GROUP /end GROUP
/begin GROUP Communication "Comment" /begin REF_CHARACTERISTIC /end REF_CHARACTERISTIC /begin REF_MEASUREMENT /end REF_MEASUREMENT /end GROUP
/begin RECORD_LAYOUT TEST_Cur_u16u16 ALIGNMENT_BYTE 1 ALIGNMENT_FLOAT32_IEEE 4 ALIGNMENT_FLOAT64_IEEE 4 ALIGNMENT_LONG 4 ALIGNMENT_WORD 2 AXIS_PTS_X 2 UWORD INDEX_INCR DIRECT FNC_VALUES 3 UWORD ROW_DIR DIRECT NO_AXIS_PTS_X 1 UWORD /end RECORD_LAYOUT
/begin RECORD_LAYOUT Test_Map_u16u16u16 ALIGNMENT_BYTE 1 ALIGNMENT_FLOAT32_IEEE 4 ALIGNMENT_FLOAT64_IEEE 4 ALIGNMENT_LONG 4 ALIGNMENT_WORD 2 AXIS_PTS_X 3 UWORD INDEX_INCR DIRECT AXIS_PTS_Y 4 UWORD INDEX_INCR DIRECT FNC_VALUES 5 UWORD COLUMN_DIR DIRECT NO_AXIS_PTS_X 1 UWORD NO_AXIS_PTS_Y 2 UWORD /end RECORD_LAYOUT
/begin RECORD_LAYOUT Test_ValueBlock10_16bit ALIGNMENT_BYTE 1 ALIGNMENT_FLOAT32_IEEE 4 ALIGNMENT_FLOAT64_IEEE 4 ALIGNMENT_LONG 4 ALIGNMENT_WORD 2 FIX_NO_AXIS_PTS_X 10 FNC_VALUES 1 UWORD COLUMN_DIR DIRECT /end RECORD_LAYOUT
/begin RECORD_LAYOUT Test_ValueBlock12_16bit ALIGNMENT_FLOAT32_IEEE 4 ALIGNMENT_FLOAT64_IEEE 8 ALIGNMENT_LONG 4 ALIGNMENT_WORD 2 FIX_NO_AXIS_PTS_X 16 FNC_VALUES 1 UWORD COLUMN_DIR DIRECT /end RECORD_LAYOUT
/begin RECORD_LAYOUT Test_ValueBlock12_8bit ALIGNMENT_BYTE 1 ALIGNMENT_FLOAT32_IEEE 4 ALIGNMENT_FLOAT64_IEEE 4 ALIGNMENT_LONG 4 ALIGNMENT_WORD 2 FIX_NO_AXIS_PTS_X 12 FNC_VALUES 1 UBYTE COLUMN_DIR DIRECT /end RECORD_LAYOUT
/begin RECORD_LAYOUT Test_ValueBlock16_16bit ALIGNMENT_BYTE 1 ALIGNMENT_FLOAT32_IEEE 4 ALIGNMENT_FLOAT64_IEEE 4 ALIGNMENT_LONG 4 ALIGNMENT_WORD 2 FIX_NO_AXIS_PTS_X 16 FNC_VALUES 1 UWORD COLUMN_DIR DIRECT /end RECORD_LAYOUT
/begin RECORD_LAYOUT Test_ValueBlock16_8bit ALIGNMENT_BYTE 1 ALIGNMENT_FLOAT32_IEEE 4 ALIGNMENT_FLOAT64_IEEE 4 ALIGNMENT_LONG 4 ALIGNMENT_WORD 2 FIX_NO_AXIS_PTS_X 16 FNC_VALUES 1 UBYTE COLUMN_DIR DIRECT /end RECORD_LAYOUT
/begin RECORD_LAYOUT Test_ValueBlock2_16bit ALIGNMENT_BYTE 1 ALIGNMENT_FLOAT32_IEEE 4 ALIGNMENT_FLOAT64_IEEE 4 ALIGNMENT_LONG 4 ALIGNMENT_WORD 2 FIX_NO_AXIS_PTS_X 2 FNC_VALUES 1 UWORD COLUMN_DIR DIRECT /end RECORD_LAYOUT
/begin RECORD_LAYOUT __UBYTE_Z FNC_VALUES 1 UBYTE ROW_DIR DIRECT /end RECORD_LAYOUT
/begin RECORD_LAYOUT __UWORD_Z FNC_VALUES 1 UWORD ROW_DIR DIRECT /end RECORD_LAYOUT
/begin RECORD_LAYOUT __ULONG_Z FNC_VALUES 1 ULONG ROW_DIR DIRECT /end RECORD_LAYOUT
/begin RECORD_LAYOUT __SBYTE_Z FNC_VALUES 1 SBYTE ROW_DIR DIRECT /end RECORD_LAYOUT
/begin RECORD_LAYOUT __SWORD_Z FNC_VALUES 1 SWORD ROW_DIR DIRECT /end RECORD_LAYOUT
/begin RECORD_LAYOUT __SLONG_Z FNC_VALUES 1 SLONG ROW_DIR DIRECT /end RECORD_LAYOUT
/begin RECORD_LAYOUT __FLOAT32_IEEE_Z FNC_VALUES 1 FLOAT32_IEEE ROW_DIR DIRECT /end RECORD_LAYOUT
/begin RECORD_LAYOUT __FLOAT64_IEEE_Z FNC_VALUES 1 FLOAT32_IEEE ROW_DIR DIRECT /end RECORD_LAYOUT
/begin RECORD_LAYOUT __UBYTE_S FNC_VALUES 1 UBYTE COLUMN_DIR DIRECT /end RECORD_LAYOUT
/begin RECORD_LAYOUT __UWORD_S FNC_VALUES 1 UWORD COLUMN_DIR DIRECT /end RECORD_LAYOUT
/begin RECORD_LAYOUT __ULONG_S FNC_VALUES 1 ULONG COLUMN_DIR DIRECT /end RECORD_LAYOUT
/begin RECORD_LAYOUT __SBYTE_S FNC_VALUES 1 SBYTE COLUMN_DIR DIRECT /end RECORD_LAYOUT
/begin RECORD_LAYOUT __SWORD_S FNC_VALUES 1 SWORD COLUMN_DIR DIRECT /end RECORD_LAYOUT
/begin RECORD_LAYOUT __SLONG_S FNC_VALUES 1 SLONG COLUMN_DIR DIRECT /end RECORD_LAYOUT
/begin RECORD_LAYOUT __FLOAT32_IEEE_S FNC_VALUES 1 FLOAT32_IEEE COLUMN_DIR DIRECT /end RECORD_LAYOUT
/begin RECORD_LAYOUT __FLOAT64_IEEE_S FNC_VALUES 1 FLOAT32_IEEE COLUMN_DIR DIRECT /end RECORD_LAYOUT
/begin RECORD_LAYOUT SSV__UBYTE_S AXIS_PTS_X 1 UBYTE INDEX_INCR DIRECT /end RECORD_LAYOUT
/begin RECORD_LAYOUT SSV__UWORD_S AXIS_PTS_X 1 UWORD INDEX_INCR DIRECT /end RECORD_LAYOUT
/begin RECORD_LAYOUT SSV__ULONG_S AXIS_PTS_X 1 ULONG INDEX_INCR DIRECT /end RECORD_LAYOUT
/begin RECORD_LAYOUT SSV__SBYTE_S AXIS_PTS_X 1 SBYTE INDEX_INCR DIRECT /end RECORD_LAYOUT
/begin RECORD_LAYOUT SSV__SWORD_S AXIS_PTS_X 1 SWORD INDEX_INCR DIRECT /end RECORD_LAYOUT
/begin RECORD_LAYOUT SSV__SLONG_S AXIS_PTS_X 1 SLONG INDEX_INCR DIRECT /end RECORD_LAYOUT
/begin RECORD_LAYOUT SSV__FLOAT32_IEEE_S AXIS_PTS_X 1 FLOAT32_IEEE INDEX_INCR DIRECT /end RECORD_LAYOUT
/begin RECORD_LAYOUT SSV__FLOAT64_IEEE_S AXIS_PTS_X 1 FLOAT32_IEEE INDEX_INCR DIRECT /end RECORD_LAYOUT
/begin CHARACTERISTIC DataSet_idxVerUB_CA "底层数据版本" ASCII 0x784022 ECTEK_AscII32 0 NO_COMPU_METHOD 0.0 255.0 FORMAT "%.2" BIT_MASK 0xFF NUMBER 32 /end CHARACTERISTIC
/begin CHARACTERISTIC DataSet_idxUserVerUB_CA "用户数据版本" ASCII 0x784042 ECTEK_AscII16 0 NO_COMPU_METHOD -4294967296.0 4294967296.0 FORMAT "%.2" BIT_MASK 0xFF NUMBER 16 /end CHARACTERISTIC
/begin CHARACTERISTIC ATDDrv_infoChanUB_CA "ATDDrv_infoChanUB_CA，16个通道的AD配置情况" VAL_BLK 0x784052 ECTEK_ValueBlock24_u8 0 NO_FORMULA 0.0 255.0 FORMAT "%.2" BIT_MASK 0xFF NUMBER 24 /end CHARACTERISTIC
/begin CHARACTERISTIC ATDDrv_idxChanSigConfUB_CA "ATDDrv_idxChanSigConfUB_CA，各个信号的通道配置" VAL_BLK 0x78406A ECTEK_ValueBlock24_u8 0 NO_FORMULA 0.0 32.0 FORMAT "%.2" BIT_MASK 0xFF NUMBER 24 /end CHARACTERISTIC
/begin CHARACTERISTIC DIODrv_idxChanSigConfUB_CA "DIODrv_idxChanSigConfUB_CA，各个数字量输入的通道配置" VAL_BLK 0x784082 ECTEK_ValueBlock18_u8 0 NO_FORMULA 0.0 32.0 FORMAT "%.2" BIT_MASK 0xFF NUMBER 18 /end CHARACTERISTIC
/begin CHARACTERISTIC DIODrv_idxChanSwtTypeUW_CA "高低有效软件可配置数字量输入通道高低有效配置" VAL_BLK 0x784094 ECTEK_ValueBlock18_u16 0 idxDIType 0.0 1.0 FORMAT "%.2" BIT_MASK 0xFFFF NUMBER 18 /end CHARACTERISTIC
/begin CHARACTERISTIC DIODrv_uLevelHighThresUW_C "高低有效软件可配通道的高电平电压门限" VALUE 0x7840B8 ECTEK_Value_u16 0 uFactor4095 0.0 5.0 FORMAT "%.2" BIT_MASK 0xFFFF /end CHARACTERISTIC
/begin CHARACTERISTIC DIODrv_uLevelLowThresUW_C "高低有效软件可配置通道的低电平电压门限" VALUE 0x7840BA ECTEK_Value_u16 0 uFactor4095 0.0 5.0 FORMAT "%.2" BIT_MASK 0xFFFF /end CHARACTERISTIC
/begin CHARACTERISTIC PWMDrv_idxScaleAUB_C "PWMDrv_idxScaleAUB_C, PWM模块中时钟源A的分频数" VALUE 0x7840BC ECTEK_Value_u8 0 NO_COMPU_METHOD -4294967296.0 4294967296.0 FORMAT "%.2" BIT_MASK 0xFF /end CHARACTERISTIC
/begin CHARACTERISTIC PWMDrv_idxScaleBUB_C "PWMDrv_idxScaleBUB_C, PWM模块中时钟源B的分频数" VALUE 0x7840BD ECTEK_Value_u8 0 NO_COMPU_METHOD -4294967296.0 4294967296.0 FORMAT "%.2" BIT_MASK 0xFF /end CHARACTERISTIC
/begin CHARACTERISTIC PWMDrv_idxScaleSAUB_C "PWMDrv_idxScaleSAUB_C, PWM模块中时钟源SA的分频数, fSA=fA/(2*N)" VALUE 0x7840BE ECTEK_Value_u8 0 NO_COMPU_METHOD -4294967296.0 4294967296.0 FORMAT "%.2" BIT_MASK 0xFF /end CHARACTERISTIC
/begin CHARACTERISTIC PWMDrv_idxScaleSBUB_C "PWMDrv_idxScaleSBUB_C, PWM模块中时钟源SB的分频数, fSB=fB/(2*N)" VALUE 0x7840BF ECTEK_Value_u8 0 NO_COMPU_METHOD -4294967296.0 4294967296.0 FORMAT "%.2" BIT_MASK 0xFF /end CHARACTERISTIC
/begin CHARACTERISTIC PWMDrv_idxChanTimerConfUB_CA "PWMDrv_idxChanTimerConfUB_CA, PWM各通道所用时钟源, X0(PWM1)与X2(PWM5)使用A或SA, X1(PWM3)和X3(PWM7)使用B或SB" VAL_BLK 0x7840C0 ECTEK_ValueBlock4_u8 0 NO_COMPU_METHOD -4294967296.0 4294967296.0 FORMAT "%.2" BIT_MASK 0xFF NUMBER 4 /end CHARACTERISTIC
/begin CHARACTERISTIC PWMDrv_stChanPrecTypeUB_CA "PWM通道的精度类型，0为要求宽频率范围,1为要求宽占空比范围" VAL_BLK 0x7840C4 ECTEK_ValueBlock4_u8 0 NO_COMPU_METHOD -4294967296.0 4294967296.0 FORMAT "%.2" BIT_MASK 0xFF NUMBER 4 /end CHARACTERISTIC
/begin CHARACTERISTIC PWMDrv_idxFuncConfUB_CA "PWMDrv_idxFuncConfUB_CA, PWM模块中各功能所对应PWM管脚配置" VAL_BLK 0x7840C8 ECTEK_ValueBlock4_u8 0 NO_FORMULA 0.0 255.0 FORMAT "%.2" BIT_MASK 0xFF NUMBER 4 /end CHARACTERISTIC
/begin CHARACTERISTIC LSPWMDrv_idxChanSigConfUB_CA "PWM型低边驱动各任务通道配置" VAL_BLK 0x7840CC ECTEK_ValueBlock4_u8 0 NO_FORMULA 0.0 255.0 FORMAT "%.2" BIT_MASK 0xFF NUMBER 4 /end CHARACTERISTIC
/begin CHARACTERISTIC L9825Drv_swtUseUB_CA "L9825Drv_swtUseUB_CA, L9825两块芯片的使能配置" VAL_BLK 0x7840D0 ECTEK_ValueBlock2_u8 0 bFunctionActive 0.0 1.0 FORMAT "%.2" BIT_MASK 0xFF NUMBER 2 /end CHARACTERISTIC
/begin CHARACTERISTIC PSWTDrv_idxChanSigConfUB_CA "PSWTDrv_idxChanSigConfUB_CA, 高低边驱动任务号配置，0~7为低边驱动，8~15为高边驱动" VAL_BLK 0x7840D2 ECTEK_ValueBlock16_u8 0 NO_FORMULA 0.0 255.0 FORMAT "%.2" BIT_MASK 0xFF NUMBER 16 /end CHARACTERISTIC
/begin CHARACTERISTIC SysCon_stIRevShuOffMskUI_C "SysCon_stIRevShuOffMaskUI_C" VALUE 0x7840E2 ECTEK_Value_u32 0 NO_COMPU_METHOD -4294967296.0 4294967296.0 FORMAT "%.2" BIT_MASK 0xFFFFFFFF /end CHARACTERISTIC
/begin CHARACTERISTIC SysCon_stRevShuOffMskUI_C "SysCon_stRevShuOffMaskUI_C" VALUE 0x7840E6 ECTEK_Value_u32 0 NO_COMPU_METHOD -4294967296.0 4294967296.0 FORMAT "%.2" BIT_MASK 0xFFFFFFFF /end CHARACTERISTIC
/begin CHARACTERISTIC SysCon_stExtWaitMskUW_C "SysCon_stExtWaitMskUW_C，PostDrive状态等待结束的事件Mask" VALUE 0x7840EA ECTEK_Value_u16 0 NO_COMPU_METHOD -4294967296.0 4294967296.0 FORMAT "%.2" BIT_MASK 0xFFFF /end CHARACTERISTIC
/begin CHARACTERISTIC SysCon_stExtWait2MskUW_C "SysCon_stExtWait2MskUW_C，PostDrive状态等待结束的事件Mask" VALUE 0x7840EC ECTEK_Value_u16 0 NO_COMPU_METHOD -4294967296.0 4294967296.0 FORMAT "%.2" BIT_MASK 0xFFFF /end CHARACTERISTIC
/begin CHARACTERISTIC SysCon_tiPostDriveMaxUI_C "SysCon_tiPostDriveMaxUI_C，PostDrive最长时间，s" VALUE 0x7840EE ECTEK_Value_u32 0 NO_COMPU_METHOD -4294967296.0 4294967296.0 FORMAT "%.2" BIT_MASK 0xFFFFFFFF /end CHARACTERISTIC
/begin CHARACTERISTIC SysCon_tiShutdownMaxUI_C "SysCon_tiShutdownMaxUI_C，shutdown状态最长执行时间，s" VALUE 0x7840F2 ECTEK_Value_u32 0 NO_COMPU_METHOD -4294967296.0 4294967296.0 FORMAT "%.2" BIT_MASK 0xFFFFFFFF /end CHARACTERISTIC
/begin CHARACTERISTIC SysCon_tiPostDriveMinUI_C "SysCon_tiPostDriveMinUI_C，PostDrive最短时间，s" VALUE 0x7840F6 ECTEK_Value_u32 0 NO_COMPU_METHOD -4294967296.0 4294967296.0 FORMAT "%.2" BIT_MASK 0xFFFFFFFF /end CHARACTERISTIC
/begin CHARACTERISTIC MSCANDrv_infoBaudrateUW_CA "MSCANDrv_infoBaudrateUW_CA" VAL_BLK 0x7840FA ECTEK_ValueBlock3_u16 0 idxBaudRate 0.0 3.0 FORMAT "%.2" BIT_MASK 0xFFFF NUMBER 3 /end CHARACTERISTIC
/begin CHARACTERISTIC KWPCAN_tiToBMaxUW_C "KWPCAN_tiToBMaxUW_C,ToB 最长时间50*100ms" VALUE 0x784100 ECTEK_Value_u16 0 tiFactor20_50ms 0.0 500.0 FORMAT "%.2" BIT_MASK 0xFFFF /end CHARACTERISTIC
/begin CHARACTERISTIC KWPCAN_tiToCMaxUW_C "KWPCAN_tiToCMaxUW_C,ToC 最长时间50*100ms" VALUE 0x784102 ECTEK_Value_u16 0 tiFactor20_50ms 0.0 500.0 FORMAT "%.2" BIT_MASK 0xFFFF /end CHARACTERISTIC
/begin CHARACTERISTIC KWPCAN_numFCWMaxUW_C "KWPCAN_numFCWMaxUW_C,最多的Flow Control Wait Frame数目16" VALUE 0x784104 ECTEK_Value_u16 0 NO_FORMULA 0.0 1000.0 FORMAT "%.2" BIT_MASK 0xFFFF /end CHARACTERISTIC
/begin CHARACTERISTIC CCP_StationIdUB_CA "" ASCII 0x784106 ECTEK_AscII10 0 NO_COMPU_METHOD 0.0 255.0 FORMAT "%.2" BIT_MASK 0xFF NUMBER 10 /end CHARACTERISTIC
/begin CHARACTERISTIC SigTst_bEnUW_C "SigTst_bEnUW_C，是否直接控制9825和9362" VALUE 0x784110 ECTEK_Value_u16 0 bFunctionActive 0.0 1.0 FORMAT "%.2" BIT_MASK 0xFFFF /end CHARACTERISTIC
/begin CHARACTERISTIC SigTst_bChanL9825UB_CA "SigTst_bChanL9825UB_CA，各通道开关" VAL_BLK 0x784112 ECTEK_ValueBlock16_u8 0 bSwitch 0.0 1.0 FORMAT "%.2" BIT_MASK 0xFF NUMBER 16 /end CHARACTERISTIC
/begin CHARACTERISTIC SigTst_fChanL9825UI_CA "SigTst_fChanL9825UI_CA，L9825各通道的PWM频率" VAL_BLK 0x784122 ECTEK_ValueBlock4_u32 0 NO_COMPU_METHOD -4294967296.0 4294967296.0 FORMAT "%.2" BIT_MASK 0xFFFFFFFF NUMBER 4 /end CHARACTERISTIC
/begin CHARACTERISTIC SigTst_rChanL9825UW_CA "SigTst_rChanL9825UW_CA，L9825各通道的占空比" VAL_BLK 0x784132 ECTEK_ValueBlock4_u16 0 rFactor100_PWM 0.0 100.0 FORMAT "%.2" BIT_MASK 0xFFFF NUMBER 4 /end CHARACTERISTIC
/begin CHARACTERISTIC SigTst_bChanBTS724UB_CA "SigTst_bChanBTS724UB_CA，高边驱动开关" VAL_BLK 0x78413A ECTEK_ValueBlock8_u8 0 bSwitch 0.0 1.0 FORMAT "%.2" BIT_MASK 0xFF NUMBER 8 /end CHARACTERISTIC
/begin CHARACTERISTIC BattCD_uLogicOnUW_C "逻辑电上电电压限值" VALUE 0x784142 ECTEK_Value_u16 0 uFactor4095 0.0 5.0 FORMAT "%.2" BIT_MASK 0xFFFF /end CHARACTERISTIC
/begin CHARACTERISTIC BattCD_uUW_CUR "蓄电池电压特性" CURVE 0x784144 ECTEK_Curve_u16u16 0 uFactor100_Batt 0.0 60.0 FORMAT "%.2" BIT_MASK 0xFFFF
 /begin AXIS_DESCR STD_AXIS NO_INPUT_QUANTITY uFactor4095 4 0.0 5.0 DEPOSIT ABSOLUTE FORMAT "%.2" /end AXIS_DESCR
/end CHARACTERISTIC
/begin CHARACTERISTIC VehDataSet_idxSupervisorVerUB_CA "标准数据版本号" ASCII 0x784156 ECTEK_AscII16 0 NO_COMPU_METHOD -4294967296.0 4294967296.0 FORMAT "%.2" BIT_MASK 0xFF NUMBER 16 /end CHARACTERISTIC
/begin CHARACTERISTIC VehDataSet_idxUserVerUB_CA "用户数据版本号" ASCII 0x784166 ECTEK_AscII16 0 NO_COMPU_METHOD -4294967296.0 4294967296.0 FORMAT "%.2" BIT_MASK 0xFF NUMBER 16 /end CHARACTERISTIC
/begin CHARACTERISTIC Test_bSaveCmdUW_C "单值标定变量示例 触发EEPROM的存储" VALUE 0x784176 ECTEK_Value_u8 0 NO_COMPU_METHOD 0.0 255.0 FORMAT "%.2" BIT_MASK 0xFF /end CHARACTERISTIC
/begin CHARACTERISTIC Test_tTempUW_CUR "曲线标定变量示例" CURVE 0x784177 ECTEK_Curve_u16u16 0 tFactor256 -40.0 125.0 FORMAT "%.2" BIT_MASK 0xFFFF
 /begin AXIS_DESCR STD_AXIS NO_INPUT_QUANTITY uFactor4095 8 0.0 5.0 DEPOSIT ABSOLUTE FORMAT "%.2" /end AXIS_DESCR
/end CHARACTERISTIC
/begin CHARACTERISTIC Test_tiTimeUW_MAP "曲面标定变量示例" MAP 0x784199 ECTEK_Map_u16u16u16 0 tiFactor1_1us 0.0 65535.0 FORMAT "%.2" BIT_MASK 0xFFFF
 /begin AXIS_DESCR STD_AXIS NO_INPUT_QUANTITY nFactor1 8 0.0 6000.0 DEPOSIT ABSOLUTE FORMAT "%.2" /end AXIS_DESCR
 /begin AXIS_DESCR STD_AXIS NO_INPUT_QUANTITY vFactor32 4 0.0 300.0 DEPOSIT ABSOLUTE FORMAT "%.2" /end AXIS_DESCR
/end CHARACTERISTIC
/begin CHARACTERISTIC Test_strVersionUB_CA "字符串标定变量示例" ASCII 0x7841F5 ECTEK_AscII16 0 NO_COMPU_METHOD -0.0 255.0 FORMAT "%.2" BIT_MASK 0xFF NUMBER 16 /end CHARACTERISTIC
/begin CHARACTERISTIC Percent_Filter_And_All "油门滤波百分比-0总数-1增量占比-2减量占比" VAL_BLK 0x784205 ECTEK_ValueBlock3_u16 0 NO_FORMULA 0.0 1000.0 FORMAT "%.2" BIT_MASK 0xFFFF NUMBER 3 /end CHARACTERISTIC
/begin CHARACTERISTIC VCU_C_1 "整车控制帧-版本-日期-型号" VAL_BLK 0x78420B ECTEK_ValueBlock7_u8 0 NO_FORMULA 0.0 255.0 FORMAT "%.2" BIT_MASK 0xFF NUMBER 7 /end CHARACTERISTIC
/begin CHARACTERISTIC AccPed_Differ_Limit "双油门差值极限 100倍 %" VALUE 0x784212 ECTEK_Value_u16 0 NO_FORMULA 0.0 10000.0 FORMAT "%.2" BIT_MASK 0xFFFF /end CHARACTERISTIC
/begin CHARACTERISTIC AccPed_BreakErr_Max "油门刹车同时踩故障 最大油门值 0~100.00%" VALUE 0x784214 ECTEK_Value_u16 0 rFactor100_PWM 0.0 100.0 FORMAT "%.2" BIT_MASK 0xFFFF /end CHARACTERISTIC
/begin CHARACTERISTIC AccPed_ModeDelay "油门模式进入0-1Nm缓冲周期 0~250   *10ms" VALUE 0x784216 ECTEK_Value_u8 0 NO_FORMULA 0.0 250.0 FORMAT "%.2" BIT_MASK 0xFF /end CHARACTERISTIC
/begin CHARACTERISTIC AccPed_Torque_Diff_Add "进入油门给定斜坡周期增量 0.1~25.0Nm   10ms周期" VALUE 0x784217 ECTEK_Value_u8 0 NO_FORMULA 1.0 250.0 FORMAT "%.2" BIT_MASK 0xFF /end CHARACTERISTIC
/begin CHARACTERISTIC AccPed_Slope_Delay "进入油门给定斜坡周期 0~250 *10ms" VALUE 0x784218 ECTEK_Value_u8 0 NO_FORMULA 0.0 250.0 FORMAT "%.2" BIT_MASK 0xFF /end CHARACTERISTIC
/begin CHARACTERISTIC AccPed_Delay_Limit "油门踩下延迟 单位 *10ms" VALUE 0x784219 ECTEK_Value_u8 0 NO_FORMULA 0.0 255.0 FORMAT "%.2" BIT_MASK 0xFF /end CHARACTERISTIC
/begin CHARACTERISTIC Err_BatterLow_Limit "复制电池过低阀值" VALUE 0x78421A ECTEK_Value_u16 0 uFactor100_Batt 0.0 100.0 FORMAT "%.2" BIT_MASK 0xFFFF /end CHARACTERISTIC
/begin CHARACTERISTIC FeedBack_Diff_Rate "回馈进出斜坡周期增量 倍率 默认1" VALUE 0x78421C ECTEK_Value_u8 0 NO_FORMULA 1.0 255.0 FORMAT "%.2" BIT_MASK 0xFF /end CHARACTERISTIC
/begin CHARACTERISTIC FeedBack_Coast_Diff_Add "进入滑行回馈斜坡周期增量 0.1~25.0Nm  50ms周期" VALUE 0x78421D ECTEK_Value_u8 0 NO_FORMULA 1.0 250.0 FORMAT "%.2" BIT_MASK 0xFF /end CHARACTERISTIC
/begin CHARACTERISTIC FeedBack_Torque_Coast_Quir_Add "退出滑行回馈斜坡周期增量 0.1~25.0Nm 50ms周期" VALUE 0x78421E ECTEK_Value_u8 0 NO_FORMULA 0.0 250.0 FORMAT "%.2" BIT_MASK 0xFF /end CHARACTERISTIC
/begin CHARACTERISTIC FeedBack_Break_Diff_Add "进入制动回馈斜坡周期增量 0.1~25.0Nm 50ms周期" VALUE 0x78421F ECTEK_Value_u8 0 NO_FORMULA 0.0 250.0 FORMAT "%.2" BIT_MASK 0xFF /end CHARACTERISTIC
/begin CHARACTERISTIC FeedBack_Torque_Break_Quir_Add "退出制动回馈斜坡周期增量 0.1~25.0Nm 50ms周期" VALUE 0x784220 ECTEK_Value_u8 0 NO_FORMULA 0.0 250.0 FORMAT "%.2" BIT_MASK 0xFF /end CHARACTERISTIC
/begin CHARACTERISTIC FeedBack_Break_Max_AccPed "进入制动回馈最大油门上限  0~100.00%" VALUE 0x784221 ECTEK_Value_u16 0 rFactor100_PWM 0.0 100.0 FORMAT "%.2" BIT_MASK 0xFFFF /end CHARACTERISTIC
/begin CHARACTERISTIC Crawl_D_Torque_Enable "D蠕动是否允许" VALUE 0x784223 ECTEK_Value_u8 0 NO_FORMULA 0.0 1.0 FORMAT "%.2" BIT_MASK 0xFF /end CHARACTERISTIC
/begin CHARACTERISTIC FeedBack_Torque_Coast_Enable "D滑行回馈开关" VALUE 0x784224 ECTEK_Value_u8 0 NO_FORMULA 0.0 1.0 FORMAT "%.2" BIT_MASK 0xFF /end CHARACTERISTIC
/begin CHARACTERISTIC FeedBack_Torque_Break_Enable "D制动回馈开关" VALUE 0x784225 ECTEK_Value_u8 0 NO_FORMULA 0.0 1.0 FORMAT "%.2" BIT_MASK 0xFF /end CHARACTERISTIC
/begin CHARACTERISTIC Auto_Parking_D_Torque_Enable "D档驻坡开关" VALUE 0x784226 ECTEK_Value_u8 0 NO_FORMULA 0.0 1.0 FORMAT "%.2" BIT_MASK 0xFF /end CHARACTERISTIC
/begin CHARACTERISTIC Auto_Parking_R_Torque_Enable "R档驻坡开关" VALUE 0x784227 ECTEK_Value_u8 0 NO_FORMULA 0.0 1.0 FORMAT "%.2" BIT_MASK 0xFF /end CHARACTERISTIC
/begin CHARACTERISTIC AccPed_Torque_P_Enable "P档限速开关" VALUE 0x784228 ECTEK_Value_u8 0 NO_FORMULA 0.0 1.0 FORMAT "%.2" BIT_MASK 0xFF /end CHARACTERISTIC
/begin CHARACTERISTIC AccPed_Torque_R_Enable "R 档限速开关" VALUE 0x784229 ECTEK_Value_u8 0 NO_FORMULA 0.0 1.0 FORMAT "%.2" BIT_MASK 0xFF /end CHARACTERISTIC
/begin CHARACTERISTIC AccPed_Torque_100_Enable "100码限速开关" VALUE 0x78422A ECTEK_Value_u8 0 NO_FORMULA 0.0 1.0 FORMAT "%.2" BIT_MASK 0xFF /end CHARACTERISTIC
/begin CHARACTERISTIC Torque_Power_Limit_Enable "电池功率限制转矩开关" VALUE 0x78422B ECTEK_Value_u8 0 NO_FORMULA 0.0 1.0 FORMAT "%.2" BIT_MASK 0xFF /end CHARACTERISTIC
/begin CHARACTERISTIC ESK_Signal_Enable "换挡器类型判断开关" VALUE 0x78422C ECTEK_Value_u8 0 NO_FORMULA 0.0 1.0 FORMAT "%.2" BIT_MASK 0xFF /end CHARACTERISTIC
/begin CHARACTERISTIC APU_Enable "増程器开关" VALUE 0x78422D ECTEK_Value_u8 0 NO_FORMULA 0.0 1.0 FORMAT "%.2" BIT_MASK 0xFF /end CHARACTERISTIC
/begin CHARACTERISTIC P_Max_Speed "D档拉手刹最大速度 km/h" VALUE 0x78422E ECTEK_Value_u8 0 NO_FORMULA 0.0 100.0 FORMAT "%.2" BIT_MASK 0xFF /end CHARACTERISTIC
/begin CHARACTERISTIC FastDischarge_Enable "主动放电开关" VALUE 0x78422F ECTEK_Value_u8 0 NO_FORMULA 0.0 255.0 FORMAT "%.2" BIT_MASK 0xFF /end CHARACTERISTIC
/begin CHARACTERISTIC R_Max_Speed "R档最大速度 km/h" VALUE 0x784230 ECTEK_Value_u8 0 NO_FORMULA 0.0 100.0 FORMAT "%.2" BIT_MASK 0xFF /end CHARACTERISTIC
/begin CHARACTERISTIC Err_AccPed_Max_Speed "油门故障时最大车速" VALUE 0x784231 ECTEK_Value_u8 0 NO_FORMULA 0.0 100.0 FORMAT "%.2" BIT_MASK 0xFF /end CHARACTERISTIC
/begin CHARACTERISTIC D100_Max_Speed "D档最大车速" VALUE 0x784232 ECTEK_Value_u8 0 NO_COMPU_METHOD 0.0 160.0 FORMAT "%.2" BIT_MASK 0xFF /end CHARACTERISTIC
/begin CHARACTERISTIC VCU_ROADCASTE_Times "广播帧重复次数" VALUE 0x784233 ECTEK_Value_u8 0 NO_FORMULA 1.0 255.0 FORMAT "%.2" BIT_MASK 0xFF /end CHARACTERISTIC
/begin CHARACTERISTIC Vehicle_Type "车型定义 1、优优 2、D11\D12  3、D07-750   4、A9 大地和   5、D11\D12 大地和 6、A9力信 7、D09旭利  8、D09大地和  9、D11L8米力信 10、D08易动 11、D08力信  12、D07L易动电机  13、D9力信  14、D08大地和" VALUE 0x784234 ECTEK_Value_u8 0 NO_COMPU_METHOD 0.0 255.0 FORMAT "%.2" BIT_MASK 0xFF /end CHARACTERISTIC
/begin CHARACTERISTIC Auto_Vehicle_Type_Enable "自动识别车型开关" VALUE 0x784235 ECTEK_Value_u8 0 NO_FORMULA 0.0 1.0 FORMAT "%.2" BIT_MASK 0xFF /end CHARACTERISTIC
/begin CHARACTERISTIC FeedBack_Break_ModeDelay_Max "制动回馈进入0Nm缓冲时间 x50ms" VALUE 0x784236 ECTEK_Value_u8 0 NO_FORMULA 0.0 255.0 FORMAT "%.2" BIT_MASK 0xFF /end CHARACTERISTIC
/begin CHARACTERISTIC FeedBack_Coast_ModeDelay_Max "滑行回馈进入0Nm缓冲时间 x50ms" VALUE 0x784237 ECTEK_Value_u8 0 NO_FORMULA 0.0 255.0 FORMAT "%.2" BIT_MASK 0xFF /end CHARACTERISTIC
/begin CHARACTERISTIC Breakk_Type "制动踏板类型 0 单路开关量 1 双路互反开关量  2 单路模拟量 3 双路模拟量" VALUE 0x784238 ECTEK_Value_u8 0 NO_FORMULA 0.0 255.0 FORMAT "%.2" BIT_MASK 0xFF /end CHARACTERISTIC
/begin CHARACTERISTIC Err_Breakk_Index_Max "制动踏板故障延时计数器最大值（达到故障） 10ms" VALUE 0x784239 ECTEK_Value_u8 0 NO_FORMULA 1.0 255.0 FORMAT "%.2" BIT_MASK 0xFF /end CHARACTERISTIC
/begin CHARACTERISTIC Brake_Shoe_Check "制动蹄片更换检测" VALUE 0x78423A ECTEK_Value_u8 0 NO_FORMULA 0.0 255.0 FORMAT "%.2" BIT_MASK 0xFF /end CHARACTERISTIC
/begin CHARACTERISTIC Motor_Speed_Buffer_Type "电机速度缓存、Motor_Speed_Delta类型：0 老式  1 新式 Average" VALUE 0x78423B ECTEK_Value_u8 0 NO_FORMULA 0.0 255.0 FORMAT "%.2" BIT_MASK 0xFF /end CHARACTERISTIC
/begin CHARACTERISTIC Vmh_Delta_Vehco_Filter_Type "Vmh_Delta_Vehco过滤类型 0 老式82 、37过滤 1 无过滤" VALUE 0x78423C ECTEK_Value_u8 0 NO_FORMULA 0.0 255.0 FORMAT "%.2" BIT_MASK 0xFF /end CHARACTERISTIC
/begin CHARACTERISTIC GBT32960 "过检样车专用" VALUE 0x78423D ECTEK_Value_u8 0 NO_FORMULA 0.0 255.0 FORMAT "%.2" BIT_MASK 0xFF /end CHARACTERISTIC
/begin CHARACTERISTIC Motor_Vehicle_Speed_Scale "转速-车速比例， 优优114.411   D11 36.632" VALUE 0x78423E ECTEK_Value_u8 0 NO_FORMULA 0.0 255.0 FORMAT "%.2" BIT_MASK 0xFF /end CHARACTERISTIC
/begin CHARACTERISTIC Speed_Buffer_Number "10ms车辆速度采样缓冲次数" VALUE 0x78423F ECTEK_Value_u8 0 NO_FORMULA 1.0 69.0 FORMAT "%.2" BIT_MASK 0xFF /end CHARACTERISTIC
/begin CHARACTERISTIC Crawl_D_Speed_Max "D蠕动最大速度  从其他状态进入蠕动的速度" VALUE 0x784240 ECTEK_Value_u16 0 rpm1-1 0.0 2000.0 FORMAT "%.2" BIT_MASK 0xFFFF /end CHARACTERISTIC
/begin CHARACTERISTIC Speed_Average_Number "10ms平均车速缓冲次数" VALUE 0x784242 ECTEK_Value_u8 0 NO_FORMULA 1.0 69.0 FORMAT "%.2" BIT_MASK 0xFF /end CHARACTERISTIC
/begin CHARACTERISTIC Torque_Buffer_Number_AutoPark "10ms车辆平均转矩采样缓冲次数 驻坡" VALUE 0x784243 ECTEK_Value_u8 0 NO_FORMULA 1.0 69.0 FORMAT "%.2" BIT_MASK 0xFF /end CHARACTERISTIC
/begin CHARACTERISTIC Demand_Limit_High "速度上限" VALUE 0x784244 ECTEK_Value_u16 0 NO_FORMULA 0.0 4095.0 FORMAT "%.2" BIT_MASK 0xFFFF /end CHARACTERISTIC
/begin CHARACTERISTIC Demand_Limit_Low "速度下限" VALUE 0x784246 ECTEK_Value_u16 0 NO_FORMULA 0.0 4095.0 FORMAT "%.2" BIT_MASK 0xFFFF /end CHARACTERISTIC
/begin CHARACTERISTIC Auto_Park_Speed_Acc_Max "激活D驻坡最大退行距离 单位mm" VALUE 0x784248 ECTEK_Value_s16 0 NO_FORMULA -32768.0 32767.0 FORMAT "%.2" BIT_MASK 0xFFFF /end CHARACTERISTIC
/begin CHARACTERISTIC Auto_Park_Speed_Times_Max "激活D驻坡最大退行增速时间 单位10ms" VALUE 0x78424A ECTEK_Value_u16 0 NO_FORMULA 0.0 65535.0 FORMAT "%.2" BIT_MASK 0xFFFF /end CHARACTERISTIC
/begin CHARACTERISTIC D_Park_Start_Speed "D驻坡触发转速" VALUE 0x78424C ECTEK_Value_u8 0 rpm1-1 0.0 255.0 FORMAT "%.2" BIT_MASK 0xFF /end CHARACTERISTIC
/begin CHARACTERISTIC Crawl_D_Torque_Delay_Max "蠕动更新间隔  单位10ms" VALUE 0x78424D ECTEK_Value_u8 0 NO_FORMULA 0.0 255.0 FORMAT "%.2" BIT_MASK 0xFF /end CHARACTERISTIC
/begin CHARACTERISTIC AccPedCD_rUW_CUR "油门开度" CURVE 0x78424E ECTEK_Curve_u16u16 0 rFactor100_PWM 0.0 100.0 FORMAT "%.2" BIT_MASK 0xFFFF
 /begin AXIS_DESCR STD_AXIS NO_INPUT_QUANTITY u5V 7 0.0 5.0 DEPOSIT ABSOLUTE FORMAT "%.2" /end AXIS_DESCR
/end CHARACTERISTIC
/begin CHARACTERISTIC AccPedCD_rUW_CUR2 "油门2开度" CURVE 0x78426C ECTEK_Curve_u16u16 0 rFactor100_PWM 0.0 100.0 FORMAT "%.2" BIT_MASK 0xFFFF
 /begin AXIS_DESCR STD_AXIS NO_INPUT_QUANTITY u5V 7 0.0 5.0 DEPOSIT ABSOLUTE FORMAT "%.2" /end AXIS_DESCR
/end CHARACTERISTIC
/begin CHARACTERISTIC Motor_Speed_Torque "转速_最大转矩_165N 75KW  比例114.4" CURVE 0x78428A ECTEK_Curve_u16s16 0 NO_FORMULA 0.0 5000.0 FORMAT "%.2" BIT_MASK 0xFFFF
 /begin AXIS_DESCR STD_AXIS NO_INPUT_QUANTITY rpm1-1 19 -15000.0 15000.0 DEPOSIT ABSOLUTE FORMAT "%.2" /end AXIS_DESCR
/end CHARACTERISTIC
/begin CHARACTERISTIC AccPed_Rip "油门曲线" CURVE 0x7842D8 ECTEK_Curve_u16u16 0 rFactor100_PWM 0.0 100.0 FORMAT "%.2" BIT_MASK 0xFFFF
 /begin AXIS_DESCR STD_AXIS NO_INPUT_QUANTITY rFactor100_PWM 11 0.0 100.0 DEPOSIT ABSOLUTE FORMAT "%.2" /end AXIS_DESCR
/end CHARACTERISTIC
/begin CHARACTERISTIC Speed_Vmh10ms_Crawl_D "D档蠕动 转速-AD曲线 rpm----mh10ms" CURVE 0x784306 ECTEK_Curve_s16s16 0 Vmh10ms -500.0 500.0 FORMAT "%.2" BIT_MASK 0xFFFF
 /begin AXIS_DESCR STD_AXIS NO_INPUT_QUANTITY rpm1-1 10 -15000.0 15000.0 DEPOSIT ABSOLUTE FORMAT "%.2" /end AXIS_DESCR
/end CHARACTERISTIC
/begin CHARACTERISTIC Torque_Increment_Crawl_D "D档蠕动 AD修正转矩给定每周期增量" CURVE 0x784330 ECTEK_Curve_s16s16 0 NO_FORMULA -100.0 100.0 FORMAT "%.2" BIT_MASK 0xFFFF
 /begin AXIS_DESCR STD_AXIS NO_INPUT_QUANTITY Vmh10ms 11 -1000.0 1000.0 DEPOSIT ABSOLUTE FORMAT "%.2" /end AXIS_DESCR
/end CHARACTERISTIC
/begin CHARACTERISTIC Speed_Max_Torque_Crawl_D "D档蠕行模式最大力矩" CURVE 0x78435E ECTEK_Curve_u16s16 0 NO_FORMULA 0.0 5000.0 FORMAT "%.2" BIT_MASK 0xFFFF
 /begin AXIS_DESCR STD_AXIS NO_INPUT_QUANTITY rpm1-1 9 -15000.0 15000.0 DEPOSIT ABSOLUTE FORMAT "%.2" /end AXIS_DESCR
/end CHARACTERISTIC
/begin CHARACTERISTIC Speed_Max_Torque_Crawl_D_Break "D档蠕行制动状态下最大驱动力矩" CURVE 0x784384 ECTEK_Curve_u16s16 0 NO_FORMULA 0.0 5000.0 FORMAT "%.2" BIT_MASK 0xFFFF
 /begin AXIS_DESCR STD_AXIS NO_INPUT_QUANTITY rpm1-1 9 -15000.0 15000.0 DEPOSIT ABSOLUTE FORMAT "%.2" /end AXIS_DESCR
/end CHARACTERISTIC
/begin CHARACTERISTIC Speed_Vmh10ms_General "通用相对转速-AD曲线 rpm----mh10ms" CURVE 0x7843AA ECTEK_Curve_s16s16 0 Vmh10ms -1000.0 1000.0 FORMAT "%.2" BIT_MASK 0xFFFF
 /begin AXIS_DESCR STD_AXIS NO_INPUT_QUANTITY rpm1-1 11 -30000.0 30000.0 DEPOSIT ABSOLUTE FORMAT "%.2" /end AXIS_DESCR
/end CHARACTERISTIC
/begin CHARACTERISTIC Torque_Increment_General "通用AD修正转矩给定每周期增量" CURVE 0x7843D8 ECTEK_Curve_s16s16 0 NO_FORMULA -100.0 100.0 FORMAT "%.2" BIT_MASK 0xFFFF
 /begin AXIS_DESCR STD_AXIS NO_INPUT_QUANTITY Vmh10ms 11 -1000.0 1000.0 DEPOSIT ABSOLUTE FORMAT "%.2" /end AXIS_DESCR
/end CHARACTERISTIC
/begin CHARACTERISTIC Speed_Vmh10ms_D_Park "D档驻坡 转速-AD曲线 rpm----mh10ms" CURVE 0x784406 ECTEK_Curve_s16s16 0 Vmh10ms -1000.0 1000.0 FORMAT "%.2" BIT_MASK 0xFFFF
 /begin AXIS_DESCR STD_AXIS NO_INPUT_QUANTITY rpm1-1 12 -15000.0 15000.0 DEPOSIT ABSOLUTE FORMAT "%.2" /end AXIS_DESCR
/end CHARACTERISTIC
/begin CHARACTERISTIC Torque_Increment_D_Park "D档驻坡AD修正转矩给定每周期增量" CURVE 0x784438 ECTEK_Curve_s16s16 0 NO_FORMULA -100.0 100.0 FORMAT "%.2" BIT_MASK 0xFFFF
 /begin AXIS_DESCR STD_AXIS NO_INPUT_QUANTITY Vmh10ms 11 -1000.0 1000.0 DEPOSIT ABSOLUTE FORMAT "%.2" /end AXIS_DESCR
/end CHARACTERISTIC
/begin CHARACTERISTIC Speed_Vmh10ms_Break "制动回馈速度-AD曲线" CURVE 0x784466 ECTEK_Curve_s16s16 0 Vmh10ms -1000.0 1000.0 FORMAT "%.2" BIT_MASK 0xFFFF
 /begin AXIS_DESCR STD_AXIS NO_INPUT_QUANTITY rpm1-1 12 -15000.0 15000.0 DEPOSIT ABSOLUTE FORMAT "%.2" /end AXIS_DESCR
/end CHARACTERISTIC
/begin CHARACTERISTIC Torque_Increment_Break "制动回馈AD修正转矩给定每周期增量" CURVE 0x784498 ECTEK_Curve_s16s16 0 NO_FORMULA -100.0 100.0 FORMAT "%.2" BIT_MASK 0xFFFF
 /begin AXIS_DESCR STD_AXIS NO_INPUT_QUANTITY Vmh10ms 11 -1000.0 1000.0 DEPOSIT ABSOLUTE FORMAT "%.2" /end AXIS_DESCR
/end CHARACTERISTIC
/begin CHARACTERISTIC Motor_Speed_Torque_Break "电机最大制动力矩 40kw 114.4" CURVE 0x7844C6 ECTEK_Curve_s16s16 0 NO_FORMULA -0.0 1000.0 FORMAT "%.2" BIT_MASK 0xFFFF
 /begin AXIS_DESCR STD_AXIS NO_INPUT_QUANTITY rpm1-1 14 -15000.0 15000.0 DEPOSIT ABSOLUTE FORMAT "%.2" /end AXIS_DESCR
/end CHARACTERISTIC
/begin CHARACTERISTIC FeedBack_Coast_D_Torque "D档滑行回馈 速度-力矩  定点" CURVE 0x784500 ECTEK_Curve_s16s16 0 NO_FORMULA -1000.0 1000.0 FORMAT "%.2" BIT_MASK 0xFFFF
 /begin AXIS_DESCR STD_AXIS NO_INPUT_QUANTITY rpm1-1 8 -15000.0 15000.0 DEPOSIT ABSOLUTE FORMAT "%.2" /end AXIS_DESCR
/end CHARACTERISTIC
/begin CHARACTERISTIC FeedBack_Break_D_Torque "D档制动回馈 速度-力矩 定点" CURVE 0x784522 ECTEK_Curve_s16s16 0 NO_FORMULA -1000.0 1000.0 FORMAT "%.2" BIT_MASK 0xFFFF
 /begin AXIS_DESCR STD_AXIS NO_INPUT_QUANTITY rpm1-1 8 -15000.0 15000.0 DEPOSIT ABSOLUTE FORMAT "%.2" /end AXIS_DESCR
/end CHARACTERISTIC
/begin CHARACTERISTIC Speed_Efficieny "电机速度-转换效率曲线" CURVE 0x784544 ECTEK_Curve_u16u16 0 rFactor100_PWM 0.0 100.0 FORMAT "%.2" BIT_MASK 0xFFFF
 /begin AXIS_DESCR STD_AXIS NO_INPUT_QUANTITY rpm1-1 30 0.0 15000.0 DEPOSIT ABSOLUTE FORMAT "%.2" /end AXIS_DESCR
/end CHARACTERISTIC
/begin CHARACTERISTIC AutoPark_Motor_Speed_Torque "驻坡最大力矩" CURVE 0x7845BE ECTEK_Curve_u16s16 0 NO_FORMULA 0.0 5000.0 FORMAT "%.2" BIT_MASK 0xFFFF
 /begin AXIS_DESCR STD_AXIS NO_INPUT_QUANTITY rpm1-1 7 -15000.0 15000.0 DEPOSIT ABSOLUTE FORMAT "%.2" /end AXIS_DESCR
/end CHARACTERISTIC
/begin CHARACTERISTIC Motor_Vehicle_Speed_Scale_M02 "转速-车速比例， 优优114.411   D11 36.632" VALUE 0x7845DC ECTEK_Value_u8 0 NO_FORMULA 0.0 255.0 FORMAT "%.2" BIT_MASK 0xFF /end CHARACTERISTIC
/begin CHARACTERISTIC Demand_Limit_High_M02 "速度上限" VALUE 0x7845DD ECTEK_Value_u16 0 NO_FORMULA 0.0 4095.0 FORMAT "%.2" BIT_MASK 0xFFFF /end CHARACTERISTIC
/begin CHARACTERISTIC Demand_Limit_Low_M02 "速度下限" VALUE 0x7845DF ECTEK_Value_u16 0 NO_FORMULA 0.0 4095.0 FORMAT "%.2" BIT_MASK 0xFFFF /end CHARACTERISTIC
/begin CHARACTERISTIC Crawl_D_Speed_Max_M02 "D蠕动最大速度  从其他状态进入蠕动的速度" VALUE 0x7845E1 ECTEK_Value_u16 0 rpm1-1 0.0 1000.0 FORMAT "%.2" BIT_MASK 0xFFFF /end CHARACTERISTIC
/begin CHARACTERISTIC Crawl_D_Torque_Delay_Max_M02 "蠕动更新间隔  单位10ms" VALUE 0x7845E3 ECTEK_Value_u8 0 NO_FORMULA 1.0 255.0 FORMAT "%.2" BIT_MASK 0xFF /end CHARACTERISTIC
/begin CHARACTERISTIC Speed_Buffer_Number_M02 "10ms车辆速度采样缓冲次数" VALUE 0x7845E4 ECTEK_Value_u8 0 NO_FORMULA 1.0 69.0 FORMAT "%.2" BIT_MASK 0xFF /end CHARACTERISTIC
/begin CHARACTERISTIC Speed_Average_Number_M02 "10ms平均车速缓冲次数" VALUE 0x7845E5 ECTEK_Value_u8 0 NO_FORMULA 1.0 69.0 FORMAT "%.2" BIT_MASK 0xFF /end CHARACTERISTIC
/begin CHARACTERISTIC Torque_Buffer_Number_AutoPark_M02 "10ms车辆平均转矩采样缓冲次数 驻坡" VALUE 0x7845E6 ECTEK_Value_u8 0 NO_FORMULA 1.0 69.0 FORMAT "%.2" BIT_MASK 0xFF /end CHARACTERISTIC
/begin CHARACTERISTIC D_Park_Start_Speed_M02 "D驻坡触发转速" VALUE 0x7845E7 ECTEK_Value_u8 0 rpm1-1 0.0 255.0 FORMAT "%.2" BIT_MASK 0xFF /end CHARACTERISTIC
/begin CHARACTERISTIC Motor_Speed_Torque_M02 "转速_最大转矩_精进670N 145KW  比例36.632" CURVE 0x7845E8 ECTEK_Curve_u16s16 0 NO_COMPU_METHOD -0.0 5000.0 FORMAT "%.2" BIT_MASK 0xFFFF
 /begin AXIS_DESCR STD_AXIS NO_INPUT_QUANTITY rpm1-1 19 -15000.0 15000.0 DEPOSIT ABSOLUTE FORMAT "%.2" /end AXIS_DESCR
/end CHARACTERISTIC
/begin CHARACTERISTIC Speed_Vmh10ms_Crawl_D_M02 "D档蠕动 转速-AD曲线 rpm----mh10ms" CURVE 0x784636 ECTEK_Curve_s16s16 0 Vmh10ms -500.0 500.0 FORMAT "%.2" BIT_MASK 0xFFFF
 /begin AXIS_DESCR STD_AXIS NO_INPUT_QUANTITY rpm1-1 10 -15000.0 15000.0 DEPOSIT ABSOLUTE FORMAT "%.2" /end AXIS_DESCR
/end CHARACTERISTIC
/begin CHARACTERISTIC Torque_Increment_Crawl_D_M02 "D档蠕动 AD修正转矩给定每周期增量" CURVE 0x784660 ECTEK_Curve_s16s16 0 NO_FORMULA -100.0 100.0 FORMAT "%.2" BIT_MASK 0xFFFF
 /begin AXIS_DESCR STD_AXIS NO_INPUT_QUANTITY Vmh10ms 11 -1000.0 1000.0 DEPOSIT ABSOLUTE FORMAT "%.2" /end AXIS_DESCR
/end CHARACTERISTIC
/begin CHARACTERISTIC Speed_Max_Torque_Crawl_D_M02 "D档蠕行模式最大力矩" CURVE 0x78468E ECTEK_Curve_u16s16 0 NO_FORMULA 0.0 5000.0 FORMAT "%.2" BIT_MASK 0xFFFF
 /begin AXIS_DESCR STD_AXIS NO_INPUT_QUANTITY rpm1-1 9 -15000.0 15000.0 DEPOSIT ABSOLUTE FORMAT "%.2" /end AXIS_DESCR
/end CHARACTERISTIC
/begin CHARACTERISTIC Speed_Max_Torque_Crawl_D_Break_M02 "D档蠕行制动状态下最大驱动力矩" CURVE 0x7846B4 ECTEK_Curve_u16s16 0 NO_FORMULA 0.0 5000.0 FORMAT "%.2" BIT_MASK 0xFFFF
 /begin AXIS_DESCR STD_AXIS NO_INPUT_QUANTITY rpm1-1 9 -15000.0 15000.0 DEPOSIT ABSOLUTE FORMAT "%.2" /end AXIS_DESCR
/end CHARACTERISTIC
/begin CHARACTERISTIC Speed_Vmh10ms_General_M02 "通用相对转速-AD曲线 rpm----mh10ms" CURVE 0x7846DA ECTEK_Curve_s16s16 0 Vmh10ms -1000.0 1000.0 FORMAT "%.2" BIT_MASK 0xFFFF
 /begin AXIS_DESCR STD_AXIS NO_INPUT_QUANTITY rpm1-1 11 -30000.0 30000.0 DEPOSIT ABSOLUTE FORMAT "%.2" /end AXIS_DESCR
/end CHARACTERISTIC
/begin CHARACTERISTIC Torque_Increment_General_M02 "通用AD修正转矩给定每周期增量" CURVE 0x784708 ECTEK_Curve_s16s16 0 NO_FORMULA -100.0 100.0 FORMAT "%.2" BIT_MASK 0xFFFF
 /begin AXIS_DESCR STD_AXIS NO_INPUT_QUANTITY Vmh10ms 11 -1000.0 1000.0 DEPOSIT ABSOLUTE FORMAT "%.2" /end AXIS_DESCR
/end CHARACTERISTIC
/begin CHARACTERISTIC Speed_Vmh10ms_D_Park_M02 "D档驻坡 转速-AD曲线 rpm----mh10ms" CURVE 0x784736 ECTEK_Curve_s16s16 0 Vmh10ms -1000.0 1000.0 FORMAT "%.2" BIT_MASK 0xFFFF
 /begin AXIS_DESCR STD_AXIS NO_INPUT_QUANTITY rpm1-1 12 -15000.0 15000.0 DEPOSIT ABSOLUTE FORMAT "%.2" /end AXIS_DESCR
/end CHARACTERISTIC
/begin CHARACTERISTIC Torque_Increment_D_Park_M02 "D档驻坡AD修正转矩给定每周期增量" CURVE 0x784768 ECTEK_Curve_s16s16 0 NO_FORMULA -100.0 100.0 FORMAT "%.2" BIT_MASK 0xFFFF
 /begin AXIS_DESCR STD_AXIS NO_INPUT_QUANTITY Vmh10ms 11 -1000.0 1000.0 DEPOSIT ABSOLUTE FORMAT "%.2" /end AXIS_DESCR
/end CHARACTERISTIC
/begin CHARACTERISTIC Motor_Speed_Torque_Break_M02 "电机最大制动力矩" CURVE 0x784796 ECTEK_Curve_s16s16 0 NO_FORMULA 0.0 1000.0 FORMAT "%.2" BIT_MASK 0xFFFF
 /begin AXIS_DESCR STD_AXIS NO_INPUT_QUANTITY rpm1-1 14 -15000.0 15000.0 DEPOSIT ABSOLUTE FORMAT "%.2" /end AXIS_DESCR
/end CHARACTERISTIC
/begin CHARACTERISTIC FeedBack_Coast_D_Torque_M02 "D档滑行回馈 速度-力矩  定点" CURVE 0x7847D0 ECTEK_Curve_s16s16 0 NO_FORMULA -1000.0 1000.0 FORMAT "%.2" BIT_MASK 0xFFFF
 /begin AXIS_DESCR STD_AXIS NO_INPUT_QUANTITY rpm1-1 8 -15000.0 15000.0 DEPOSIT ABSOLUTE FORMAT "%.2" /end AXIS_DESCR
/end CHARACTERISTIC
/begin CHARACTERISTIC FeedBack_Break_D_Torque_M02 "D档制动回馈 速度-力矩 定点" CURVE 0x7847F2 ECTEK_Curve_s16s16 0 NO_FORMULA -1000.0 1000.0 FORMAT "%.2" BIT_MASK 0xFFFF
 /begin AXIS_DESCR STD_AXIS NO_INPUT_QUANTITY rpm1-1 8 -15000.0 15000.0 DEPOSIT ABSOLUTE FORMAT "%.2" /end AXIS_DESCR
/end CHARACTERISTIC
/begin CHARACTERISTIC Speed_Efficieny_M02 "电机速度-转换效率曲线" CURVE 0x784814 ECTEK_Curve_u16u16 0 rFactor100_PWM 0.0 100.0 FORMAT "%.2" BIT_MASK 0xFFFF
 /begin AXIS_DESCR STD_AXIS NO_INPUT_QUANTITY rpm1-1 26 0.0 15000.0 DEPOSIT ABSOLUTE FORMAT "%.2" /end AXIS_DESCR
/end CHARACTERISTIC
/begin CHARACTERISTIC AutoPark_Motor_Speed_Torque_M02 "驻坡最大力矩" CURVE 0x78487E ECTEK_Curve_u16s16 0 NO_FORMULA 0.0 5000.0 FORMAT "%.2" BIT_MASK 0xFFFF
 /begin AXIS_DESCR STD_AXIS NO_INPUT_QUANTITY rpm1-1 8 -15000.0 15000.0 DEPOSIT ABSOLUTE FORMAT "%.2" /end AXIS_DESCR
/end CHARACTERISTIC
/begin CHARACTERISTIC Motor_Vehicle_Speed_Scale_M021 "转速-车速比例， 优优114.411   D11 36.632" VALUE 0x7848A0 ECTEK_Value_u8 0 NO_COMPU_METHOD 0.0 255.0 FORMAT "%.2" BIT_MASK 0xFF /end CHARACTERISTIC
/begin CHARACTERISTIC Demand_Limit_High_M021 "速度上限" VALUE 0x7848A1 ECTEK_Value_u16 0 NO_COMPU_METHOD 0.0 4095.0 FORMAT "%.2" BIT_MASK 0xFFFF /end CHARACTERISTIC
/begin CHARACTERISTIC Demand_Limit_Low_M021 "速度下限" VALUE 0x7848A3 ECTEK_Value_u16 0 NO_COMPU_METHOD 0.0 4095.0 FORMAT "%.2" BIT_MASK 0xFFFF /end CHARACTERISTIC
/begin CHARACTERISTIC Crawl_D_Speed_Max_M021 "D蠕动最大速度  从其他状态进入蠕动的速度" VALUE 0x7848A5 ECTEK_Value_u16 0 NO_COMPU_METHOD 0.0 1000.0 FORMAT "%.2" BIT_MASK 0xFFFF /end CHARACTERISTIC
/begin CHARACTERISTIC Crawl_D_Torque_Delay_Max_M021 "蠕动更新间隔  单位10ms" VALUE 0x7848A7 ECTEK_Value_u8 0 NO_COMPU_METHOD 1.0 255.0 FORMAT "%.2" BIT_MASK 0xFF /end CHARACTERISTIC
/begin CHARACTERISTIC Crawl_D_Torque_Delay_Start_Max_M021 "起步蠕动更新间隔  单位10ms" VALUE 0x7848A8 ECTEK_Value_u8 0 NO_FORMULA 0.0 255.0 FORMAT "%.2" BIT_MASK 0xFF /end CHARACTERISTIC
/begin CHARACTERISTIC Speed_Buffer_Number_M021 "10ms车辆速度采样缓冲次数" VALUE 0x7848A9 ECTEK_Value_u8 0 NO_COMPU_METHOD 1.0 69.0 FORMAT "%.2" BIT_MASK 0xFF /end CHARACTERISTIC
/begin CHARACTERISTIC Speed_Average_Number_M021 "10ms平均车速缓冲次数" VALUE 0x7848AA ECTEK_Value_u8 0 NO_COMPU_METHOD 1.0 69.0 FORMAT "%.2" BIT_MASK 0xFF /end CHARACTERISTIC
/begin CHARACTERISTIC Torque_Buffer_Number_AutoPark_M021 "10ms车辆平均转矩采样缓冲次数 驻坡" VALUE 0x7848AB ECTEK_Value_u8 0 NO_COMPU_METHOD 1.0 69.0 FORMAT "%.2" BIT_MASK 0xFF /end CHARACTERISTIC
/begin CHARACTERISTIC D_Park_Start_Speed_M021 "D驻坡触发转速" VALUE 0x7848AC ECTEK_Value_u8 0 NO_COMPU_METHOD 0.0 255.0 FORMAT "%.2" BIT_MASK 0xFF /end CHARACTERISTIC
/begin CHARACTERISTIC Auto_Park_Speed_Acc_Max_M021 "激活D驻坡最大退行转速累加" VALUE 0x7848AD ECTEK_Value_s16 0 NO_FORMULA -32768.0 32767.0 FORMAT "%.2" BIT_MASK 0xFFFF /end CHARACTERISTIC
/begin CHARACTERISTIC Auto_Park_Speed_Times_Max_M021 "激活D驻坡最大退行增速时间 单位10ms" VALUE 0x7848AF ECTEK_Value_u16 0 NO_FORMULA 0.0 65535.0 FORMAT "%.2" BIT_MASK 0xFFFF /end CHARACTERISTIC
/begin CHARACTERISTIC Auto_Torque_Min_M021 "自动转矩最小正值" VALUE 0x7848B1 ECTEK_Value_s16 0 NO_COMPU_METHOD 0.0 300.0 FORMAT "%.2" BIT_MASK 0xFFFF /end CHARACTERISTIC
/begin CHARACTERISTIC Auto_Torque_Max_M021 "自动转矩最大负值" VALUE 0x7848B3 ECTEK_Value_s16 0 NO_FORMULA -300.0 0.0 FORMAT "%.2" BIT_MASK 0xFFFF /end CHARACTERISTIC
/begin CHARACTERISTIC R_Vhms_Average_Ratio_M021 "R档Vhms平均值缓冲比例" VALUE 0x7848B5 ECTEK_Value_u16 0 NO_FORMULA 1.0 500.0 FORMAT "%.2" BIT_MASK 0xFFFF /end CHARACTERISTIC
/begin CHARACTERISTIC D_Vhms_Average_Ratio_M021 "D档Vhms平均值缓冲比例" VALUE 0x7848B7 ECTEK_Value_u16 0 NO_FORMULA 1.0 500.0 FORMAT "%.2" BIT_MASK 0xFFFF /end CHARACTERISTIC
/begin CHARACTERISTIC Motor_Speed_Torque_M021 "转速_最大转矩_大地和350-700Nm 70-100KW  比例36.632" CURVE 0x7848B9 ECTEK_Curve_u16s16 0 NO_FORMULA 0.0 5000.0 FORMAT "%.2" BIT_MASK 0xFFFF
 /begin AXIS_DESCR STD_AXIS NO_INPUT_QUANTITY rpm1-1 19 -15000.0 15000.0 DEPOSIT ABSOLUTE FORMAT "%.2" /end AXIS_DESCR
/end CHARACTERISTIC
/begin CHARACTERISTIC Speed_Vmh10ms_Crawl_D_M021 "D档蠕动 转速-AD曲线 rpm----mh10ms" CURVE 0x784907 ECTEK_Curve_s16s16 0 Vmh10ms -500.0 500.0 FORMAT "%.2" BIT_MASK 0xFFFF
 /begin AXIS_DESCR STD_AXIS NO_INPUT_QUANTITY rpm1-1 10 -15000.0 15000.0 DEPOSIT ABSOLUTE FORMAT "%.2" /end AXIS_DESCR
/end CHARACTERISTIC
/begin CHARACTERISTIC Torque_Increment_Crawl_D_M021 "D档蠕动 AD修正转矩给定每周期增量" CURVE 0x784931 ECTEK_Curve_s16s16 0 NO_FORMULA -100.0 100.0 FORMAT "%.2" BIT_MASK 0xFFFF
 /begin AXIS_DESCR STD_AXIS NO_INPUT_QUANTITY Vmh10ms 11 -1000.0 1000.0 DEPOSIT ABSOLUTE FORMAT "%.2" /end AXIS_DESCR
/end CHARACTERISTIC
/begin CHARACTERISTIC Speed_Max_Torque_Crawl_D_M021 "D档蠕行模式最大力矩" CURVE 0x78495F ECTEK_Curve_u16s16 0 NO_FORMULA 0.0 5000.0 FORMAT "%.2" BIT_MASK 0xFFFF
 /begin AXIS_DESCR STD_AXIS NO_INPUT_QUANTITY rpm1-1 9 -15000.0 15000.0 DEPOSIT ABSOLUTE FORMAT "%.2" /end AXIS_DESCR
/end CHARACTERISTIC
/begin CHARACTERISTIC Speed_Max_Torque_Crawl_D_Break_M021 "D档蠕行制动状态下最大驱动力矩" CURVE 0x784985 ECTEK_Curve_u16s16 0 NO_FORMULA 0.0 5000.0 FORMAT "%.2" BIT_MASK 0xFFFF
 /begin AXIS_DESCR STD_AXIS NO_INPUT_QUANTITY rpm1-1 9 -15000.0 15000.0 DEPOSIT ABSOLUTE FORMAT "%.2" /end AXIS_DESCR
/end CHARACTERISTIC
/begin CHARACTERISTIC Speed_Vmh10ms_General_M021 "通用相对转速-AD曲线 rpm----mh10ms" CURVE 0x7849AB ECTEK_Curve_s16s16 0 Vmh10ms -1000.0 1000.0 FORMAT "%.2" BIT_MASK 0xFFFF
 /begin AXIS_DESCR STD_AXIS NO_INPUT_QUANTITY rpm1-1 11 -30000.0 30000.0 DEPOSIT ABSOLUTE FORMAT "%.2" /end AXIS_DESCR
/end CHARACTERISTIC
/begin CHARACTERISTIC Torque_Increment_General_M021 "通用AD修正转矩给定每周期增量" CURVE 0x7849D9 ECTEK_Curve_s16s16 0 NO_FORMULA -100.0 100.0 FORMAT "%.2" BIT_MASK 0xFFFF
 /begin AXIS_DESCR STD_AXIS NO_INPUT_QUANTITY Vmh10ms 11 -1000.0 1000.0 DEPOSIT ABSOLUTE FORMAT "%.2" /end AXIS_DESCR
/end CHARACTERISTIC
/begin CHARACTERISTIC Speed_Vmh10ms_D_Park_M021 "D档驻坡 转速-AD曲线 rpm----mh10ms" CURVE 0x784A07 ECTEK_Curve_s16s16 0 Vmh10ms -1000.0 1000.0 FORMAT "%.2" BIT_MASK 0xFFFF
 /begin AXIS_DESCR STD_AXIS NO_INPUT_QUANTITY rpm1-1 12 -15000.0 15000.0 DEPOSIT ABSOLUTE FORMAT "%.2" /end AXIS_DESCR
/end CHARACTERISTIC
/begin CHARACTERISTIC Torque_Increment_D_Park_M021 "D档驻坡AD修正转矩给定每周期增量" CURVE 0x784A39 ECTEK_Curve_s16s16 0 NO_FORMULA -100.0 100.0 FORMAT "%.2" BIT_MASK 0xFFFF
 /begin AXIS_DESCR STD_AXIS NO_INPUT_QUANTITY Vmh10ms 11 -1000.0 1000.0 DEPOSIT ABSOLUTE FORMAT "%.2" /end AXIS_DESCR
/end CHARACTERISTIC
/begin CHARACTERISTIC Motor_Speed_Torque_Break_M021 "电机最大制动力矩" CURVE 0x784A67 ECTEK_Curve_s16s16 0 NO_FORMULA 0.0 1000.0 FORMAT "%.2" BIT_MASK 0xFFFF
 /begin AXIS_DESCR STD_AXIS NO_INPUT_QUANTITY rpm1-1 14 -15000.0 15000.0 DEPOSIT ABSOLUTE FORMAT "%.2" /end AXIS_DESCR
/end CHARACTERISTIC
/begin CHARACTERISTIC FeedBack_Coast_D_Torque_M021 "D档滑行回馈 速度-力矩  定点" CURVE 0x784AA1 ECTEK_Curve_s16s16 0 NO_FORMULA -1000.0 1000.0 FORMAT "%.2" BIT_MASK 0xFFFF
 /begin AXIS_DESCR STD_AXIS NO_INPUT_QUANTITY rpm1-1 8 -15000.0 15000.0 DEPOSIT ABSOLUTE FORMAT "%.2" /end AXIS_DESCR
/end CHARACTERISTIC
/begin CHARACTERISTIC FeedBack_Break_D_Torque_M021 "D档制动回馈 速度-力矩 定点" CURVE 0x784AC3 ECTEK_Curve_s16s16 0 NO_FORMULA -1000.0 1000.0 FORMAT "%.2" BIT_MASK 0xFFFF
 /begin AXIS_DESCR STD_AXIS NO_INPUT_QUANTITY rpm1-1 8 -15000.0 15000.0 DEPOSIT ABSOLUTE FORMAT "%.2" /end AXIS_DESCR
/end CHARACTERISTIC
/begin CHARACTERISTIC Speed_Efficieny_M021 "电机速度-转换效率曲线" CURVE 0x784AE5 ECTEK_Curve_u16u16 0 rFactor100_PWM 0.0 100.0 FORMAT "%.2" BIT_MASK 0xFFFF
 /begin AXIS_DESCR STD_AXIS NO_INPUT_QUANTITY rpm1-1 17 0.0 15000.0 DEPOSIT ABSOLUTE FORMAT "%.2" /end AXIS_DESCR
/end CHARACTERISTIC
/begin CHARACTERISTIC AutoPark_Motor_Speed_Torque_M021 "驻坡最大力矩" CURVE 0x784B2B ECTEK_Curve_u16s16 0 NO_FORMULA 0.0 5000.0 FORMAT "%.2" BIT_MASK 0xFFFF
 /begin AXIS_DESCR STD_AXIS NO_INPUT_QUANTITY rpm1-1 9 -15000.0 15000.0 DEPOSIT ABSOLUTE FORMAT "%.2" /end AXIS_DESCR
/end CHARACTERISTIC
/begin CHARACTERISTIC Motor_Vehicle_Speed_Scale_M03 "转速-车速比例， 优优114.411   D11 36.632   D07  62.111" VALUE 0x784B51 ECTEK_Value_u8 0 NO_FORMULA 0.0 255.0 FORMAT "%.2" BIT_MASK 0xFF /end CHARACTERISTIC
/begin CHARACTERISTIC Demand_Limit_High_M03 "转速上线  *4" VALUE 0x784B52 ECTEK_Value_u16 0 NO_FORMULA 0.0 4095.0 FORMAT "%.2" BIT_MASK 0xFFFF /end CHARACTERISTIC
/begin CHARACTERISTIC Demand_Limit_Low_M03 "速度下限" VALUE 0x784B54 ECTEK_Value_u16 0 NO_FORMULA 0.0 4095.0 FORMAT "%.2" BIT_MASK 0xFFFF /end CHARACTERISTIC
/begin CHARACTERISTIC Crawl_D_Speed_Max_M03 "D蠕动最大速度  从其他状态进入蠕动的速度" VALUE 0x784B56 ECTEK_Value_u16 0 rpm1-1 0.0 1000.0 FORMAT "%.2" BIT_MASK 0xFFFF /end CHARACTERISTIC
/begin CHARACTERISTIC Crawl_D_Torque_Delay_Max_M03 "蠕动更新间隔  单位10ms" VALUE 0x784B58 ECTEK_Value_u8 0 NO_FORMULA 0.0 255.0 FORMAT "%.2" BIT_MASK 0xFF /end CHARACTERISTIC
/begin CHARACTERISTIC Crawl_D_Torque_Delay_Start_Max_M03 "起步蠕动更新间隔  单位10ms" VALUE 0x784B59 ECTEK_Value_u8 0 NO_FORMULA 0.0 255.0 FORMAT "%.2" BIT_MASK 0xFF /end CHARACTERISTIC
/begin CHARACTERISTIC Speed_Buffer_Number_M03 "10ms车辆速度采样缓冲次数" VALUE 0x784B5A ECTEK_Value_u8 0 NO_FORMULA 0.0 69.0 FORMAT "%.2" BIT_MASK 0xFF /end CHARACTERISTIC
/begin CHARACTERISTIC Speed_Average_Number_M03 "10ms平均车速缓冲次数" VALUE 0x784B5B ECTEK_Value_u8 0 NO_FORMULA 0.0 69.0 FORMAT "%.2" BIT_MASK 0xFF /end CHARACTERISTIC
/begin CHARACTERISTIC Torque_Buffer_Number_AutoPark_M03 "10ms平均车速缓冲次数" VALUE 0x784B5C ECTEK_Value_u8 0 NO_FORMULA 0.0 69.0 FORMAT "%.2" BIT_MASK 0xFF /end CHARACTERISTIC
/begin CHARACTERISTIC D_Park_Start_Speed_M03 "D驻坡触发转速" VALUE 0x784B5D ECTEK_Value_u8 0 rpm1-1 0.0 255.0 FORMAT "%.2" BIT_MASK 0xFF /end CHARACTERISTIC
/begin CHARACTERISTIC Auto_Park_Speed_Acc_Max_M03 "激活D驻坡最大退行转速累加" VALUE 0x784B5E ECTEK_Value_s16 0 NO_FORMULA -32768.0 32767.0 FORMAT "%.2" BIT_MASK 0xFFFF /end CHARACTERISTIC
/begin CHARACTERISTIC Auto_Park_Speed_Times_Max_M03 "激活D驻坡最大退行增速时间 单位10ms" VALUE 0x784B60 ECTEK_Value_u16 0 NO_FORMULA 0.0 65535.0 FORMAT "%.2" BIT_MASK 0xFFFF /end CHARACTERISTIC
/begin CHARACTERISTIC EPS_Pwm "EPS脉冲信号手工频率" VALUE 0x784B62 ECTEK_Value_u32 0 PWM_Hz100 0.0 5000.0 BIT_MASK 0xFFFFFFFF /end CHARACTERISTIC
/begin CHARACTERISTIC EPS_Vehicle_Speed_Scale "EPS频率-车速比例  100倍" VALUE 0x784B66 ECTEK_Value_u16 0 NO_COMPU_METHOD 0.0 65535.0 FORMAT "%.2" BIT_MASK 0xFFFF /end CHARACTERISTIC
/begin CHARACTERISTIC AC_Pressure_Max_Times "空调压力开关动作延迟 *50mS" VALUE 0x784B68 ECTEK_Value_u16 0 NO_FORMULA 0.0 65535.0 FORMAT "%.2" BIT_MASK 0xFFFF /end CHARACTERISTIC
/begin CHARACTERISTIC AC_Condenser_Temp_Low "空调蒸发器温度最低值" VALUE 0x784B6A ECTEK_Value_s8 0 NO_FORMULA -128.0 127.0 FORMAT "%.2" BIT_MASK 0xFF /end CHARACTERISTIC
/begin CHARACTERISTIC Auto_Torque_Min_M03 "自动转矩最小正值" VALUE 0x784B6B ECTEK_Value_s16 0 NO_FORMULA -300.0 300.0 FORMAT "%.2" BIT_MASK 0xFFFF /end CHARACTERISTIC
/begin CHARACTERISTIC Auto_Torque_Max_M03 "自动转矩最大负值" VALUE 0x784B6D ECTEK_Value_s16 0 NO_FORMULA -300.0 300.0 FORMAT "%.2" BIT_MASK 0xFFFF /end CHARACTERISTIC
/begin CHARACTERISTIC R_Vhms_Average_Ratio_M03 "R档Vhms平均值缓冲比例" VALUE 0x784B6F ECTEK_Value_u16 0 NO_FORMULA 1.0 500.0 FORMAT "%.2" BIT_MASK 0xFFFF /end CHARACTERISTIC
/begin CHARACTERISTIC D_Vhms_Average_Ratio_M03 "D档Vhms平均值缓冲比例" VALUE 0x784B71 ECTEK_Value_u16 0 NO_FORMULA 1.0 500.0 FORMAT "%.2" BIT_MASK 0xFFFF /end CHARACTERISTIC
/begin CHARACTERISTIC Motor_Speed_Torque_M03 "转速_最大转矩 大地和 100KW 300N   62.111" CURVE 0x784B73 ECTEK_Curve_u16s16 0 NO_FORMULA 0.0 5000.0 FORMAT "%.2" BIT_MASK 0xFFFF
 /begin AXIS_DESCR STD_AXIS NO_INPUT_QUANTITY rpm1-1 19 -15000.0 15000.0 DEPOSIT ABSOLUTE FORMAT "%.2" /end AXIS_DESCR
/end CHARACTERISTIC
/begin CHARACTERISTIC AccPed_Rip_M03 "油门曲线" CURVE 0x784BC1 ECTEK_Curve_u16u16 0 rFactor100_PWM 0.0 100.0 FORMAT "%.2" BIT_MASK 0xFFFF
 /begin AXIS_DESCR STD_AXIS NO_INPUT_QUANTITY rFactor100_PWM 11 0.0 100.0 DEPOSIT ABSOLUTE FORMAT "%.2" /end AXIS_DESCR
/end CHARACTERISTIC
/begin CHARACTERISTIC Speed_Vmh10ms_Crawl_D_M03 "D档蠕动 转速-AD曲线 rpm----mh10ms" CURVE 0x784BEF ECTEK_Curve_s16s16 0 Vmh10ms -500.0 500.0 FORMAT "%.2" BIT_MASK 0xFFFF
 /begin AXIS_DESCR STD_AXIS NO_INPUT_QUANTITY rpm1-1 10 -15000.0 15000.0 DEPOSIT ABSOLUTE FORMAT "%.2" /end AXIS_DESCR
/end CHARACTERISTIC
/begin CHARACTERISTIC Torque_Increment_Crawl_D_M03 "D档蠕动 AD修正转矩给定每周期增量" CURVE 0x784C19 ECTEK_Curve_s16s16 0 NO_FORMULA -100.0 100.0 FORMAT "%.2" BIT_MASK 0xFFFF
 /begin AXIS_DESCR STD_AXIS NO_INPUT_QUANTITY NO_COMPU_METHOD 11 -1000.0 1000.0 DEPOSIT ABSOLUTE FORMAT "%.2" /end AXIS_DESCR
/end CHARACTERISTIC
/begin CHARACTERISTIC Speed_Max_Torque_Crawl_D_M03 "D档蠕行模式最大力矩" CURVE 0x784C47 ECTEK_Curve_u16s16 0 NO_FORMULA 0.0 5000.0 FORMAT "%.2" BIT_MASK 0xFFFF
 /begin AXIS_DESCR STD_AXIS NO_INPUT_QUANTITY rpm1-1 10 -15000.0 15000.0 DEPOSIT ABSOLUTE FORMAT "%.2" /end AXIS_DESCR
/end CHARACTERISTIC
/begin CHARACTERISTIC Speed_Max_Torque_Crawl_D_Break_M03 "D档蠕行制动状态下最大驱动力矩" CURVE 0x784C71 ECTEK_Curve_u16s16 0 NO_COMPU_METHOD 0.0 5000.0 FORMAT "%.2" BIT_MASK 0xFFFF
 /begin AXIS_DESCR STD_AXIS NO_INPUT_QUANTITY NO_COMPU_METHOD 11 -15000.0 15000.0 DEPOSIT ABSOLUTE FORMAT "%.2" /end AXIS_DESCR
/end CHARACTERISTIC
/begin CHARACTERISTIC Speed_Vmh10ms_General_M03 "通用相对转速-AD曲线 rpm----mh10ms" CURVE 0x784C9F ECTEK_Curve_s16s16 0 Vmh10ms -1000.0 1000.0 FORMAT "%.2" BIT_MASK 0xFFFF
 /begin AXIS_DESCR STD_AXIS NO_INPUT_QUANTITY rpm1-1 11 -30000.0 30000.0 DEPOSIT ABSOLUTE FORMAT "%.2" /end AXIS_DESCR
/end CHARACTERISTIC
/begin CHARACTERISTIC Torque_Increment_General_M03 "通用AD修正转矩给定每周期增量" CURVE 0x784CCD ECTEK_Curve_s16s16 0 NO_FORMULA -100.0 100.0 FORMAT "%.2" BIT_MASK 0xFFFF
 /begin AXIS_DESCR STD_AXIS NO_INPUT_QUANTITY Vmh10ms 11 -1000.0 1000.0 DEPOSIT ABSOLUTE FORMAT "%.2" /end AXIS_DESCR
/end CHARACTERISTIC
/begin CHARACTERISTIC Speed_Vmh10ms_D_Park_M03 "D档驻坡 转速-AD曲线 rpm----mh10ms" CURVE 0x784CFB ECTEK_Curve_s16s16 0 Vmh10ms -1000.0 1000.0 FORMAT "%.2" BIT_MASK 0xFFFF
 /begin AXIS_DESCR STD_AXIS NO_INPUT_QUANTITY rpm1-1 12 -15000.0 15000.0 DEPOSIT ABSOLUTE FORMAT "%.2" /end AXIS_DESCR
/end CHARACTERISTIC
/begin CHARACTERISTIC Torque_Increment_D_Park_M03 "D档驻坡AD修正转矩给定每周期增量" CURVE 0x784D2D ECTEK_Curve_s16s16 0 NO_FORMULA -100.0 100.0 FORMAT "%.2" BIT_MASK 0xFFFF
 /begin AXIS_DESCR STD_AXIS NO_INPUT_QUANTITY Vmh10ms 11 -1000.0 1000.0 DEPOSIT ABSOLUTE FORMAT "%.2" /end AXIS_DESCR
/end CHARACTERISTIC
/begin CHARACTERISTIC Motor_Speed_Torque_Break_M03 "电机最大制动力矩" CURVE 0x784D5B ECTEK_Curve_s16s16 0 NO_FORMULA -0.0 5000.0 FORMAT "%.2" BIT_MASK 0xFFFF
 /begin AXIS_DESCR STD_AXIS NO_INPUT_QUANTITY rpm1-1 14 -15000.0 15000.0 DEPOSIT ABSOLUTE FORMAT "%.2" /end AXIS_DESCR
/end CHARACTERISTIC
/begin CHARACTERISTIC FeedBack_Coast_D_Torque_M03 "D档滑行回馈 速度-力矩  定点" CURVE 0x784D95 ECTEK_Curve_s16s16 0 NO_FORMULA -1000.0 1000.0 FORMAT "%.2" BIT_MASK 0xFFFF
 /begin AXIS_DESCR STD_AXIS NO_INPUT_QUANTITY rpm1-1 8 -15000.0 15000.0 DEPOSIT ABSOLUTE FORMAT "%.2" /end AXIS_DESCR
/end CHARACTERISTIC
/begin CHARACTERISTIC FeedBack_Break_D_Torque_M03 "D档制动回馈 速度-力矩 定点" CURVE 0x784DB7 ECTEK_Curve_s16s16 0 NO_FORMULA -1000.0 1000.0 FORMAT "%.2" BIT_MASK 0xFFFF
 /begin AXIS_DESCR STD_AXIS NO_INPUT_QUANTITY rpm1-1 8 -15000.0 15000.0 DEPOSIT ABSOLUTE FORMAT "%.2" /end AXIS_DESCR
/end CHARACTERISTIC
/begin CHARACTERISTIC Speed_Efficieny_M03 "电机速度-转换效率曲线 驱动" CURVE 0x784DD9 ECTEK_Curve_u16u16 0 rFactor100_PWM 0.0 100.0 FORMAT "%.2" BIT_MASK 0xFFFF
 /begin AXIS_DESCR STD_AXIS NO_INPUT_QUANTITY rpm1-1 14 0.0 15000.0 DEPOSIT ABSOLUTE FORMAT "%.2" /end AXIS_DESCR
/end CHARACTERISTIC
/begin CHARACTERISTIC Speed_Efficieny_FeedBack_M03 "电机速度-转换效率曲线 发电" CURVE 0x784E13 ECTEK_Curve_u16u16 0 rFactor100_PWM 0.0 100.0 FORMAT "%.2" BIT_MASK 0xFFFF
 /begin AXIS_DESCR STD_AXIS NO_INPUT_QUANTITY rpm1-1 14 0.0 15000.0 DEPOSIT ABSOLUTE FORMAT "%.2" /end AXIS_DESCR
/end CHARACTERISTIC
/begin CHARACTERISTIC AutoPark_Motor_Speed_Torque_M03 "驻坡最大力矩" CURVE 0x784E4D ECTEK_Curve_u16s16 0 NO_FORMULA 0.0 5000.0 FORMAT "%.2" BIT_MASK 0xFFFF
 /begin AXIS_DESCR STD_AXIS NO_INPUT_QUANTITY rpm1-1 8 -15000.0 15000.0 DEPOSIT ABSOLUTE FORMAT "%.2" /end AXIS_DESCR
/end CHARACTERISTIC
/begin CHARACTERISTIC AccPedCD_rUW_CUR_M03 "油门开度" CURVE 0x784E6F ECTEK_Curve_u16u16 0 rFactor100_PWM 0.0 100.0 FORMAT "%.2" BIT_MASK 0xFFFF
 /begin AXIS_DESCR STD_AXIS NO_INPUT_QUANTITY u5V 7 0.0 5.0 DEPOSIT ABSOLUTE FORMAT "%.2" /end AXIS_DESCR
/end CHARACTERISTIC
/begin CHARACTERISTIC AccPedCD_rUW_CUR2_M03 "油门2开度" CURVE 0x784E8D ECTEK_Curve_u16u16 0 rFactor100_PWM 0.0 100.0 FORMAT "%.2" BIT_MASK 0xFFFF
 /begin AXIS_DESCR STD_AXIS NO_INPUT_QUANTITY u5V 7 0.0 5.0 DEPOSIT ABSOLUTE FORMAT "%.2" /end AXIS_DESCR
/end CHARACTERISTIC
/begin CHARACTERISTIC EPS_Speed "D07 EPS频率与转速对应曲线 33~233.30Hz" CURVE 0x784EAB ECTEK_Curve_u16s16 0 PWM_Hz100 33.0 600.0 BIT_MASK 0xFFFF
 /begin AXIS_DESCR STD_AXIS NO_INPUT_QUANTITY rpm1-1 10 -15000.0 15000.0 DEPOSIT ABSOLUTE FORMAT "%.2" /end AXIS_DESCR
/end CHARACTERISTIC
/begin CHARACTERISTIC AC_Condenser_Temp_M03 "空调蒸发器温度" CURVE 0x784ED5 ECTEK_Curve_s16u16 0 NO_FORMULA -100.0 150.0 FORMAT "%.2" BIT_MASK 0xFF
 /begin AXIS_DESCR STD_AXIS NO_INPUT_QUANTITY NO_FORMULA 35 0.0 4095.0 DEPOSIT ABSOLUTE FORMAT "%.2" /end AXIS_DESCR
/end CHARACTERISTIC
/begin CHARACTERISTIC AC_Condenser_Temp_M03_ACES "空调蒸发器温度_奥易克斯" CURVE 0x784F63 ECTEK_Curve_s16u16 0 NO_FORMULA -100.0 150.0 FORMAT "%.2" BIT_MASK 0xFFFF
 /begin AXIS_DESCR STD_AXIS NO_INPUT_QUANTITY NO_FORMULA 36 0.0 4095.0 DEPOSIT ABSOLUTE FORMAT "%.2" /end AXIS_DESCR
/end CHARACTERISTIC
/begin CHARACTERISTIC APU_DebugMode "増程器手动调试模式开关" VALUE 0x784FF5 ECTEK_Value_u8 0 NO_FORMULA 0.0 1.0 FORMAT "%.2" BIT_MASK 0xFF /end CHARACTERISTIC
/begin CHARACTERISTIC APU_Debug_CMD "増程器工作命令 0 停 1 工作(启动) 2 发电 3 主动放电" VALUE 0x784FF6 ECTEK_Value_u8 0 NO_FORMULA 0.0 3.0 FORMAT "%.2" BIT_MASK 0xFF /end CHARACTERISTIC
/begin CHARACTERISTIC APU_Debug_Demand_Power "増程器目标发电功率 1310.7~0.1KW" VALUE 0x784FF7 ECTEK_Value_u16 0 rFactor10_VSSPlaus 0.0 1310.7 FORMAT "%.2" BIT_MASK 0xFFFF /end CHARACTERISTIC
/begin CHARACTERISTIC APU_Debug_Demand_Speed "増程器目标转速" VALUE 0x784FF9 ECTEK_Value_u16 0 rpm1-1 0.0 7650.0 FORMAT "%.2" BIT_MASK 0xFFFF /end CHARACTERISTIC
/begin CHARACTERISTIC Motor_Vehicle_Speed_Scale_M04 "转速-车速比例， 优优114.411   D11 36.632   D07  62.111  A9 95.064" VALUE 0x784FFB ECTEK_Value_u8 0 NO_FORMULA 0.0 255.0 FORMAT "%.2" BIT_MASK 0xFF /end CHARACTERISTIC
/begin CHARACTERISTIC Demand_Limit_High_M04 "转速上线  *4" VALUE 0x784FFC ECTEK_Value_u16 0 NO_FORMULA -0.0 4095.0 FORMAT "%.2" BIT_MASK 0xFFFF /end CHARACTERISTIC
/begin CHARACTERISTIC Demand_Limit_Low_M04 "速度下限" VALUE 0x784FFE ECTEK_Value_u16 0 NO_FORMULA -0.0 4095.0 FORMAT "%.2" BIT_MASK 0xFFFF /end CHARACTERISTIC
/begin CHARACTERISTIC Crawl_D_Speed_Max_M04 "D蠕动最大速度  从其他状态进入蠕动的速度" VALUE 0x785000 ECTEK_Value_u16 0 rpm1-1 -0.0 1000.0 FORMAT "%.2" BIT_MASK 0xFFFF /end CHARACTERISTIC
/begin CHARACTERISTIC Crawl_D_Torque_Delay_Max_M04 "蠕动更新间隔  单位10ms" VALUE 0x785002 ECTEK_Value_u8 0 NO_FORMULA -0.0 255.0 FORMAT "%.2" BIT_MASK 0xFF /end CHARACTERISTIC
/begin CHARACTERISTIC Crawl_D_Torque_Delay_Start_Max_M04 "起步蠕动更新间隔  单位10ms" VALUE 0x785003 ECTEK_Value_u8 0 NO_COMPU_METHOD -4294967296.0 4294967296.0 FORMAT "%.2" BIT_MASK 0xFF /end CHARACTERISTIC
/begin CHARACTERISTIC Speed_Buffer_Number_M04 "10ms车辆速度采样缓冲次数" VALUE 0x785004 ECTEK_Value_u8 0 NO_FORMULA -0.0 69.0 FORMAT "%.2" BIT_MASK 0xFF /end CHARACTERISTIC
/begin CHARACTERISTIC Speed_Average_Number_M04 "10ms平均车速缓冲次数" VALUE 0x785005 ECTEK_Value_u8 0 NO_FORMULA -0.0 69.0 FORMAT "%.2" BIT_MASK 0xFF /end CHARACTERISTIC
/begin CHARACTERISTIC Torque_Buffer_Number_AutoPark_M04 "10ms平均转矩缓冲次数" VALUE 0x785006 ECTEK_Value_u8 0 NO_FORMULA -0.0 69.0 FORMAT "%.2" BIT_MASK 0xFF /end CHARACTERISTIC
/begin CHARACTERISTIC D_Park_Start_Speed_M04 "D驻坡触发转速" VALUE 0x785007 ECTEK_Value_u8 0 rpm1-1 -0.0 255.0 FORMAT "%.2" BIT_MASK 0xFF /end CHARACTERISTIC
/begin CHARACTERISTIC Auto_Park_Speed_Acc_Max_M04 "激活D驻坡最大退行转速累加" VALUE 0x785008 ECTEK_Value_s16 0 NO_FORMULA -32767.0 32768.0 FORMAT "%.2" BIT_MASK 0xFFFF /end CHARACTERISTIC
/begin CHARACTERISTIC Auto_Park_Speed_Times_Max_M04 "激活D驻坡最大退行增速时间 单位10ms" VALUE 0x78500A ECTEK_Value_u16 0 NO_FORMULA -0.0 65535.0 FORMAT "%.2" BIT_MASK 0xFFFF /end CHARACTERISTIC
/begin CHARACTERISTIC Auto_Torque_Min_M04 "自动转矩最小正值" VALUE 0x78500C ECTEK_Value_s16 0 NO_FORMULA 0.0 150.0 FORMAT "%.2" BIT_MASK 0xFFFF /end CHARACTERISTIC
/begin CHARACTERISTIC Auto_Torque_Max_M04 "自动转矩最大负值" VALUE 0x78500E ECTEK_Value_s16 0 NO_FORMULA -150.0 0.0 FORMAT "%.2" BIT_MASK 0xFFFF /end CHARACTERISTIC
/begin CHARACTERISTIC R_Vhms_Average_Ratio_M04 "R档Vhms平均值缓冲比例" VALUE 0x785010 ECTEK_Value_u16 0 NO_FORMULA 1.0 500.0 FORMAT "%.2" BIT_MASK 0xFFFF /end CHARACTERISTIC
/begin CHARACTERISTIC D_Vhms_Average_Ratio_M04 "D档Vhms平均值缓冲比例" VALUE 0x785012 ECTEK_Value_u16 0 NO_FORMULA 1.0 500.0 FORMAT "%.2" BIT_MASK 0xFFFF /end CHARACTERISTIC
/begin CHARACTERISTIC Motor_Speed_Torque_M04 "转速_最大转矩 大地和 30KW 150N   95" CURVE 0x785014 ECTEK_Curve_u16s16 0 NO_FORMULA -5000.0 5000.0 FORMAT "%.2" BIT_MASK 0xFFFF
 /begin AXIS_DESCR STD_AXIS NO_INPUT_QUANTITY rpm1-1 29 -15000.0 15000.0 DEPOSIT ABSOLUTE FORMAT "%.2" /end AXIS_DESCR
/end CHARACTERISTIC
/begin CHARACTERISTIC AccPed_Rip_M04 "油门曲线" CURVE 0x78508A ECTEK_Curve_u16u16 0 rFactor100_PWM -0.0 100.0 FORMAT "%.2" BIT_MASK 0xFFFF
 /begin AXIS_DESCR STD_AXIS NO_INPUT_QUANTITY rFactor100_PWM 11 -0.0 100.0 DEPOSIT ABSOLUTE FORMAT "%.2" /end AXIS_DESCR
/end CHARACTERISTIC
/begin CHARACTERISTIC Speed_Vmh10ms_Crawl_D_M04 "D档蠕动 转速-AD曲线 rpm----mh10ms" CURVE 0x7850B8 ECTEK_Curve_s16s16 0 Vmh10ms -500.0 500.0 FORMAT "%.2" BIT_MASK 0xFFFF
 /begin AXIS_DESCR STD_AXIS NO_INPUT_QUANTITY rpm1-1 10 -15000.0 15000.0 DEPOSIT ABSOLUTE FORMAT "%.2" /end AXIS_DESCR
/end CHARACTERISTIC
/begin CHARACTERISTIC Torque_Increment_Crawl_D_M04 "D档蠕动 AD修正转矩给定每周期增量" CURVE 0x7850E2 ECTEK_Curve_s16s16 0 NO_FORMULA -100.0 100.0 FORMAT "%.2" BIT_MASK 0xFFFF
 /begin AXIS_DESCR STD_AXIS NO_INPUT_QUANTITY Vmh10ms 11 -1000.0 1000.0 DEPOSIT ABSOLUTE FORMAT "%.2" /end AXIS_DESCR
/end CHARACTERISTIC
/begin CHARACTERISTIC Speed_Max_Torque_Crawl_D_M04 "D档蠕行模式最大力矩" CURVE 0x785110 ECTEK_Curve_u16s16 0 NO_FORMULA -5000.0 5000.0 FORMAT "%.2" BIT_MASK 0xFFFF
 /begin AXIS_DESCR STD_AXIS NO_INPUT_QUANTITY rpm1-1 9 -15000.0 15000.0 DEPOSIT ABSOLUTE FORMAT "%.2" /end AXIS_DESCR
/end CHARACTERISTIC
/begin CHARACTERISTIC Speed_Max_Torque_Crawl_D_Break_M04 "D档蠕行制动状态下最大驱动力矩" CURVE 0x785136 ECTEK_Curve_u16s16 0 NO_FORMULA -1000.0 1000.0 FORMAT "%.2" BIT_MASK 0xFFFF
 /begin AXIS_DESCR STD_AXIS NO_INPUT_QUANTITY rpm1-1 9 -15000.0 15000.0 DEPOSIT ABSOLUTE FORMAT "%.2" /end AXIS_DESCR
/end CHARACTERISTIC
/begin CHARACTERISTIC Speed_Vmh10ms_General_M04 "通用相对转速-AD曲线 rpm----mh10ms" CURVE 0x78515C ECTEK_Curve_s16s16 0 Vmh10ms -500.0 500.0 FORMAT "%.2" BIT_MASK 0xFFFF
 /begin AXIS_DESCR STD_AXIS NO_INPUT_QUANTITY rpm1-1 11 -30000.0 30000.0 DEPOSIT ABSOLUTE FORMAT "%.2" /end AXIS_DESCR
/end CHARACTERISTIC
/begin CHARACTERISTIC Torque_Increment_General_M04 "通用AD修正转矩给定每周期增量" CURVE 0x78518A ECTEK_Curve_s16s16 0 NO_FORMULA -100.0 100.0 FORMAT "%.2" BIT_MASK 0xFFFF
 /begin AXIS_DESCR STD_AXIS NO_INPUT_QUANTITY Vmh10ms 11 -1000.0 1000.0 DEPOSIT ABSOLUTE FORMAT "%.2" /end AXIS_DESCR
/end CHARACTERISTIC
/begin CHARACTERISTIC Speed_Vmh10ms_D_Park_M04 "D档驻坡 转速-AD曲线 rpm----mh10ms" CURVE 0x7851B8 ECTEK_Curve_s16s16 0 Vmh10ms -500.0 500.0 FORMAT "%.2" BIT_MASK 0xFFFF
 /begin AXIS_DESCR STD_AXIS NO_INPUT_QUANTITY rpm1-1 12 -15000.0 15000.0 DEPOSIT ABSOLUTE FORMAT "%.2" /end AXIS_DESCR
/end CHARACTERISTIC
/begin CHARACTERISTIC Torque_Increment_D_Park_M04 "D档驻坡AD修正转矩给定每周期增量" CURVE 0x7851EA ECTEK_Curve_s16s16 0 NO_FORMULA -100.0 100.0 FORMAT "%.2" BIT_MASK 0xFFFF
 /begin AXIS_DESCR STD_AXIS NO_INPUT_QUANTITY Vmh10ms 11 -1000.0 1000.0 DEPOSIT ABSOLUTE FORMAT "%.2" /end AXIS_DESCR
/end CHARACTERISTIC
/begin CHARACTERISTIC Motor_Speed_Torque_Break_M04 "电机最大制动力矩" CURVE 0x785218 ECTEK_Curve_s16s16 0 NO_FORMULA -5000.0 5000.0 FORMAT "%.2" BIT_MASK 0xFFFF
 /begin AXIS_DESCR STD_AXIS NO_INPUT_QUANTITY rpm1-1 14 -15000.0 15000.0 DEPOSIT ABSOLUTE FORMAT "%.2" /end AXIS_DESCR
/end CHARACTERISTIC
/begin CHARACTERISTIC FeedBack_Coast_D_Torque_M04 "D档滑行回馈 速度-力矩  定点" CURVE 0x785252 ECTEK_Curve_s16s16 0 NO_FORMULA -5000.0 5000.0 FORMAT "%.2" BIT_MASK 0xFFFF
 /begin AXIS_DESCR STD_AXIS NO_INPUT_QUANTITY rpm1-1 8 -15000.0 15000.0 DEPOSIT ABSOLUTE FORMAT "%.2" /end AXIS_DESCR
/end CHARACTERISTIC
/begin CHARACTERISTIC FeedBack_Break_D_Torque_M04 "D档制动回馈 速度-力矩 定点" CURVE 0x785274 ECTEK_Curve_s16s16 0 NO_FORMULA -5000.0 5000.0 FORMAT "%.2" BIT_MASK 0xFFFF
 /begin AXIS_DESCR STD_AXIS NO_INPUT_QUANTITY rpm1-1 8 -15000.0 15000.0 DEPOSIT ABSOLUTE FORMAT "%.2" /end AXIS_DESCR
/end CHARACTERISTIC
/begin CHARACTERISTIC Speed_Efficieny_M04 "电机速度-转换效率曲线 驱动" CURVE 0x785296 ECTEK_Curve_u16u16 0 rFactor100_PWM 0.0 100.0 FORMAT "%.2" BIT_MASK 0xFFFF
 /begin AXIS_DESCR STD_AXIS NO_INPUT_QUANTITY rpm1-1 14 0.0 15000.0 DEPOSIT ABSOLUTE FORMAT "%.2" /end AXIS_DESCR
/end CHARACTERISTIC
/begin CHARACTERISTIC Speed_Efficieny_FeedBack_M04 "电机速度-转换效率曲线 发电" CURVE 0x7852D0 ECTEK_Curve_u16u16 0 rFactor100_PWM 0.0 150.0 FORMAT "%.2" BIT_MASK 0xFFFF
 /begin AXIS_DESCR STD_AXIS NO_INPUT_QUANTITY rpm1-1 14 0.0 15000.0 DEPOSIT ABSOLUTE FORMAT "%.2" /end AXIS_DESCR
/end CHARACTERISTIC
/begin CHARACTERISTIC AutoPark_Motor_Speed_Torque_M04 "驻坡最大力矩" CURVE 0x78530A ECTEK_Curve_u16s16 0 NO_FORMULA 0.0 5000.0 FORMAT "%.2" BIT_MASK 0xFFFF
 /begin AXIS_DESCR STD_AXIS NO_INPUT_QUANTITY rpm1-1 8 -15000.0 15000.0 DEPOSIT ABSOLUTE FORMAT "%.2" /end AXIS_DESCR
/end CHARACTERISTIC
/begin CHARACTERISTIC AccPedCD_rUW_CUR_M04 "油门开度" CURVE 0x78532C ECTEK_Curve_u16u16 0 rFactor100_PWM 0.0 100.0 FORMAT "%.2" BIT_MASK 0xFFFF
 /begin AXIS_DESCR STD_AXIS NO_INPUT_QUANTITY u5V 7 0.0 5.0 DEPOSIT ABSOLUTE FORMAT "%.2" /end AXIS_DESCR
/end CHARACTERISTIC
/begin CHARACTERISTIC AccPedCD_rUW_CUR2_M04 "油门2开度" CURVE 0x78534A ECTEK_Curve_u16u16 0 rFactor100_PWM 0.0 100.0 FORMAT "%.2" BIT_MASK 0xFFFF
 /begin AXIS_DESCR STD_AXIS NO_INPUT_QUANTITY u5V 7 0.0 5.0 DEPOSIT ABSOLUTE FORMAT "%.2" /end AXIS_DESCR
/end CHARACTERISTIC
/begin CHARACTERISTIC Motor_Vehicle_Speed_Scale_M041 "转速-车速比例， 优优114.411   D11 36.632   D07  62.111  A9 95.064" VALUE 0x785368 ECTEK_Value_u8 0 NO_FORMULA 0.0 255.0 FORMAT "%.2" BIT_MASK 0xFF /end CHARACTERISTIC
/begin CHARACTERISTIC Demand_Limit_High_M041 "转速上线  *4" VALUE 0x785369 ECTEK_Value_u16 0 NO_FORMULA -0.0 4095.0 FORMAT "%.2" BIT_MASK 0xFFFF /end CHARACTERISTIC
/begin CHARACTERISTIC Demand_Limit_Low_M041 "速度下限" VALUE 0x78536B ECTEK_Value_u16 0 NO_FORMULA -0.0 4095.0 FORMAT "%.2" BIT_MASK 0xFFFF /end CHARACTERISTIC
/begin CHARACTERISTIC Crawl_D_Speed_Max_M041 "D蠕动最大速度  从其他状态进入蠕动的速度" VALUE 0x78536D ECTEK_Value_u16 0 rpm1-1 -0.0 1000.0 FORMAT "%.2" BIT_MASK 0xFFFF /end CHARACTERISTIC
/begin CHARACTERISTIC Crawl_D_Torque_Delay_Max_M041 "蠕动更新间隔  单位10ms" VALUE 0x78536F ECTEK_Value_u8 0 NO_FORMULA -0.0 255.0 FORMAT "%.2" BIT_MASK 0xFF /end CHARACTERISTIC
/begin CHARACTERISTIC Crawl_D_Torque_Delay_Start_Max_M041 "起步蠕动更新间隔  单位10ms" VALUE 0x785370 ECTEK_Value_u8 0 NO_COMPU_METHOD -4294967296.0 4294967296.0 FORMAT "%.2" BIT_MASK 0xFF /end CHARACTERISTIC
/begin CHARACTERISTIC Speed_Buffer_Number_M041 "10ms车辆速度采样缓冲次数" VALUE 0x785371 ECTEK_Value_u8 0 NO_FORMULA -0.0 69.0 FORMAT "%.2" BIT_MASK 0xFF /end CHARACTERISTIC
/begin CHARACTERISTIC Speed_Average_Number_M041 "10ms平均车速缓冲次数" VALUE 0x785372 ECTEK_Value_u8 0 NO_FORMULA -0.0 69.0 FORMAT "%.2" BIT_MASK 0xFF /end CHARACTERISTIC
/begin CHARACTERISTIC Torque_Buffer_Number_AutoPark_M041 "10ms平均转矩缓冲次数" VALUE 0x785373 ECTEK_Value_u8 0 NO_FORMULA -0.0 69.0 FORMAT "%.2" BIT_MASK 0xFF /end CHARACTERISTIC
/begin CHARACTERISTIC D_Park_Start_Speed_M041 "D驻坡触发转速" VALUE 0x785374 ECTEK_Value_u8 0 rpm1-1 -0.0 255.0 FORMAT "%.2" BIT_MASK 0xFF /end CHARACTERISTIC
/begin CHARACTERISTIC Auto_Park_Speed_Acc_Max_M041 "激活D驻坡最大退行转速累加" VALUE 0x785375 ECTEK_Value_s16 0 NO_FORMULA -32767.0 32768.0 FORMAT "%.2" BIT_MASK 0xFFFF /end CHARACTERISTIC
/begin CHARACTERISTIC Auto_Park_Speed_Times_Max_M041 "激活D驻坡最大退行增速时间 单位10ms" VALUE 0x785377 ECTEK_Value_u16 0 NO_FORMULA -0.0 65535.0 FORMAT "%.2" BIT_MASK 0xFFFF /end CHARACTERISTIC
/begin CHARACTERISTIC Auto_Torque_Min_M041 "自动转矩最小正值" VALUE 0x785379 ECTEK_Value_s16 0 NO_FORMULA 0.0 150.0 FORMAT "%.2" BIT_MASK 0xFFFF /end CHARACTERISTIC
/begin CHARACTERISTIC Auto_Torque_Max_M041 "自动转矩最大负值" VALUE 0x78537B ECTEK_Value_s16 0 NO_FORMULA -150.0 0.0 FORMAT "%.2" BIT_MASK 0xFFFF /end CHARACTERISTIC
/begin CHARACTERISTIC R_Vhms_Average_Ratio_M041 "R档Vhms平均值缓冲比例" VALUE 0x78537D ECTEK_Value_u16 0 NO_FORMULA 1.0 500.0 FORMAT "%.2" BIT_MASK 0xFFFF /end CHARACTERISTIC
/begin CHARACTERISTIC D_Vhms_Average_Ratio_M041 "D档Vhms平均值缓冲比例" VALUE 0x78537F ECTEK_Value_u16 0 NO_FORMULA 1.0 500.0 FORMAT "%.2" BIT_MASK 0xFFFF /end CHARACTERISTIC
/begin CHARACTERISTIC Motor_Speed_Torque_M041 "转速_最大转矩 大地和 30KW 150N   95" CURVE 0x785381 ECTEK_Curve_u16s16 0 NO_FORMULA -5000.0 5000.0 FORMAT "%.2" BIT_MASK 0xFFFF
 /begin AXIS_DESCR STD_AXIS NO_INPUT_QUANTITY rpm1-1 28 -15000.0 15000.0 DEPOSIT ABSOLUTE FORMAT "%.2" /end AXIS_DESCR
/end CHARACTERISTIC
/begin CHARACTERISTIC AccPed_Rip_M041 "油门曲线" CURVE 0x7853F3 ECTEK_Curve_u16u16 0 rFactor100_PWM -0.0 100.0 FORMAT "%.2" BIT_MASK 0xFFFF
 /begin AXIS_DESCR STD_AXIS NO_INPUT_QUANTITY rFactor100_PWM 11 -0.0 100.0 DEPOSIT ABSOLUTE FORMAT "%.2" /end AXIS_DESCR
/end CHARACTERISTIC
/begin CHARACTERISTIC Speed_Vmh10ms_Crawl_D_M041 "D档蠕动 转速-AD曲线 rpm----mh10ms" CURVE 0x785421 ECTEK_Curve_s16s16 0 Vmh10ms -500.0 500.0 FORMAT "%.2" BIT_MASK 0xFFFF
 /begin AXIS_DESCR STD_AXIS NO_INPUT_QUANTITY rpm1-1 10 -15000.0 15000.0 DEPOSIT ABSOLUTE FORMAT "%.2" /end AXIS_DESCR
/end CHARACTERISTIC
/begin CHARACTERISTIC Torque_Increment_Crawl_D_M041 "D档蠕动 AD修正转矩给定每周期增量" CURVE 0x78544B ECTEK_Curve_s16s16 0 NO_FORMULA -100.0 100.0 FORMAT "%.2" BIT_MASK 0xFFFF
 /begin AXIS_DESCR STD_AXIS NO_INPUT_QUANTITY Vmh10ms 11 -1000.0 1000.0 DEPOSIT ABSOLUTE FORMAT "%.2" /end AXIS_DESCR
/end CHARACTERISTIC
/begin CHARACTERISTIC Speed_Max_Torque_Crawl_D_M041 "D档蠕行模式最大力矩" CURVE 0x785479 ECTEK_Curve_u16s16 0 NO_FORMULA -5000.0 5000.0 FORMAT "%.2" BIT_MASK 0xFFFF
 /begin AXIS_DESCR STD_AXIS NO_INPUT_QUANTITY rpm1-1 9 -15000.0 15000.0 DEPOSIT ABSOLUTE FORMAT "%.2" /end AXIS_DESCR
/end CHARACTERISTIC
/begin CHARACTERISTIC Speed_Max_Torque_Crawl_D_Break_M041 "D档蠕行制动状态下最大驱动力矩" CURVE 0x78549F ECTEK_Curve_u16s16 0 NO_FORMULA -1000.0 1000.0 FORMAT "%.2" BIT_MASK 0xFFFF
 /begin AXIS_DESCR STD_AXIS NO_INPUT_QUANTITY rpm1-1 9 -15000.0 15000.0 DEPOSIT ABSOLUTE FORMAT "%.2" /end AXIS_DESCR
/end CHARACTERISTIC
/begin CHARACTERISTIC Speed_Vmh10ms_General_M041 "通用相对转速-AD曲线 rpm----mh10ms" CURVE 0x7854C5 ECTEK_Curve_s16s16 0 Vmh10ms -500.0 500.0 FORMAT "%.2" BIT_MASK 0xFFFF
 /begin AXIS_DESCR STD_AXIS NO_INPUT_QUANTITY rpm1-1 11 -30000.0 30000.0 DEPOSIT ABSOLUTE FORMAT "%.2" /end AXIS_DESCR
/end CHARACTERISTIC
/begin CHARACTERISTIC Torque_Increment_General_M041 "通用AD修正转矩给定每周期增量" CURVE 0x7854F3 ECTEK_Curve_s16s16 0 NO_FORMULA -100.0 100.0 FORMAT "%.2" BIT_MASK 0xFFFF
 /begin AXIS_DESCR STD_AXIS NO_INPUT_QUANTITY Vmh10ms 11 -1000.0 1000.0 DEPOSIT ABSOLUTE FORMAT "%.2" /end AXIS_DESCR
/end CHARACTERISTIC
/begin CHARACTERISTIC Speed_Vmh10ms_D_Park_M041 "D档驻坡 转速-AD曲线 rpm----mh10ms" CURVE 0x785521 ECTEK_Curve_s16s16 0 Vmh10ms -500.0 500.0 FORMAT "%.2" BIT_MASK 0xFFFF
 /begin AXIS_DESCR STD_AXIS NO_INPUT_QUANTITY rpm1-1 12 -15000.0 15000.0 DEPOSIT ABSOLUTE FORMAT "%.2" /end AXIS_DESCR
/end CHARACTERISTIC
/begin CHARACTERISTIC Torque_Increment_D_Park_M041 "D档驻坡AD修正转矩给定每周期增量" CURVE 0x785553 ECTEK_Curve_s16s16 0 NO_FORMULA -100.0 100.0 FORMAT "%.2" BIT_MASK 0xFFFF
 /begin AXIS_DESCR STD_AXIS NO_INPUT_QUANTITY Vmh10ms 11 -1000.0 1000.0 DEPOSIT ABSOLUTE FORMAT "%.2" /end AXIS_DESCR
/end CHARACTERISTIC
/begin CHARACTERISTIC Motor_Speed_Torque_Break_M041 "电机最大制动力矩" CURVE 0x785581 ECTEK_Curve_s16s16 0 NO_FORMULA -5000.0 5000.0 FORMAT "%.2" BIT_MASK 0xFFFF
 /begin AXIS_DESCR STD_AXIS NO_INPUT_QUANTITY rpm1-1 14 -15000.0 15000.0 DEPOSIT ABSOLUTE FORMAT "%.2" /end AXIS_DESCR
/end CHARACTERISTIC
/begin CHARACTERISTIC FeedBack_Coast_D_Torque_M041 "D档滑行回馈 速度-力矩  定点" CURVE 0x7855BB ECTEK_Curve_s16s16 0 NO_FORMULA -5000.0 5000.0 FORMAT "%.2" BIT_MASK 0xFFFF
 /begin AXIS_DESCR STD_AXIS NO_INPUT_QUANTITY rpm1-1 8 -15000.0 15000.0 DEPOSIT ABSOLUTE FORMAT "%.2" /end AXIS_DESCR
/end CHARACTERISTIC
/begin CHARACTERISTIC FeedBack_Break_D_Torque_M041 "D档制动回馈 速度-力矩 定点" CURVE 0x7855DD ECTEK_Curve_s16s16 0 NO_FORMULA -5000.0 5000.0 FORMAT "%.2" BIT_MASK 0xFFFF
 /begin AXIS_DESCR STD_AXIS NO_INPUT_QUANTITY rpm1-1 8 -15000.0 15000.0 DEPOSIT ABSOLUTE FORMAT "%.2" /end AXIS_DESCR
/end CHARACTERISTIC
/begin CHARACTERISTIC Speed_Efficieny_M041 "电机速度-转换效率曲线 驱动" CURVE 0x7855FF ECTEK_Curve_u16u16 0 rFactor100_PWM 0.0 100.0 FORMAT "%.2" BIT_MASK 0xFFFF
 /begin AXIS_DESCR STD_AXIS NO_INPUT_QUANTITY rpm1-1 20 0.0 15000.0 DEPOSIT ABSOLUTE FORMAT "%.2" /end AXIS_DESCR
/end CHARACTERISTIC
/begin CHARACTERISTIC Speed_Efficieny_FeedBack_M041 "电机速度-转换效率曲线 发电" CURVE 0x785651 ECTEK_Curve_u16u16 0 rFactor100_PWM 0.0 150.0 FORMAT "%.2" BIT_MASK 0xFFFF
 /begin AXIS_DESCR STD_AXIS NO_INPUT_QUANTITY rpm1-1 20 0.0 15000.0 DEPOSIT ABSOLUTE FORMAT "%.2" /end AXIS_DESCR
/end CHARACTERISTIC
/begin CHARACTERISTIC AutoPark_Motor_Speed_Torque_M041 "驻坡最大力矩" CURVE 0x7856A3 ECTEK_Curve_u16s16 0 NO_FORMULA 0.0 5000.0 FORMAT "%.2" BIT_MASK 0xFFFF
 /begin AXIS_DESCR STD_AXIS NO_INPUT_QUANTITY rpm1-1 8 -15000.0 15000.0 DEPOSIT ABSOLUTE FORMAT "%.2" /end AXIS_DESCR
/end CHARACTERISTIC
/begin CHARACTERISTIC AccPedCD_rUW_CUR_M041 "油门开度" CURVE 0x7856C5 ECTEK_Curve_u16u16 0 rFactor100_PWM 0.0 100.0 FORMAT "%.2" BIT_MASK 0xFFFF
 /begin AXIS_DESCR STD_AXIS NO_INPUT_QUANTITY u5V 7 0.0 5.0 DEPOSIT ABSOLUTE FORMAT "%.2" /end AXIS_DESCR
/end CHARACTERISTIC
/begin CHARACTERISTIC AccPedCD_rUW_CUR2_M041 "油门2开度" CURVE 0x7856E3 ECTEK_Curve_u16u16 0 rFactor100_PWM 0.0 100.0 FORMAT "%.2" BIT_MASK 0xFFFF
 /begin AXIS_DESCR STD_AXIS NO_INPUT_QUANTITY u5V 7 0.0 5.0 DEPOSIT ABSOLUTE FORMAT "%.2" /end AXIS_DESCR
/end CHARACTERISTIC
/begin CHARACTERISTIC Motor_Vehicle_Speed_Scale_M06 "转速-车速比例， D09 车速与转速比 1：44.83" VALUE 0x785701 ECTEK_Value_u8 0 NO_COMPU_METHOD 0.0 255.0 FORMAT "%.2" BIT_MASK 0xFF /end CHARACTERISTIC
/begin CHARACTERISTIC Demand_Limit_High_M06 "速度上限" VALUE 0x785702 ECTEK_Value_u16 0 NO_COMPU_METHOD 0.0 4095.0 FORMAT "%.2" BIT_MASK 0xFFFF /end CHARACTERISTIC
/begin CHARACTERISTIC Demand_Limit_Low_M06 "速度下限" VALUE 0x785704 ECTEK_Value_u16 0 NO_COMPU_METHOD 0.0 4095.0 FORMAT "%.2" BIT_MASK 0xFFFF /end CHARACTERISTIC
/begin CHARACTERISTIC Crawl_D_Speed_Max_M06 "D蠕动最大速度  从其他状态进入蠕动的速度" VALUE 0x785706 ECTEK_Value_u16 0 NO_COMPU_METHOD 0.0 1000.0 FORMAT "%.2" BIT_MASK 0xFFFF /end CHARACTERISTIC
/begin CHARACTERISTIC Crawl_D_Torque_Delay_Max_M06 "蠕动更新间隔  单位10ms" VALUE 0x785708 ECTEK_Value_u8 0 NO_COMPU_METHOD 1.0 255.0 FORMAT "%.2" BIT_MASK 0xFF /end CHARACTERISTIC
/begin CHARACTERISTIC Crawl_D_Torque_Delay_Start_Max_M06 "起步蠕动更新间隔  单位10ms" VALUE 0x785709 ECTEK_Value_u8 0 NO_FORMULA 0.0 255.0 FORMAT "%.2" BIT_MASK 0xFF /end CHARACTERISTIC
/begin CHARACTERISTIC Speed_Buffer_Number_M06 "10ms车辆速度采样缓冲次数" VALUE 0x78570A ECTEK_Value_u8 0 NO_COMPU_METHOD 1.0 69.0 FORMAT "%.2" BIT_MASK 0xFF /end CHARACTERISTIC
/begin CHARACTERISTIC Speed_Average_Number_M06 "10ms平均车速缓冲次数" VALUE 0x78570B ECTEK_Value_u8 0 NO_COMPU_METHOD 1.0 69.0 FORMAT "%.2" BIT_MASK 0xFF /end CHARACTERISTIC
/begin CHARACTERISTIC Torque_Buffer_Number_AutoPark_M06 "10ms车辆平均转矩采样缓冲次数 驻坡" VALUE 0x78570C ECTEK_Value_u8 0 NO_COMPU_METHOD 1.0 69.0 FORMAT "%.2" BIT_MASK 0xFF /end CHARACTERISTIC
/begin CHARACTERISTIC D_Park_Start_Speed_M06 "D驻坡触发转速" VALUE 0x78570D ECTEK_Value_u8 0 NO_COMPU_METHOD 0.0 255.0 FORMAT "%.2" BIT_MASK 0xFF /end CHARACTERISTIC
/begin CHARACTERISTIC Auto_Park_Speed_Acc_Max_M06 "激活D驻坡最大退行转速累加" VALUE 0x78570E ECTEK_Value_s16 0 NO_FORMULA -32768.0 32767.0 FORMAT "%.2" BIT_MASK 0xFFFF /end CHARACTERISTIC
/begin CHARACTERISTIC Auto_Park_Speed_Times_Max_M06 "" VALUE 0x785710 ECTEK_Value_u16 0 NO_FORMULA 0.0 65535.0 FORMAT "%.2" BIT_MASK 0xFFFF /end CHARACTERISTIC
/begin CHARACTERISTIC Auto_Torque_Min_M06 "自动转矩最小正值" VALUE 0x785712 ECTEK_Value_s16 0 NO_COMPU_METHOD 0.0 300.0 FORMAT "%.2" BIT_MASK 0xFFFF /end CHARACTERISTIC
/begin CHARACTERISTIC Auto_Torque_Max_M06 "自动转矩最大负值" VALUE 0x785714 ECTEK_Value_s16 0 NO_FORMULA -300.0 0.0 FORMAT "%.2" BIT_MASK 0xFFFF /end CHARACTERISTIC
/begin CHARACTERISTIC R_Vhms_Average_Ratio_M06 "R档Vhms平均值缓冲比例" VALUE 0x785716 ECTEK_Value_u16 0 NO_FORMULA 1.0 500.0 FORMAT "%.2" BIT_MASK 0xFFFF /end CHARACTERISTIC
/begin CHARACTERISTIC D_Vhms_Average_Ratio_M06 "D档Vhms平均值缓冲比例" VALUE 0x785718 ECTEK_Value_u16 0 NO_FORMULA 1.0 500.0 FORMAT "%.2" BIT_MASK 0xFFFF /end CHARACTERISTIC
/begin CHARACTERISTIC Motor_Speed_Torque_M06 "转速_最大转矩_旭利、230(500)Nm、50(90)KW、2100(6000)rpm 、比例44.83" CURVE 0x78571A ECTEK_Curve_u16s16 0 NO_FORMULA 0.0 5000.0 FORMAT "%.2" BIT_MASK 0xFFFF
 /begin AXIS_DESCR STD_AXIS NO_INPUT_QUANTITY rpm1-1 19 -15000.0 15000.0 DEPOSIT ABSOLUTE FORMAT "%.2" /end AXIS_DESCR
/end CHARACTERISTIC
/begin CHARACTERISTIC Speed_Vmh10ms_Crawl_D_M06 "D档蠕动 转速-AD曲线 rpm----mh10ms" CURVE 0x785768 ECTEK_Curve_s16s16 0 Vmh10ms -500.0 500.0 FORMAT "%.2" BIT_MASK 0xFFFF
 /begin AXIS_DESCR STD_AXIS NO_INPUT_QUANTITY rpm1-1 10 -15000.0 15000.0 DEPOSIT ABSOLUTE FORMAT "%.2" /end AXIS_DESCR
/end CHARACTERISTIC
/begin CHARACTERISTIC Torque_Increment_Crawl_D_M06 "D档蠕动 AD修正转矩给定每周期增量" CURVE 0x785792 ECTEK_Curve_s16s16 0 NO_FORMULA -100.0 100.0 FORMAT "%.2" BIT_MASK 0xFFFF
 /begin AXIS_DESCR STD_AXIS NO_INPUT_QUANTITY Vmh10ms 11 -1000.0 1000.0 DEPOSIT ABSOLUTE FORMAT "%.2" /end AXIS_DESCR
/end CHARACTERISTIC
/begin CHARACTERISTIC Speed_Max_Torque_Crawl_D_M06 "D档蠕行模式最大力矩" CURVE 0x7857C0 ECTEK_Curve_u16s16 0 NO_FORMULA 0.0 5000.0 FORMAT "%.2" BIT_MASK 0xFFFF
 /begin AXIS_DESCR STD_AXIS NO_INPUT_QUANTITY rpm1-1 9 -15000.0 15000.0 DEPOSIT ABSOLUTE FORMAT "%.2" /end AXIS_DESCR
/end CHARACTERISTIC
/begin CHARACTERISTIC Speed_Max_Torque_Crawl_D_Break_M06 "D档蠕行制动状态下最大驱动力矩" CURVE 0x7857E6 ECTEK_Curve_u16s16 0 NO_FORMULA 0.0 5000.0 FORMAT "%.2" BIT_MASK 0xFFFF
 /begin AXIS_DESCR STD_AXIS NO_INPUT_QUANTITY rpm1-1 9 -15000.0 15000.0 DEPOSIT ABSOLUTE FORMAT "%.2" /end AXIS_DESCR
/end CHARACTERISTIC
/begin CHARACTERISTIC Speed_Vmh10ms_General_M06 "通用相对转速-AD曲线 rpm----mh10ms" CURVE 0x78580C ECTEK_Curve_s16s16 0 Vmh10ms -1000.0 1000.0 FORMAT "%.2" BIT_MASK 0xFFFF
 /begin AXIS_DESCR STD_AXIS NO_INPUT_QUANTITY rpm1-1 11 -30000.0 30000.0 DEPOSIT ABSOLUTE FORMAT "%.2" /end AXIS_DESCR
/end CHARACTERISTIC
/begin CHARACTERISTIC Torque_Increment_General_M06 "通用AD修正转矩给定每周期增量" CURVE 0x78583A ECTEK_Curve_s16s16 0 NO_FORMULA -100.0 100.0 FORMAT "%.2" BIT_MASK 0xFFFF
 /begin AXIS_DESCR STD_AXIS NO_INPUT_QUANTITY Vmh10ms 11 -1000.0 1000.0 DEPOSIT ABSOLUTE FORMAT "%.2" /end AXIS_DESCR
/end CHARACTERISTIC
/begin CHARACTERISTIC Speed_Vmh10ms_D_Park_M06 "D档驻坡 转速-AD曲线 rpm----mh10ms" CURVE 0x785868 ECTEK_Curve_s16s16 0 Vmh10ms -1000.0 1000.0 FORMAT "%.2" BIT_MASK 0xFFFF
 /begin AXIS_DESCR STD_AXIS NO_INPUT_QUANTITY rpm1-1 12 -15000.0 15000.0 DEPOSIT ABSOLUTE FORMAT "%.2" /end AXIS_DESCR
/end CHARACTERISTIC
/begin CHARACTERISTIC Torque_Increment_D_Park_M06 "D档驻坡AD修正转矩给定每周期增量" CURVE 0x78589A ECTEK_Curve_s16s16 0 NO_FORMULA -100.0 100.0 FORMAT "%.2" BIT_MASK 0xFFFF
 /begin AXIS_DESCR STD_AXIS NO_INPUT_QUANTITY Vmh10ms 11 -1000.0 1000.0 DEPOSIT ABSOLUTE FORMAT "%.2" /end AXIS_DESCR
/end CHARACTERISTIC
/begin CHARACTERISTIC Motor_Speed_Torque_Break_M06 "电机最大制动力矩" CURVE 0x7858C8 ECTEK_Curve_s16s16 0 NO_FORMULA 0.0 1000.0 FORMAT "%.2" BIT_MASK 0xFFFF
 /begin AXIS_DESCR STD_AXIS NO_INPUT_QUANTITY rpm1-1 14 -15000.0 15000.0 DEPOSIT ABSOLUTE FORMAT "%.2" /end AXIS_DESCR
/end CHARACTERISTIC
/begin CHARACTERISTIC FeedBack_Coast_D_Torque_M06 "D档滑行回馈 速度-力矩  定点" CURVE 0x785902 ECTEK_Curve_s16s16 0 NO_FORMULA -1000.0 1000.0 FORMAT "%.2" BIT_MASK 0xFFFF
 /begin AXIS_DESCR STD_AXIS NO_INPUT_QUANTITY rpm1-1 8 -15000.0 15000.0 DEPOSIT ABSOLUTE FORMAT "%.2" /end AXIS_DESCR
/end CHARACTERISTIC
/begin CHARACTERISTIC FeedBack_Break_D_Torque_M06 "D档制动回馈 速度-力矩 定点" CURVE 0x785924 ECTEK_Curve_s16s16 0 NO_FORMULA -1000.0 1000.0 FORMAT "%.2" BIT_MASK 0xFFFF
 /begin AXIS_DESCR STD_AXIS NO_INPUT_QUANTITY rpm1-1 8 -15000.0 15000.0 DEPOSIT ABSOLUTE FORMAT "%.2" /end AXIS_DESCR
/end CHARACTERISTIC
/begin CHARACTERISTIC Speed_Efficieny_M06 "电机速度-转换效率曲线" CURVE 0x785946 ECTEK_Curve_u16u16 0 rFactor100_PWM 0.0 100.0 FORMAT "%.2" BIT_MASK 0xFFFF
 /begin AXIS_DESCR STD_AXIS NO_INPUT_QUANTITY rpm1-1 17 0.0 15000.0 DEPOSIT ABSOLUTE FORMAT "%.2" /end AXIS_DESCR
/end CHARACTERISTIC
/begin CHARACTERISTIC Speed_Efficieny_FeedBack_M06 "电机速度-转换效率曲线 发电" CURVE 0x78598C ECTEK_Curve_u16u16 0 rFactor100_PWM 0.0 100.0 FORMAT "%.2" BIT_MASK 0xFFFF
 /begin AXIS_DESCR STD_AXIS NO_INPUT_QUANTITY rpm1-1 17 0.0 15000.0 DEPOSIT ABSOLUTE FORMAT "%.2" /end AXIS_DESCR
/end CHARACTERISTIC
/begin CHARACTERISTIC AutoPark_Motor_Speed_Torque_M06 "驻坡最大力矩" CURVE 0x7859D2 ECTEK_Curve_u16s16 0 NO_FORMULA 0.0 5000.0 FORMAT "%.2" BIT_MASK 0xFFFF
 /begin AXIS_DESCR STD_AXIS NO_INPUT_QUANTITY rpm1-1 9 -15000.0 15000.0 DEPOSIT ABSOLUTE FORMAT "%.2" /end AXIS_DESCR
/end CHARACTERISTIC
/begin CHARACTERISTIC AccPedCD_rUW_CUR_M06 "油门开度" CURVE 0x7859F8 ECTEK_Curve_u16u16 0 rFactor100_PWM 0.0 100.0 FORMAT "%.2" BIT_MASK 0xFFFF
 /begin AXIS_DESCR STD_AXIS NO_INPUT_QUANTITY u5V 7 0.0 5.0 DEPOSIT ABSOLUTE FORMAT "%.2" /end AXIS_DESCR
/end CHARACTERISTIC
/begin CHARACTERISTIC AccPedCD_rUW_CUR2_M06 "油门2开度" CURVE 0x785A16 ECTEK_Curve_u16u16 0 rFactor100_PWM 0.0 100.0 FORMAT "%.2" BIT_MASK 0xFFFF
 /begin AXIS_DESCR STD_AXIS NO_INPUT_QUANTITY u5V 7 0.0 5.0 DEPOSIT ABSOLUTE FORMAT "%.2" /end AXIS_DESCR
/end CHARACTERISTIC
/begin CHARACTERISTIC Motor_Vehicle_Speed_Scale_M061 "转速-车速比例， D09 车速与转速比 1：44.83" VALUE 0x785A34 ECTEK_Value_u8 0 NO_COMPU_METHOD 0.0 255.0 FORMAT "%.2" BIT_MASK 0xFF /end CHARACTERISTIC
/begin CHARACTERISTIC Demand_Limit_High_M061 "速度上限" VALUE 0x785A35 ECTEK_Value_u16 0 NO_COMPU_METHOD 0.0 4095.0 FORMAT "%.2" BIT_MASK 0xFFFF /end CHARACTERISTIC
/begin CHARACTERISTIC Demand_Limit_Low_M061 "速度下限" VALUE 0x785A37 ECTEK_Value_u16 0 NO_COMPU_METHOD 0.0 4095.0 FORMAT "%.2" BIT_MASK 0xFFFF /end CHARACTERISTIC
/begin CHARACTERISTIC Crawl_D_Speed_Max_M061 "D蠕动最大速度  从其他状态进入蠕动的速度" VALUE 0x785A39 ECTEK_Value_u16 0 NO_COMPU_METHOD 0.0 1000.0 FORMAT "%.2" BIT_MASK 0xFFFF /end CHARACTERISTIC
/begin CHARACTERISTIC Crawl_D_Torque_Delay_Max_M061 "蠕动更新间隔  单位10ms" VALUE 0x785A3B ECTEK_Value_u8 0 NO_COMPU_METHOD 1.0 255.0 FORMAT "%.2" BIT_MASK 0xFF /end CHARACTERISTIC
/begin CHARACTERISTIC Crawl_D_Torque_Delay_Start_Max_M061 "起步蠕动更新间隔  单位10ms" VALUE 0x785A3C ECTEK_Value_u8 0 NO_FORMULA 0.0 255.0 FORMAT "%.2" BIT_MASK 0xFF /end CHARACTERISTIC
/begin CHARACTERISTIC Speed_Buffer_Number_M061 "10ms车辆速度采样缓冲次数" VALUE 0x785A3D ECTEK_Value_u8 0 NO_COMPU_METHOD 1.0 69.0 FORMAT "%.2" BIT_MASK 0xFF /end CHARACTERISTIC
/begin CHARACTERISTIC Speed_Average_Number_M061 "10ms平均车速缓冲次数" VALUE 0x785A3E ECTEK_Value_u8 0 NO_COMPU_METHOD 1.0 69.0 FORMAT "%.2" BIT_MASK 0xFF /end CHARACTERISTIC
/begin CHARACTERISTIC Torque_Buffer_Number_AutoPark_M061 "10ms车辆平均转矩采样缓冲次数 驻坡" VALUE 0x785A3F ECTEK_Value_u8 0 NO_COMPU_METHOD 1.0 69.0 FORMAT "%.2" BIT_MASK 0xFF /end CHARACTERISTIC
/begin CHARACTERISTIC D_Park_Start_Speed_M061 "D驻坡触发转速" VALUE 0x785A40 ECTEK_Value_u8 0 NO_COMPU_METHOD 0.0 255.0 FORMAT "%.2" BIT_MASK 0xFF /end CHARACTERISTIC
/begin CHARACTERISTIC Auto_Park_Speed_Acc_Max_M061 "激活D驻坡最大退行转速累加" VALUE 0x785A41 ECTEK_Value_s16 0 NO_FORMULA -32768.0 32767.0 FORMAT "%.2" BIT_MASK 0xFFFF /end CHARACTERISTIC
/begin CHARACTERISTIC Auto_Park_Speed_Times_Max_M061 "" VALUE 0x785A43 ECTEK_Value_u16 0 NO_FORMULA 0.0 65535.0 FORMAT "%.2" BIT_MASK 0xFFFF /end CHARACTERISTIC
/begin CHARACTERISTIC Auto_Torque_Min_M061 "自动转矩最小正值" VALUE 0x785A45 ECTEK_Value_s16 0 NO_COMPU_METHOD 0.0 300.0 FORMAT "%.2" BIT_MASK 0xFFFF /end CHARACTERISTIC
/begin CHARACTERISTIC Auto_Torque_Max_M061 "自动转矩最大负值" VALUE 0x785A47 ECTEK_Value_s16 0 NO_FORMULA -300.0 0.0 FORMAT "%.2" BIT_MASK 0xFFFF /end CHARACTERISTIC
/begin CHARACTERISTIC R_Vhms_Average_Ratio_M061 "R档Vhms平均值缓冲比例" VALUE 0x785A49 ECTEK_Value_u16 0 NO_FORMULA 1.0 500.0 FORMAT "%.2" BIT_MASK 0xFFFF /end CHARACTERISTIC
/begin CHARACTERISTIC D_Vhms_Average_Ratio_M061 "D档Vhms平均值缓冲比例" VALUE 0x785A4B ECTEK_Value_u16 0 NO_FORMULA 1.0 500.0 FORMAT "%.2" BIT_MASK 0xFFFF /end CHARACTERISTIC
/begin CHARACTERISTIC Motor_Speed_Torque_M061 "转速_最大转矩_旭利、230(500)Nm、50(90)KW、2100(6000)rpm 、比例44.83" CURVE 0x785A4D ECTEK_Curve_u16s16 0 NO_FORMULA 0.0 5000.0 FORMAT "%.2" BIT_MASK 0xFFFF
 /begin AXIS_DESCR STD_AXIS NO_INPUT_QUANTITY rpm1-1 27 -15000.0 15000.0 DEPOSIT ABSOLUTE FORMAT "%.2" /end AXIS_DESCR
/end CHARACTERISTIC
/begin CHARACTERISTIC Speed_Vmh10ms_Crawl_D_M061 "D档蠕动 转速-AD曲线 rpm----mh10ms" CURVE 0x785ABB ECTEK_Curve_s16s16 0 Vmh10ms -500.0 500.0 FORMAT "%.2" BIT_MASK 0xFFFF
 /begin AXIS_DESCR STD_AXIS NO_INPUT_QUANTITY rpm1-1 10 -15000.0 15000.0 DEPOSIT ABSOLUTE FORMAT "%.2" /end AXIS_DESCR
/end CHARACTERISTIC
/begin CHARACTERISTIC Torque_Increment_Crawl_D_M061 "D档蠕动 AD修正转矩给定每周期增量" CURVE 0x785AE5 ECTEK_Curve_s16s16 0 NO_FORMULA -100.0 100.0 FORMAT "%.2" BIT_MASK 0xFFFF
 /begin AXIS_DESCR STD_AXIS NO_INPUT_QUANTITY Vmh10ms 11 -1000.0 1000.0 DEPOSIT ABSOLUTE FORMAT "%.2" /end AXIS_DESCR
/end CHARACTERISTIC
/begin CHARACTERISTIC Speed_Max_Torque_Crawl_D_M061 "D档蠕行模式最大力矩" CURVE 0x785B13 ECTEK_Curve_u16s16 0 NO_FORMULA 0.0 5000.0 FORMAT "%.2" BIT_MASK 0xFFFF
 /begin AXIS_DESCR STD_AXIS NO_INPUT_QUANTITY rpm1-1 9 -15000.0 15000.0 DEPOSIT ABSOLUTE FORMAT "%.2" /end AXIS_DESCR
/end CHARACTERISTIC
/begin CHARACTERISTIC Speed_Max_Torque_Crawl_D_Break_M061 "D档蠕行制动状态下最大驱动力矩" CURVE 0x785B39 ECTEK_Curve_u16s16 0 NO_FORMULA 0.0 5000.0 FORMAT "%.2" BIT_MASK 0xFFFF
 /begin AXIS_DESCR STD_AXIS NO_INPUT_QUANTITY rpm1-1 9 -15000.0 15000.0 DEPOSIT ABSOLUTE FORMAT "%.2" /end AXIS_DESCR
/end CHARACTERISTIC
/begin CHARACTERISTIC Speed_Vmh10ms_General_M061 "通用相对转速-AD曲线 rpm----mh10ms" CURVE 0x785B5F ECTEK_Curve_s16s16 0 Vmh10ms -1000.0 1000.0 FORMAT "%.2" BIT_MASK 0xFFFF
 /begin AXIS_DESCR STD_AXIS NO_INPUT_QUANTITY rpm1-1 11 -30000.0 30000.0 DEPOSIT ABSOLUTE FORMAT "%.2" /end AXIS_DESCR
/end CHARACTERISTIC
/begin CHARACTERISTIC Torque_Increment_General_M061 "通用AD修正转矩给定每周期增量" CURVE 0x785B8D ECTEK_Curve_s16s16 0 NO_FORMULA -100.0 100.0 FORMAT "%.2" BIT_MASK 0xFFFF
 /begin AXIS_DESCR STD_AXIS NO_INPUT_QUANTITY Vmh10ms 11 -1000.0 1000.0 DEPOSIT ABSOLUTE FORMAT "%.2" /end AXIS_DESCR
/end CHARACTERISTIC
/begin CHARACTERISTIC Speed_Vmh10ms_D_Park_M061 "D档驻坡 转速-AD曲线 rpm----mh10ms" CURVE 0x785BBB ECTEK_Curve_s16s16 0 Vmh10ms -1000.0 1000.0 FORMAT "%.2" BIT_MASK 0xFFFF
 /begin AXIS_DESCR STD_AXIS NO_INPUT_QUANTITY rpm1-1 12 -15000.0 15000.0 DEPOSIT ABSOLUTE FORMAT "%.2" /end AXIS_DESCR
/end CHARACTERISTIC
/begin CHARACTERISTIC Torque_Increment_D_Park_M061 "D档驻坡AD修正转矩给定每周期增量" CURVE 0x785BED ECTEK_Curve_s16s16 0 NO_FORMULA -100.0 100.0 FORMAT "%.2" BIT_MASK 0xFFFF
 /begin AXIS_DESCR STD_AXIS NO_INPUT_QUANTITY Vmh10ms 11 -1000.0 1000.0 DEPOSIT ABSOLUTE FORMAT "%.2" /end AXIS_DESCR
/end CHARACTERISTIC
/begin CHARACTERISTIC Motor_Speed_Torque_Break_M061 "电机最大制动力矩" CURVE 0x785C1B ECTEK_Curve_s16s16 0 NO_FORMULA 0.0 1000.0 FORMAT "%.2" BIT_MASK 0xFFFF
 /begin AXIS_DESCR STD_AXIS NO_INPUT_QUANTITY rpm1-1 14 -15000.0 15000.0 DEPOSIT ABSOLUTE FORMAT "%.2" /end AXIS_DESCR
/end CHARACTERISTIC
/begin CHARACTERISTIC FeedBack_Coast_D_Torque_M061 "D档滑行回馈 速度-力矩  定点" CURVE 0x785C55 ECTEK_Curve_s16s16 0 NO_FORMULA -1000.0 1000.0 FORMAT "%.2" BIT_MASK 0xFFFF
 /begin AXIS_DESCR STD_AXIS NO_INPUT_QUANTITY rpm1-1 8 -15000.0 15000.0 DEPOSIT ABSOLUTE FORMAT "%.2" /end AXIS_DESCR
/end CHARACTERISTIC
/begin CHARACTERISTIC FeedBack_Break_D_Torque_M061 "D档制动回馈 速度-力矩 定点" CURVE 0x785C77 ECTEK_Curve_s16s16 0 NO_FORMULA -1000.0 1000.0 FORMAT "%.2" BIT_MASK 0xFFFF
 /begin AXIS_DESCR STD_AXIS NO_INPUT_QUANTITY rpm1-1 8 -15000.0 15000.0 DEPOSIT ABSOLUTE FORMAT "%.2" /end AXIS_DESCR
/end CHARACTERISTIC
/begin CHARACTERISTIC Speed_Efficieny_M061 "电机速度-转换效率曲线" CURVE 0x785C99 ECTEK_Curve_u16u16 0 rFactor100_PWM 0.0 100.0 FORMAT "%.2" BIT_MASK 0xFFFF
 /begin AXIS_DESCR STD_AXIS NO_INPUT_QUANTITY rpm1-1 17 0.0 15000.0 DEPOSIT ABSOLUTE FORMAT "%.2" /end AXIS_DESCR
/end CHARACTERISTIC
/begin CHARACTERISTIC Speed_Efficieny_FeedBack_M061 "电机速度-转换效率曲线 发电" CURVE 0x785CDF ECTEK_Curve_u16u16 0 rFactor100_PWM 0.0 100.0 FORMAT "%.2" BIT_MASK 0xFFFF
 /begin AXIS_DESCR STD_AXIS NO_INPUT_QUANTITY rpm1-1 17 0.0 15000.0 DEPOSIT ABSOLUTE FORMAT "%.2" /end AXIS_DESCR
/end CHARACTERISTIC
/begin CHARACTERISTIC AutoPark_Motor_Speed_Torque_M061 "驻坡最大力矩" CURVE 0x785D25 ECTEK_Curve_u16s16 0 NO_FORMULA 0.0 5000.0 FORMAT "%.2" BIT_MASK 0xFFFF
 /begin AXIS_DESCR STD_AXIS NO_INPUT_QUANTITY rpm1-1 9 -15000.0 15000.0 DEPOSIT ABSOLUTE FORMAT "%.2" /end AXIS_DESCR
/end CHARACTERISTIC
/begin CHARACTERISTIC Speed_Efficieny_M062 "电机速度-转换效率曲线" CURVE 0x785D4B ECTEK_Curve_u16u16 0 rFactor100_PWM 0.0 100.0 FORMAT "%.2" BIT_MASK 0xFFFF
 /begin AXIS_DESCR STD_AXIS NO_INPUT_QUANTITY rpm1-1 28 0.0 15000.0 DEPOSIT ABSOLUTE FORMAT "%.2" /end AXIS_DESCR
/end CHARACTERISTIC
/begin CHARACTERISTIC Speed_Efficieny_FeedBack_M062 "电机速度-转换效率曲线 发电" CURVE 0x785DBD ECTEK_Curve_u16u16 0 rFactor100_PWM 0.0 100.0 FORMAT "%.2" BIT_MASK 0xFFFF
 /begin AXIS_DESCR STD_AXIS NO_INPUT_QUANTITY rpm1-1 28 0.0 15000.0 DEPOSIT ABSOLUTE FORMAT "%.2" /end AXIS_DESCR
/end CHARACTERISTIC
/begin CHARACTERISTIC Motor_Vehicle_Speed_Scale_M09 "转速-车速比例， 优优114.411   D11 36.632" VALUE 0x785E2F ECTEK_Value_u8 0 NO_COMPU_METHOD 0.0 255.0 FORMAT "%.2" BIT_MASK 0xFF /end CHARACTERISTIC
/begin CHARACTERISTIC Demand_Limit_High_M09 "速度上限" VALUE 0x785E30 ECTEK_Value_u16 0 NO_COMPU_METHOD 0.0 4095.0 FORMAT "%.2" BIT_MASK 0xFFFF /end CHARACTERISTIC
/begin CHARACTERISTIC Demand_Limit_Low_M09 "速度下限" VALUE 0x785E32 ECTEK_Value_u16 0 NO_COMPU_METHOD 0.0 4095.0 FORMAT "%.2" BIT_MASK 0xFFFF /end CHARACTERISTIC
/begin CHARACTERISTIC Crawl_D_Speed_Max_M09 "D蠕动最大速度  从其他状态进入蠕动的速度" VALUE 0x785E34 ECTEK_Value_u16 0 NO_COMPU_METHOD 0.0 1000.0 FORMAT "%.2" BIT_MASK 0xFFFF /end CHARACTERISTIC
/begin CHARACTERISTIC Crawl_D_Torque_Delay_Max_M09 "蠕动更新间隔  单位10ms" VALUE 0x785E36 ECTEK_Value_u8 0 NO_COMPU_METHOD 1.0 255.0 FORMAT "%.2" BIT_MASK 0xFF /end CHARACTERISTIC
/begin CHARACTERISTIC Crawl_D_Torque_Delay_Start_Max_M09 "起步蠕动更新间隔  单位10ms" VALUE 0x785E37 ECTEK_Value_u8 0 NO_FORMULA 0.0 255.0 FORMAT "%.2" BIT_MASK 0xFF /end CHARACTERISTIC
/begin CHARACTERISTIC Speed_Buffer_Number_M09 "10ms车辆速度采样缓冲次数" VALUE 0x785E38 ECTEK_Value_u8 0 NO_COMPU_METHOD 1.0 69.0 FORMAT "%.2" BIT_MASK 0xFF /end CHARACTERISTIC
/begin CHARACTERISTIC Speed_Average_Number_M09 "10ms平均车速缓冲次数" VALUE 0x785E39 ECTEK_Value_u8 0 NO_COMPU_METHOD 1.0 69.0 FORMAT "%.2" BIT_MASK 0xFF /end CHARACTERISTIC
/begin CHARACTERISTIC Torque_Buffer_Number_AutoPark_M09 "10ms车辆平均转矩采样缓冲次数 驻坡" VALUE 0x785E3A ECTEK_Value_u8 0 NO_COMPU_METHOD 1.0 69.0 FORMAT "%.2" BIT_MASK 0xFF /end CHARACTERISTIC
/begin CHARACTERISTIC D_Park_Start_Speed_M09 "D驻坡触发转速" VALUE 0x785E3B ECTEK_Value_u8 0 NO_COMPU_METHOD 0.0 255.0 FORMAT "%.2" BIT_MASK 0xFF /end CHARACTERISTIC
/begin CHARACTERISTIC Auto_Park_Speed_Acc_Max_M09 "激活D驻坡最大退行转速累加" VALUE 0x785E3C ECTEK_Value_s16 0 NO_FORMULA -32768.0 32767.0 FORMAT "%.2" BIT_MASK 0xFFFF /end CHARACTERISTIC
/begin CHARACTERISTIC Auto_Park_Speed_Times_Max_M09 "激活D驻坡最大退行增速时间 单位10ms" VALUE 0x785E3E ECTEK_Value_u16 0 NO_FORMULA 0.0 65535.0 FORMAT "%.2" BIT_MASK 0xFFFF /end CHARACTERISTIC
/begin CHARACTERISTIC Auto_Torque_Min_M09 "自动转矩最小正值" VALUE 0x785E40 ECTEK_Value_s16 0 NO_COMPU_METHOD 0.0 300.0 FORMAT "%.2" BIT_MASK 0xFFFF /end CHARACTERISTIC
/begin CHARACTERISTIC Auto_Torque_Max_M09 "自动转矩最大负值" VALUE 0x785E42 ECTEK_Value_s16 0 NO_FORMULA -300.0 0.0 FORMAT "%.2" BIT_MASK 0xFFFF /end CHARACTERISTIC
/begin CHARACTERISTIC R_Vhms_Average_Ratio_M09 "R档Vhms平均值缓冲比例" VALUE 0x785E44 ECTEK_Value_u16 0 NO_FORMULA 1.0 500.0 FORMAT "%.2" BIT_MASK 0xFFFF /end CHARACTERISTIC
/begin CHARACTERISTIC D_Vhms_Average_Ratio_M09 "D档Vhms平均值缓冲比例" VALUE 0x785E46 ECTEK_Value_u16 0 NO_FORMULA 1.0 500.0 FORMAT "%.2" BIT_MASK 0xFFFF /end CHARACTERISTIC
/begin CHARACTERISTIC Motor_Speed_Torque_M09 "转速_最大转矩_大地和350-700Nm 70-100KW  比例36.632" CURVE 0x785E48 ECTEK_Curve_u16s16 0 NO_FORMULA 0.0 5000.0 FORMAT "%.2" BIT_MASK 0xFFFF
 /begin AXIS_DESCR STD_AXIS NO_INPUT_QUANTITY rpm1-1 28 -15000.0 15000.0 DEPOSIT ABSOLUTE FORMAT "%.2" /end AXIS_DESCR
/end CHARACTERISTIC
/begin CHARACTERISTIC Speed_Vmh10ms_Crawl_D_M09 "D档蠕动 转速-AD曲线 rpm----mh10ms" CURVE 0x785EBA ECTEK_Curve_s16s16 0 Vmh10ms -500.0 500.0 FORMAT "%.2" BIT_MASK 0xFFFF
 /begin AXIS_DESCR STD_AXIS NO_INPUT_QUANTITY rpm1-1 10 -15000.0 15000.0 DEPOSIT ABSOLUTE FORMAT "%.2" /end AXIS_DESCR
/end CHARACTERISTIC
/begin CHARACTERISTIC Torque_Increment_Crawl_D_M09 "D档蠕动 AD修正转矩给定每周期增量" CURVE 0x785EE4 ECTEK_Curve_s16s16 0 NO_FORMULA -100.0 100.0 FORMAT "%.2" BIT_MASK 0xFFFF
 /begin AXIS_DESCR STD_AXIS NO_INPUT_QUANTITY Vmh10ms 11 -1000.0 1000.0 DEPOSIT ABSOLUTE FORMAT "%.2" /end AXIS_DESCR
/end CHARACTERISTIC
/begin CHARACTERISTIC Speed_Max_Torque_Crawl_D_M09 "D档蠕行模式最大力矩" CURVE 0x785F12 ECTEK_Curve_u16s16 0 NO_FORMULA 0.0 5000.0 FORMAT "%.2" BIT_MASK 0xFFFF
 /begin AXIS_DESCR STD_AXIS NO_INPUT_QUANTITY rpm1-1 9 -15000.0 15000.0 DEPOSIT ABSOLUTE FORMAT "%.2" /end AXIS_DESCR
/end CHARACTERISTIC
/begin CHARACTERISTIC Speed_Max_Torque_Crawl_D_Break_M09 "D档蠕行制动状态下最大驱动力矩" CURVE 0x785F38 ECTEK_Curve_u16s16 0 NO_FORMULA 0.0 5000.0 FORMAT "%.2" BIT_MASK 0xFFFF
 /begin AXIS_DESCR STD_AXIS NO_INPUT_QUANTITY rpm1-1 9 -15000.0 15000.0 DEPOSIT ABSOLUTE FORMAT "%.2" /end AXIS_DESCR
/end CHARACTERISTIC
/begin CHARACTERISTIC Speed_Vmh10ms_General_M09 "通用相对转速-AD曲线 rpm----mh10ms" CURVE 0x785F5E ECTEK_Curve_s16s16 0 Vmh10ms -1000.0 1000.0 FORMAT "%.2" BIT_MASK 0xFFFF
 /begin AXIS_DESCR STD_AXIS NO_INPUT_QUANTITY rpm1-1 11 -30000.0 30000.0 DEPOSIT ABSOLUTE FORMAT "%.2" /end AXIS_DESCR
/end CHARACTERISTIC
/begin CHARACTERISTIC Torque_Increment_General_M09 "通用AD修正转矩给定每周期增量" CURVE 0x785F8C ECTEK_Curve_s16s16 0 NO_FORMULA -100.0 100.0 FORMAT "%.2" BIT_MASK 0xFFFF
 /begin AXIS_DESCR STD_AXIS NO_INPUT_QUANTITY Vmh10ms 11 -1000.0 1000.0 DEPOSIT ABSOLUTE FORMAT "%.2" /end AXIS_DESCR
/end CHARACTERISTIC
/begin CHARACTERISTIC Speed_Vmh10ms_D_Park_M09 "D档驻坡 转速-AD曲线 rpm----mh10ms" CURVE 0x785FBA ECTEK_Curve_s16s16 0 Vmh10ms -1000.0 1000.0 FORMAT "%.2" BIT_MASK 0xFFFF
 /begin AXIS_DESCR STD_AXIS NO_INPUT_QUANTITY rpm1-1 12 -15000.0 15000.0 DEPOSIT ABSOLUTE FORMAT "%.2" /end AXIS_DESCR
/end CHARACTERISTIC
/begin CHARACTERISTIC Torque_Increment_D_Park_M09 "D档驻坡AD修正转矩给定每周期增量" CURVE 0x785FEC ECTEK_Curve_s16s16 0 NO_FORMULA -100.0 100.0 FORMAT "%.2" BIT_MASK 0xFFFF
 /begin AXIS_DESCR STD_AXIS NO_INPUT_QUANTITY Vmh10ms 11 -1000.0 1000.0 DEPOSIT ABSOLUTE FORMAT "%.2" /end AXIS_DESCR
/end CHARACTERISTIC
/begin CHARACTERISTIC Motor_Speed_Torque_Break_M09 "电机最大制动力矩" CURVE 0x78601A ECTEK_Curve_s16s16 0 NO_FORMULA 0.0 1000.0 FORMAT "%.2" BIT_MASK 0xFFFF
 /begin AXIS_DESCR STD_AXIS NO_INPUT_QUANTITY rpm1-1 14 -15000.0 15000.0 DEPOSIT ABSOLUTE FORMAT "%.2" /end AXIS_DESCR
/end CHARACTERISTIC
/begin CHARACTERISTIC FeedBack_Coast_D_Torque_M09 "D档滑行回馈 速度-力矩  定点" CURVE 0x786054 ECTEK_Curve_s16s16 0 NO_FORMULA -1000.0 1000.0 FORMAT "%.2" BIT_MASK 0xFFFF
 /begin AXIS_DESCR STD_AXIS NO_INPUT_QUANTITY rpm1-1 8 -15000.0 15000.0 DEPOSIT ABSOLUTE FORMAT "%.2" /end AXIS_DESCR
/end CHARACTERISTIC
/begin CHARACTERISTIC FeedBack_Break_D_Torque_M09 "D档制动回馈 速度-力矩 定点" CURVE 0x786076 ECTEK_Curve_s16s16 0 NO_FORMULA -1000.0 1000.0 FORMAT "%.2" BIT_MASK 0xFFFF
 /begin AXIS_DESCR STD_AXIS NO_INPUT_QUANTITY rpm1-1 8 -15000.0 15000.0 DEPOSIT ABSOLUTE FORMAT "%.2" /end AXIS_DESCR
/end CHARACTERISTIC
/begin CHARACTERISTIC Speed_Efficieny_M09 "电机速度-转换效率曲线" CURVE 0x786098 ECTEK_Curve_u16u16 0 rFactor100_PWM 0.0 100.0 FORMAT "%.2" BIT_MASK 0xFFFF
 /begin AXIS_DESCR STD_AXIS NO_INPUT_QUANTITY rpm1-1 17 0.0 15000.0 DEPOSIT ABSOLUTE FORMAT "%.2" /end AXIS_DESCR
/end CHARACTERISTIC
/begin CHARACTERISTIC AutoPark_Motor_Speed_Torque_M09 "驻坡最大力矩" CURVE 0x7860DE ECTEK_Curve_u16s16 0 NO_FORMULA 0.0 5000.0 FORMAT "%.2" BIT_MASK 0xFFFF
 /begin AXIS_DESCR STD_AXIS NO_INPUT_QUANTITY rpm1-1 9 -15000.0 15000.0 DEPOSIT ABSOLUTE FORMAT "%.2" /end AXIS_DESCR
/end CHARACTERISTIC
/begin CHARACTERISTIC Motor_Vehicle_Speed_Scale_M10 "转速-车速比例， D08  75.15" VALUE 0x786104 ECTEK_Value_u8 0 NO_FORMULA 0.0 255.0 FORMAT "%.2" BIT_MASK 0xFF /end CHARACTERISTIC
/begin CHARACTERISTIC Demand_Limit_High_M10 "转速上线  *4" VALUE 0x786105 ECTEK_Value_u16 0 NO_FORMULA -0.0 4095.0 FORMAT "%.2" BIT_MASK 0xFFFF /end CHARACTERISTIC
/begin CHARACTERISTIC Demand_Limit_Low_M10 "速度下限" VALUE 0x786107 ECTEK_Value_u16 0 NO_FORMULA -0.0 4095.0 FORMAT "%.2" BIT_MASK 0xFFFF /end CHARACTERISTIC
/begin CHARACTERISTIC Crawl_D_Speed_Max_M10 "D蠕动最大速度  从其他状态进入蠕动的速度" VALUE 0x786109 ECTEK_Value_u16 0 rpm1-1 -0.0 1000.0 FORMAT "%.2" BIT_MASK 0xFFFF /end CHARACTERISTIC
/begin CHARACTERISTIC Crawl_D_Torque_Delay_Max_M10 "蠕动更新间隔  单位10ms" VALUE 0x78610B ECTEK_Value_u8 0 NO_FORMULA -0.0 255.0 FORMAT "%.2" BIT_MASK 0xFF /end CHARACTERISTIC
/begin CHARACTERISTIC Crawl_D_Torque_Delay_Start_Max_M10 "起步蠕动更新间隔  单位10ms" VALUE 0x78610C ECTEK_Value_u8 0 NO_COMPU_METHOD -4294967296.0 4294967296.0 FORMAT "%.2" BIT_MASK 0xFF /end CHARACTERISTIC
/begin CHARACTERISTIC Speed_Buffer_Number_M10 "10ms车辆速度采样缓冲次数" VALUE 0x78610D ECTEK_Value_u8 0 NO_FORMULA -0.0 69.0 FORMAT "%.2" BIT_MASK 0xFF /end CHARACTERISTIC
/begin CHARACTERISTIC Speed_Average_Number_M10 "10ms平均车速缓冲次数" VALUE 0x78610E ECTEK_Value_u8 0 NO_FORMULA -0.0 69.0 FORMAT "%.2" BIT_MASK 0xFF /end CHARACTERISTIC
/begin CHARACTERISTIC Torque_Buffer_Number_AutoPark_M10 "10ms平均转矩缓冲次数" VALUE 0x78610F ECTEK_Value_u8 0 NO_FORMULA -0.0 69.0 FORMAT "%.2" BIT_MASK 0xFF /end CHARACTERISTIC
/begin CHARACTERISTIC D_Park_Start_Speed_M10 "D驻坡触发转速" VALUE 0x786110 ECTEK_Value_u8 0 rpm1-1 -0.0 255.0 FORMAT "%.2" BIT_MASK 0xFF /end CHARACTERISTIC
/begin CHARACTERISTIC Auto_Park_Speed_Acc_Max_M10 "激活D驻坡最大退行转速累加" VALUE 0x786111 ECTEK_Value_s16 0 NO_FORMULA -32767.0 32768.0 FORMAT "%.2" BIT_MASK 0xFFFF /end CHARACTERISTIC
/begin CHARACTERISTIC Auto_Park_Speed_Times_Max_M10 "激活D驻坡最大退行增速时间 单位10ms" VALUE 0x786113 ECTEK_Value_u16 0 NO_FORMULA -0.0 65535.0 FORMAT "%.2" BIT_MASK 0xFFFF /end CHARACTERISTIC
/begin CHARACTERISTIC Auto_Torque_Min_M10 "自动转矩最小正值" VALUE 0x786115 ECTEK_Value_s16 0 NO_FORMULA 0.0 150.0 FORMAT "%.2" BIT_MASK 0xFFFF /end CHARACTERISTIC
/begin CHARACTERISTIC Auto_Torque_Max_M10 "自动转矩最大负值" VALUE 0x786117 ECTEK_Value_s16 0 NO_FORMULA -150.0 0.0 FORMAT "%.2" BIT_MASK 0xFFFF /end CHARACTERISTIC
/begin CHARACTERISTIC R_Vhms_Average_Ratio_M10 "R档Vhms平均值缓冲比例" VALUE 0x786119 ECTEK_Value_u16 0 NO_FORMULA 1.0 500.0 FORMAT "%.2" BIT_MASK 0xFFFF /end CHARACTERISTIC
/begin CHARACTERISTIC D_Vhms_Average_Ratio_M10 "D档Vhms平均值缓冲比例" VALUE 0x78611B ECTEK_Value_u16 0 NO_FORMULA 1.0 500.0 FORMAT "%.2" BIT_MASK 0xFFFF /end CHARACTERISTIC
/begin CHARACTERISTIC Motor_Speed_Torque_M10 "转速_最大转矩 易动 200Nm 60KW 75" CURVE 0x78611D ECTEK_Curve_u16s16 0 NO_FORMULA -5000.0 5000.0 FORMAT "%.2" BIT_MASK 0xFFFF
 /begin AXIS_DESCR STD_AXIS NO_INPUT_QUANTITY rpm1-1 28 -15000.0 15000.0 DEPOSIT ABSOLUTE FORMAT "%.2" /end AXIS_DESCR
/end CHARACTERISTIC
/begin CHARACTERISTIC AccPed_Rip_M10 "油门曲线" CURVE 0x78618F ECTEK_Curve_u16u16 0 rFactor100_PWM -0.0 100.0 FORMAT "%.2" BIT_MASK 0xFFFF
 /begin AXIS_DESCR STD_AXIS NO_INPUT_QUANTITY rFactor100_PWM 11 -0.0 100.0 DEPOSIT ABSOLUTE FORMAT "%.2" /end AXIS_DESCR
/end CHARACTERISTIC
/begin CHARACTERISTIC Speed_Vmh10ms_Crawl_D_M10 "D档蠕动 转速-AD曲线 rpm----mh10ms" CURVE 0x7861BD ECTEK_Curve_s16s16 0 Vmh10ms -500.0 500.0 FORMAT "%.2" BIT_MASK 0xFFFF
 /begin AXIS_DESCR STD_AXIS NO_INPUT_QUANTITY rpm1-1 10 -15000.0 15000.0 DEPOSIT ABSOLUTE FORMAT "%.2" /end AXIS_DESCR
/end CHARACTERISTIC
/begin CHARACTERISTIC Torque_Increment_Crawl_D_M10 "D档蠕动 AD修正转矩给定每周期增量" CURVE 0x7861E7 ECTEK_Curve_s16s16 0 NO_FORMULA -100.0 100.0 FORMAT "%.2" BIT_MASK 0xFFFF
 /begin AXIS_DESCR STD_AXIS NO_INPUT_QUANTITY Vmh10ms 11 -1000.0 1000.0 DEPOSIT ABSOLUTE FORMAT "%.2" /end AXIS_DESCR
/end CHARACTERISTIC
/begin CHARACTERISTIC Speed_Max_Torque_Crawl_D_M10 "D档蠕行模式最大力矩" CURVE 0x786215 ECTEK_Curve_u16s16 0 NO_FORMULA -5000.0 5000.0 FORMAT "%.2" BIT_MASK 0xFFFF
 /begin AXIS_DESCR STD_AXIS NO_INPUT_QUANTITY rpm1-1 9 -15000.0 15000.0 DEPOSIT ABSOLUTE FORMAT "%.2" /end AXIS_DESCR
/end CHARACTERISTIC
/begin CHARACTERISTIC Speed_Max_Torque_Crawl_D_Break_M10 "D档蠕行制动状态下最大驱动力矩" CURVE 0x78623B ECTEK_Curve_u16s16 0 NO_FORMULA -1000.0 1000.0 FORMAT "%.2" BIT_MASK 0xFFFF
 /begin AXIS_DESCR STD_AXIS NO_INPUT_QUANTITY rpm1-1 9 -15000.0 15000.0 DEPOSIT ABSOLUTE FORMAT "%.2" /end AXIS_DESCR
/end CHARACTERISTIC
/begin CHARACTERISTIC Speed_Vmh10ms_General_M10 "通用相对转速-AD曲线 rpm----mh10ms" CURVE 0x786261 ECTEK_Curve_s16s16 0 Vmh10ms -500.0 500.0 FORMAT "%.2" BIT_MASK 0xFFFF
 /begin AXIS_DESCR STD_AXIS NO_INPUT_QUANTITY rpm1-1 11 -30000.0 30000.0 DEPOSIT ABSOLUTE FORMAT "%.2" /end AXIS_DESCR
/end CHARACTERISTIC
/begin CHARACTERISTIC Torque_Increment_General_M10 "通用AD修正转矩给定每周期增量" CURVE 0x78628F ECTEK_Curve_s16s16 0 NO_FORMULA -100.0 100.0 FORMAT "%.2" BIT_MASK 0xFFFF
 /begin AXIS_DESCR STD_AXIS NO_INPUT_QUANTITY Vmh10ms 11 -1000.0 1000.0 DEPOSIT ABSOLUTE FORMAT "%.2" /end AXIS_DESCR
/end CHARACTERISTIC
/begin CHARACTERISTIC Speed_Vmh10ms_D_Park_M10 "D档驻坡 转速-AD曲线 rpm----mh10ms" CURVE 0x7862BD ECTEK_Curve_s16s16 0 Vmh10ms -500.0 500.0 FORMAT "%.2" BIT_MASK 0xFFFF
 /begin AXIS_DESCR STD_AXIS NO_INPUT_QUANTITY rpm1-1 12 -15000.0 15000.0 DEPOSIT ABSOLUTE FORMAT "%.2" /end AXIS_DESCR
/end CHARACTERISTIC
/begin CHARACTERISTIC Torque_Increment_D_Park_M10 "D档驻坡AD修正转矩给定每周期增量" CURVE 0x7862EF ECTEK_Curve_s16s16 0 NO_FORMULA -100.0 100.0 FORMAT "%.2" BIT_MASK 0xFFFF
 /begin AXIS_DESCR STD_AXIS NO_INPUT_QUANTITY Vmh10ms 11 -1000.0 1000.0 DEPOSIT ABSOLUTE FORMAT "%.2" /end AXIS_DESCR
/end CHARACTERISTIC
/begin CHARACTERISTIC Motor_Speed_Torque_Break_M10 "电机最大制动力矩" CURVE 0x78631D ECTEK_Curve_s16s16 0 NO_FORMULA -5000.0 5000.0 FORMAT "%.2" BIT_MASK 0xFFFF
 /begin AXIS_DESCR STD_AXIS NO_INPUT_QUANTITY rpm1-1 14 -15000.0 15000.0 DEPOSIT ABSOLUTE FORMAT "%.2" /end AXIS_DESCR
/end CHARACTERISTIC
/begin CHARACTERISTIC FeedBack_Coast_D_Torque_M10 "D档滑行回馈 速度-力矩  定点" CURVE 0x786357 ECTEK_Curve_s16s16 0 NO_FORMULA -5000.0 5000.0 FORMAT "%.2" BIT_MASK 0xFFFF
 /begin AXIS_DESCR STD_AXIS NO_INPUT_QUANTITY rpm1-1 8 -15000.0 15000.0 DEPOSIT ABSOLUTE FORMAT "%.2" /end AXIS_DESCR
/end CHARACTERISTIC
/begin CHARACTERISTIC FeedBack_Break_D_Torque_M10 "D档制动回馈 速度-力矩 定点" CURVE 0x786379 ECTEK_Curve_s16s16 0 NO_FORMULA -5000.0 5000.0 FORMAT "%.2" BIT_MASK 0xFFFF
 /begin AXIS_DESCR STD_AXIS NO_INPUT_QUANTITY rpm1-1 8 -15000.0 15000.0 DEPOSIT ABSOLUTE FORMAT "%.2" /end AXIS_DESCR
/end CHARACTERISTIC
/begin CHARACTERISTIC Speed_Efficieny_M10 "电机速度-转换效率曲线 驱动" CURVE 0x78639B ECTEK_Curve_u16u16 0 rFactor100_PWM 0.0 100.0 FORMAT "%.2" BIT_MASK 0xFFFF
 /begin AXIS_DESCR STD_AXIS NO_INPUT_QUANTITY rpm1-1 20 0.0 15000.0 DEPOSIT ABSOLUTE FORMAT "%.2" /end AXIS_DESCR
/end CHARACTERISTIC
/begin CHARACTERISTIC Speed_Efficieny_FeedBack_M10 "电机速度-转换效率曲线 发电" CURVE 0x7863ED ECTEK_Curve_u16u16 0 rFactor100_PWM 0.0 150.0 FORMAT "%.2" BIT_MASK 0xFFFF
 /begin AXIS_DESCR STD_AXIS NO_INPUT_QUANTITY rpm1-1 20 0.0 15000.0 DEPOSIT ABSOLUTE FORMAT "%.2" /end AXIS_DESCR
/end CHARACTERISTIC
/begin CHARACTERISTIC AutoPark_Motor_Speed_Torque_M10 "驻坡最大力矩" CURVE 0x78643F ECTEK_Curve_u16s16 0 NO_FORMULA 0.0 5000.0 FORMAT "%.2" BIT_MASK 0xFFFF
 /begin AXIS_DESCR STD_AXIS NO_INPUT_QUANTITY rpm1-1 8 -15000.0 15000.0 DEPOSIT ABSOLUTE FORMAT "%.2" /end AXIS_DESCR
/end CHARACTERISTIC
/begin CHARACTERISTIC AccPedCD_rUW_CUR_M10 "油门开度" CURVE 0x786461 ECTEK_Curve_u16u16 0 rFactor100_PWM 0.0 100.0 FORMAT "%.2" BIT_MASK 0xFFFF
 /begin AXIS_DESCR STD_AXIS NO_INPUT_QUANTITY u5V 7 0.0 5.0 DEPOSIT ABSOLUTE FORMAT "%.2" /end AXIS_DESCR
/end CHARACTERISTIC
/begin CHARACTERISTIC AccPedCD_rUW_CUR2_M10 "油门2开度" CURVE 0x78647F ECTEK_Curve_u16u16 0 rFactor100_PWM 0.0 100.0 FORMAT "%.2" BIT_MASK 0xFFFF
 /begin AXIS_DESCR STD_AXIS NO_INPUT_QUANTITY u5V 7 0.0 5.0 DEPOSIT ABSOLUTE FORMAT "%.2" /end AXIS_DESCR
/end CHARACTERISTIC
/begin CHARACTERISTIC EPS_Speed_M10 "D08 EPS频率与转速对应曲线 1.2869~128.69Hz" CURVE 0x78649D ECTEK_Curve_u16s16 0 PWM_Hz100 30.5 600.0 BIT_MASK 0xFFFF
 /begin AXIS_DESCR STD_AXIS NO_INPUT_QUANTITY rpm1-1 6 -15000.0 15000.0 DEPOSIT ABSOLUTE FORMAT "%.2" /end AXIS_DESCR
/end CHARACTERISTIC
/begin CHARACTERISTIC AC_Condenser_Temp_M10 "空调蒸发器温度 上拉100K 下拉10K" CURVE 0x7864B7 ECTEK_Curve_s16u16 0 Temp -100.0 150.0 FORMAT "%.2" BIT_MASK 0xFFFF
 /begin AXIS_DESCR STD_AXIS NO_INPUT_QUANTITY NO_FORMULA 31 0.0 4095.0 DEPOSIT ABSOLUTE FORMAT "%.2" /end AXIS_DESCR
/end CHARACTERISTIC
/begin CHARACTERISTIC AC_Condenser_Temp_M10_ACES "空调蒸发器温度_奥易克斯 上拉2.74K 下拉500K" CURVE 0x786535 ECTEK_Curve_s16u16 0 Temp -100.0 150.0 FORMAT "%.2" BIT_MASK 0xFFFF
 /begin AXIS_DESCR STD_AXIS NO_INPUT_QUANTITY NO_FORMULA 29 0.0 4095.0 DEPOSIT ABSOLUTE FORMAT "%.2" /end AXIS_DESCR
/end CHARACTERISTIC
/begin CHARACTERISTIC Motor_Vehicle_Speed_Scale_M101 "转速-车速比例， D08  75.15" VALUE 0x7865AB ECTEK_Value_u8 0 NO_FORMULA 0.0 255.0 FORMAT "%.2" BIT_MASK 0xFF /end CHARACTERISTIC
/begin CHARACTERISTIC Demand_Limit_High_M101 "转速上线  *4" VALUE 0x7865AC ECTEK_Value_u16 0 NO_FORMULA -0.0 4095.0 FORMAT "%.2" BIT_MASK 0xFFFF /end CHARACTERISTIC
/begin CHARACTERISTIC Demand_Limit_Low_M101 "速度下限" VALUE 0x7865AE ECTEK_Value_u16 0 NO_FORMULA -0.0 4095.0 FORMAT "%.2" BIT_MASK 0xFFFF /end CHARACTERISTIC
/begin CHARACTERISTIC Crawl_D_Speed_Max_M101 "D蠕动最大速度  从其他状态进入蠕动的速度" VALUE 0x7865B0 ECTEK_Value_u16 0 rpm1-1 -0.0 1000.0 FORMAT "%.2" BIT_MASK 0xFFFF /end CHARACTERISTIC
/begin CHARACTERISTIC Crawl_D_Torque_Delay_Max_M101 "蠕动更新间隔  单位10ms" VALUE 0x7865B2 ECTEK_Value_u8 0 NO_FORMULA -0.0 255.0 FORMAT "%.2" BIT_MASK 0xFF /end CHARACTERISTIC
/begin CHARACTERISTIC Crawl_D_Torque_Delay_Start_Max_M101 "起步蠕动更新间隔  单位10ms" VALUE 0x7865B3 ECTEK_Value_u8 0 NO_COMPU_METHOD -4294967296.0 4294967296.0 FORMAT "%.2" BIT_MASK 0xFF /end CHARACTERISTIC
/begin CHARACTERISTIC Speed_Buffer_Number_M101 "10ms车辆速度采样缓冲次数" VALUE 0x7865B4 ECTEK_Value_u8 0 NO_FORMULA -0.0 69.0 FORMAT "%.2" BIT_MASK 0xFF /end CHARACTERISTIC
/begin CHARACTERISTIC Speed_Average_Number_M101 "10ms平均车速缓冲次数" VALUE 0x7865B5 ECTEK_Value_u8 0 NO_FORMULA -0.0 69.0 FORMAT "%.2" BIT_MASK 0xFF /end CHARACTERISTIC
/begin CHARACTERISTIC Torque_Buffer_Number_AutoPark_M101 "10ms平均转矩缓冲次数" VALUE 0x7865B6 ECTEK_Value_u8 0 NO_FORMULA -0.0 69.0 FORMAT "%.2" BIT_MASK 0xFF /end CHARACTERISTIC
/begin CHARACTERISTIC D_Park_Start_Speed_M101 "D驻坡触发转速" VALUE 0x7865B7 ECTEK_Value_u8 0 rpm1-1 -0.0 255.0 FORMAT "%.2" BIT_MASK 0xFF /end CHARACTERISTIC
/begin CHARACTERISTIC Auto_Park_Speed_Acc_Max_M101 "激活D驻坡最大退行转速累加" VALUE 0x7865B8 ECTEK_Value_s16 0 NO_FORMULA -32767.0 32768.0 FORMAT "%.2" BIT_MASK 0xFFFF /end CHARACTERISTIC
/begin CHARACTERISTIC Auto_Park_Speed_Times_Max_M101 "激活D驻坡最大退行增速时间 单位10ms" VALUE 0x7865BA ECTEK_Value_u16 0 NO_FORMULA -0.0 65535.0 FORMAT "%.2" BIT_MASK 0xFFFF /end CHARACTERISTIC
/begin CHARACTERISTIC Auto_Torque_Min_M101 "自动转矩最小正值" VALUE 0x7865BC ECTEK_Value_s16 0 NO_FORMULA 0.0 150.0 FORMAT "%.2" BIT_MASK 0xFFFF /end CHARACTERISTIC
/begin CHARACTERISTIC Auto_Torque_Max_M101 "自动转矩最大负值" VALUE 0x7865BE ECTEK_Value_s16 0 NO_FORMULA -150.0 0.0 FORMAT "%.2" BIT_MASK 0xFFFF /end CHARACTERISTIC
/begin CHARACTERISTIC R_Vhms_Average_Ratio_M101 "R档Vhms平均值缓冲比例" VALUE 0x7865C0 ECTEK_Value_u16 0 NO_FORMULA 1.0 500.0 FORMAT "%.2" BIT_MASK 0xFFFF /end CHARACTERISTIC
/begin CHARACTERISTIC D_Vhms_Average_Ratio_M101 "D档Vhms平均值缓冲比例" VALUE 0x7865C2 ECTEK_Value_u16 0 NO_FORMULA 1.0 500.0 FORMAT "%.2" BIT_MASK 0xFFFF /end CHARACTERISTIC
/begin CHARACTERISTIC Motor_Speed_Torque_M101 "转速_最大转矩 力信 180Nm 50KW 75" CURVE 0x7865C4 ECTEK_Curve_u16s16 0 NO_FORMULA -5000.0 5000.0 FORMAT "%.2" BIT_MASK 0xFFFF
 /begin AXIS_DESCR STD_AXIS NO_INPUT_QUANTITY rpm1-1 21 -15000.0 15000.0 DEPOSIT ABSOLUTE FORMAT "%.2" /end AXIS_DESCR
/end CHARACTERISTIC
/begin CHARACTERISTIC Speed_Vmh10ms_Crawl_D_M101 "D档蠕动 转速-AD曲线 rpm----mh10ms" CURVE 0x78661A ECTEK_Curve_s16s16 0 Vmh10ms -500.0 500.0 FORMAT "%.2" BIT_MASK 0xFFFF
 /begin AXIS_DESCR STD_AXIS NO_INPUT_QUANTITY rpm1-1 10 -15000.0 15000.0 DEPOSIT ABSOLUTE FORMAT "%.2" /end AXIS_DESCR
/end CHARACTERISTIC
/begin CHARACTERISTIC Torque_Increment_Crawl_D_M101 "D档蠕动 AD修正转矩给定每周期增量" CURVE 0x786644 ECTEK_Curve_s16s16 0 NO_FORMULA -100.0 100.0 FORMAT "%.2" BIT_MASK 0xFFFF
 /begin AXIS_DESCR STD_AXIS NO_INPUT_QUANTITY Vmh10ms 11 -1000.0 1000.0 DEPOSIT ABSOLUTE FORMAT "%.2" /end AXIS_DESCR
/end CHARACTERISTIC
/begin CHARACTERISTIC Speed_Max_Torque_Crawl_D_M101 "D档蠕行模式最大力矩" CURVE 0x786672 ECTEK_Curve_u16s16 0 NO_FORMULA -5000.0 5000.0 FORMAT "%.2" BIT_MASK 0xFFFF
 /begin AXIS_DESCR STD_AXIS NO_INPUT_QUANTITY rpm1-1 9 -15000.0 15000.0 DEPOSIT ABSOLUTE FORMAT "%.2" /end AXIS_DESCR
/end CHARACTERISTIC
/begin CHARACTERISTIC Speed_Max_Torque_Crawl_D_Break_M101 "D档蠕行制动状态下最大驱动力矩" CURVE 0x786698 ECTEK_Curve_u16s16 0 NO_FORMULA -1000.0 1000.0 FORMAT "%.2" BIT_MASK 0xFFFF
 /begin AXIS_DESCR STD_AXIS NO_INPUT_QUANTITY rpm1-1 9 -15000.0 15000.0 DEPOSIT ABSOLUTE FORMAT "%.2" /end AXIS_DESCR
/end CHARACTERISTIC
/begin CHARACTERISTIC Speed_Vmh10ms_General_M101 "通用相对转速-AD曲线 rpm----mh10ms" CURVE 0x7866BE ECTEK_Curve_s16s16 0 Vmh10ms -500.0 500.0 FORMAT "%.2" BIT_MASK 0xFFFF
 /begin AXIS_DESCR STD_AXIS NO_INPUT_QUANTITY rpm1-1 11 -30000.0 30000.0 DEPOSIT ABSOLUTE FORMAT "%.2" /end AXIS_DESCR
/end CHARACTERISTIC
/begin CHARACTERISTIC Torque_Increment_General_M101 "通用AD修正转矩给定每周期增量" CURVE 0x7866EC ECTEK_Curve_s16s16 0 NO_FORMULA -100.0 100.0 FORMAT "%.2" BIT_MASK 0xFFFF
 /begin AXIS_DESCR STD_AXIS NO_INPUT_QUANTITY Vmh10ms 11 -1000.0 1000.0 DEPOSIT ABSOLUTE FORMAT "%.2" /end AXIS_DESCR
/end CHARACTERISTIC
/begin CHARACTERISTIC Speed_Vmh10ms_D_Park_M101 "D档驻坡 转速-AD曲线 rpm----mh10ms" CURVE 0x78671A ECTEK_Curve_s16s16 0 Vmh10ms -500.0 500.0 FORMAT "%.2" BIT_MASK 0xFFFF
 /begin AXIS_DESCR STD_AXIS NO_INPUT_QUANTITY rpm1-1 12 -15000.0 15000.0 DEPOSIT ABSOLUTE FORMAT "%.2" /end AXIS_DESCR
/end CHARACTERISTIC
/begin CHARACTERISTIC Torque_Increment_D_Park_M101 "D档驻坡AD修正转矩给定每周期增量" CURVE 0x78674C ECTEK_Curve_s16s16 0 NO_FORMULA -100.0 100.0 FORMAT "%.2" BIT_MASK 0xFFFF
 /begin AXIS_DESCR STD_AXIS NO_INPUT_QUANTITY Vmh10ms 11 -1000.0 1000.0 DEPOSIT ABSOLUTE FORMAT "%.2" /end AXIS_DESCR
/end CHARACTERISTIC
/begin CHARACTERISTIC Motor_Speed_Torque_Break_M101 "电机最大制动力矩" CURVE 0x78677A ECTEK_Curve_s16s16 0 NO_FORMULA -5000.0 5000.0 FORMAT "%.2" BIT_MASK 0xFFFF
 /begin AXIS_DESCR STD_AXIS NO_INPUT_QUANTITY rpm1-1 14 -15000.0 15000.0 DEPOSIT ABSOLUTE FORMAT "%.2" /end AXIS_DESCR
/end CHARACTERISTIC
/begin CHARACTERISTIC FeedBack_Coast_D_Torque_M101 "D档滑行回馈 速度-力矩  定点" CURVE 0x7867B4 ECTEK_Curve_s16s16 0 NO_FORMULA -5000.0 5000.0 FORMAT "%.2" BIT_MASK 0xFFFF
 /begin AXIS_DESCR STD_AXIS NO_INPUT_QUANTITY rpm1-1 8 -15000.0 15000.0 DEPOSIT ABSOLUTE FORMAT "%.2" /end AXIS_DESCR
/end CHARACTERISTIC
/begin CHARACTERISTIC FeedBack_Break_D_Torque_M101 "D档制动回馈 速度-力矩 定点" CURVE 0x7867D6 ECTEK_Curve_s16s16 0 NO_FORMULA -5000.0 5000.0 FORMAT "%.2" BIT_MASK 0xFFFF
 /begin AXIS_DESCR STD_AXIS NO_INPUT_QUANTITY rpm1-1 8 -15000.0 15000.0 DEPOSIT ABSOLUTE FORMAT "%.2" /end AXIS_DESCR
/end CHARACTERISTIC
/begin CHARACTERISTIC Speed_Efficieny_M101 "电机速度-转换效率曲线 驱动" CURVE 0x7867F8 ECTEK_Curve_u16u16 0 rFactor100_PWM 0.0 100.0 FORMAT "%.2" BIT_MASK 0xFFFF
 /begin AXIS_DESCR STD_AXIS NO_INPUT_QUANTITY rpm1-1 11 0.0 15000.0 DEPOSIT ABSOLUTE FORMAT "%.2" /end AXIS_DESCR
/end CHARACTERISTIC
/begin CHARACTERISTIC Speed_Efficieny_FeedBack_M101 "电机速度-转换效率曲线 发电" CURVE 0x786826 ECTEK_Curve_u16u16 0 rFactor100_PWM 0.0 150.0 FORMAT "%.2" BIT_MASK 0xFFFF
 /begin AXIS_DESCR STD_AXIS NO_INPUT_QUANTITY rpm1-1 20 0.0 15000.0 DEPOSIT ABSOLUTE FORMAT "%.2" /end AXIS_DESCR
/end CHARACTERISTIC
/begin CHARACTERISTIC AutoPark_Motor_Speed_Torque_M101 "驻坡最大力矩" CURVE 0x786878 ECTEK_Curve_u16s16 0 NO_FORMULA 0.0 5000.0 FORMAT "%.2" BIT_MASK 0xFFFF
 /begin AXIS_DESCR STD_AXIS NO_INPUT_QUANTITY rpm1-1 8 -15000.0 15000.0 DEPOSIT ABSOLUTE FORMAT "%.2" /end AXIS_DESCR
/end CHARACTERISTIC
/begin CHARACTERISTIC Motor_Vehicle_Speed_Scale_M102 "转速-车速比例， D08  75.15" VALUE 0x78689A ECTEK_Value_u8 0 NO_FORMULA 0.0 255.0 FORMAT "%.2" BIT_MASK 0xFF /end CHARACTERISTIC
/begin CHARACTERISTIC Demand_Limit_High_M102 "转速上线  *4" VALUE 0x78689B ECTEK_Value_u16 0 NO_FORMULA -0.0 4095.0 FORMAT "%.2" BIT_MASK 0xFFFF /end CHARACTERISTIC
/begin CHARACTERISTIC Demand_Limit_Low_M102 "速度下限" VALUE 0x78689D ECTEK_Value_u16 0 NO_FORMULA -0.0 4095.0 FORMAT "%.2" BIT_MASK 0xFFFF /end CHARACTERISTIC
/begin CHARACTERISTIC Crawl_D_Speed_Max_M102 "D蠕动最大速度  从其他状态进入蠕动的速度" VALUE 0x78689F ECTEK_Value_u16 0 rpm1-1 -0.0 1000.0 FORMAT "%.2" BIT_MASK 0xFFFF /end CHARACTERISTIC
/begin CHARACTERISTIC Crawl_D_Torque_Delay_Max_M102 "蠕动更新间隔  单位10ms" VALUE 0x7868A1 ECTEK_Value_u8 0 NO_FORMULA -0.0 255.0 FORMAT "%.2" BIT_MASK 0xFF /end CHARACTERISTIC
/begin CHARACTERISTIC Crawl_D_Torque_Delay_Start_Max_M102 "起步蠕动更新间隔  单位10ms" VALUE 0x7868A2 ECTEK_Value_u8 0 NO_COMPU_METHOD -4294967296.0 4294967296.0 FORMAT "%.2" BIT_MASK 0xFF /end CHARACTERISTIC
/begin CHARACTERISTIC Speed_Buffer_Number_M102 "10ms车辆速度采样缓冲次数" VALUE 0x7868A3 ECTEK_Value_u8 0 NO_FORMULA -0.0 69.0 FORMAT "%.2" BIT_MASK 0xFF /end CHARACTERISTIC
/begin CHARACTERISTIC Speed_Average_Number_M102 "10ms平均车速缓冲次数" VALUE 0x7868A4 ECTEK_Value_u8 0 NO_FORMULA -0.0 69.0 FORMAT "%.2" BIT_MASK 0xFF /end CHARACTERISTIC
/begin CHARACTERISTIC Torque_Buffer_Number_AutoPark_M102 "10ms平均转矩缓冲次数" VALUE 0x7868A5 ECTEK_Value_u8 0 NO_FORMULA -0.0 69.0 FORMAT "%.2" BIT_MASK 0xFF /end CHARACTERISTIC
/begin CHARACTERISTIC D_Park_Start_Speed_M102 "D驻坡触发转速" VALUE 0x7868A6 ECTEK_Value_u8 0 rpm1-1 -0.0 255.0 FORMAT "%.2" BIT_MASK 0xFF /end CHARACTERISTIC
/begin CHARACTERISTIC Auto_Park_Speed_Acc_Max_M102 "激活D驻坡最大退行转速累加" VALUE 0x7868A7 ECTEK_Value_s16 0 NO_FORMULA -32767.0 32768.0 FORMAT "%.2" BIT_MASK 0xFFFF /end CHARACTERISTIC
/begin CHARACTERISTIC Auto_Park_Speed_Times_Max_M102 "激活D驻坡最大退行增速时间 单位10ms" VALUE 0x7868A9 ECTEK_Value_u16 0 NO_FORMULA -0.0 65535.0 FORMAT "%.2" BIT_MASK 0xFFFF /end CHARACTERISTIC
/begin CHARACTERISTIC Auto_Torque_Min_M102 "自动转矩最小正值" VALUE 0x7868AB ECTEK_Value_s16 0 NO_FORMULA 0.0 150.0 FORMAT "%.2" BIT_MASK 0xFFFF /end CHARACTERISTIC
/begin CHARACTERISTIC Auto_Torque_Max_M102 "自动转矩最大负值" VALUE 0x7868AD ECTEK_Value_s16 0 NO_FORMULA -150.0 0.0 FORMAT "%.2" BIT_MASK 0xFFFF /end CHARACTERISTIC
/begin CHARACTERISTIC R_Vhms_Average_Ratio_M102 "R档Vhms平均值缓冲比例" VALUE 0x7868AF ECTEK_Value_u16 0 NO_FORMULA 1.0 500.0 FORMAT "%.2" BIT_MASK 0xFFFF /end CHARACTERISTIC
/begin CHARACTERISTIC D_Vhms_Average_Ratio_M102 "D档Vhms平均值缓冲比例" VALUE 0x7868B1 ECTEK_Value_u16 0 NO_FORMULA 1.0 500.0 FORMAT "%.2" BIT_MASK 0xFFFF /end CHARACTERISTIC
/begin CHARACTERISTIC Motor_Speed_Torque_M102 "转速_最大转矩 力信 180Nm 50KW 75" CURVE 0x7868B3 ECTEK_Curve_u16s16 0 NO_FORMULA -5000.0 5000.0 FORMAT "%.2" BIT_MASK 0xFFFF
 /begin AXIS_DESCR STD_AXIS NO_INPUT_QUANTITY rpm1-1 28 -15000.0 15000.0 DEPOSIT ABSOLUTE FORMAT "%.2" /end AXIS_DESCR
/end CHARACTERISTIC
/begin CHARACTERISTIC Speed_Vmh10ms_Crawl_D_M102 "D档蠕动 转速-AD曲线 rpm----mh10ms" CURVE 0x786925 ECTEK_Curve_s16s16 0 Vmh10ms -500.0 500.0 FORMAT "%.2" BIT_MASK 0xFFFF
 /begin AXIS_DESCR STD_AXIS NO_INPUT_QUANTITY rpm1-1 10 -15000.0 15000.0 DEPOSIT ABSOLUTE FORMAT "%.2" /end AXIS_DESCR
/end CHARACTERISTIC
/begin CHARACTERISTIC Torque_Increment_Crawl_D_M102 "D档蠕动 AD修正转矩给定每周期增量" CURVE 0x78694F ECTEK_Curve_s16s16 0 NO_FORMULA -100.0 100.0 FORMAT "%.2" BIT_MASK 0xFFFF
 /begin AXIS_DESCR STD_AXIS NO_INPUT_QUANTITY Vmh10ms 11 -1000.0 1000.0 DEPOSIT ABSOLUTE FORMAT "%.2" /end AXIS_DESCR
/end CHARACTERISTIC
/begin CHARACTERISTIC Speed_Max_Torque_Crawl_D_M102 "D档蠕行模式最大力矩" CURVE 0x78697D ECTEK_Curve_u16s16 0 NO_FORMULA -5000.0 5000.0 FORMAT "%.2" BIT_MASK 0xFFFF
 /begin AXIS_DESCR STD_AXIS NO_INPUT_QUANTITY rpm1-1 9 -15000.0 15000.0 DEPOSIT ABSOLUTE FORMAT "%.2" /end AXIS_DESCR
/end CHARACTERISTIC
/begin CHARACTERISTIC Speed_Max_Torque_Crawl_D_Break_M102 "D档蠕行制动状态下最大驱动力矩" CURVE 0x7869A3 ECTEK_Curve_u16s16 0 NO_FORMULA -1000.0 1000.0 FORMAT "%.2" BIT_MASK 0xFFFF
 /begin AXIS_DESCR STD_AXIS NO_INPUT_QUANTITY rpm1-1 9 -15000.0 15000.0 DEPOSIT ABSOLUTE FORMAT "%.2" /end AXIS_DESCR
/end CHARACTERISTIC
/begin CHARACTERISTIC Speed_Vmh10ms_General_M102 "通用相对转速-AD曲线 rpm----mh10ms" CURVE 0x7869C9 ECTEK_Curve_s16s16 0 Vmh10ms -500.0 500.0 FORMAT "%.2" BIT_MASK 0xFFFF
 /begin AXIS_DESCR STD_AXIS NO_INPUT_QUANTITY rpm1-1 11 -30000.0 30000.0 DEPOSIT ABSOLUTE FORMAT "%.2" /end AXIS_DESCR
/end CHARACTERISTIC
/begin CHARACTERISTIC Torque_Increment_General_M102 "通用AD修正转矩给定每周期增量" CURVE 0x7869F7 ECTEK_Curve_s16s16 0 NO_FORMULA -100.0 100.0 FORMAT "%.2" BIT_MASK 0xFFFF
 /begin AXIS_DESCR STD_AXIS NO_INPUT_QUANTITY Vmh10ms 11 -1000.0 1000.0 DEPOSIT ABSOLUTE FORMAT "%.2" /end AXIS_DESCR
/end CHARACTERISTIC
/begin CHARACTERISTIC Speed_Vmh10ms_D_Park_M102 "D档驻坡 转速-AD曲线 rpm----mh10ms" CURVE 0x786A25 ECTEK_Curve_s16s16 0 Vmh10ms -500.0 500.0 FORMAT "%.2" BIT_MASK 0xFFFF
 /begin AXIS_DESCR STD_AXIS NO_INPUT_QUANTITY rpm1-1 12 -15000.0 15000.0 DEPOSIT ABSOLUTE FORMAT "%.2" /end AXIS_DESCR
/end CHARACTERISTIC
/begin CHARACTERISTIC Torque_Increment_D_Park_M102 "D档驻坡AD修正转矩给定每周期增量" CURVE 0x786A57 ECTEK_Curve_s16s16 0 NO_FORMULA -100.0 100.0 FORMAT "%.2" BIT_MASK 0xFFFF
 /begin AXIS_DESCR STD_AXIS NO_INPUT_QUANTITY Vmh10ms 11 -1000.0 1000.0 DEPOSIT ABSOLUTE FORMAT "%.2" /end AXIS_DESCR
/end CHARACTERISTIC
/begin CHARACTERISTIC Motor_Speed_Torque_Break_M102 "电机最大制动力矩" CURVE 0x786A85 ECTEK_Curve_s16s16 0 NO_FORMULA -5000.0 5000.0 FORMAT "%.2" BIT_MASK 0xFFFF
 /begin AXIS_DESCR STD_AXIS NO_INPUT_QUANTITY rpm1-1 14 -15000.0 15000.0 DEPOSIT ABSOLUTE FORMAT "%.2" /end AXIS_DESCR
/end CHARACTERISTIC
/begin CHARACTERISTIC FeedBack_Coast_D_Torque_M102 "D档滑行回馈 速度-力矩  定点" CURVE 0x786ABF ECTEK_Curve_s16s16 0 NO_FORMULA -5000.0 5000.0 FORMAT "%.2" BIT_MASK 0xFFFF
 /begin AXIS_DESCR STD_AXIS NO_INPUT_QUANTITY rpm1-1 8 -15000.0 15000.0 DEPOSIT ABSOLUTE FORMAT "%.2" /end AXIS_DESCR
/end CHARACTERISTIC
/begin CHARACTERISTIC FeedBack_Break_D_Torque_M102 "D档制动回馈 速度-力矩 定点" CURVE 0x786AE1 ECTEK_Curve_s16s16 0 NO_FORMULA -5000.0 5000.0 FORMAT "%.2" BIT_MASK 0xFFFF
 /begin AXIS_DESCR STD_AXIS NO_INPUT_QUANTITY rpm1-1 8 -15000.0 15000.0 DEPOSIT ABSOLUTE FORMAT "%.2" /end AXIS_DESCR
/end CHARACTERISTIC
/begin CHARACTERISTIC Speed_Efficieny_M102 "电机速度-转换效率曲线 驱动" CURVE 0x786B03 ECTEK_Curve_u16u16 0 rFactor100_PWM 0.0 100.0 FORMAT "%.2" BIT_MASK 0xFFFF
 /begin AXIS_DESCR STD_AXIS NO_INPUT_QUANTITY rpm1-1 20 0.0 15000.0 DEPOSIT ABSOLUTE FORMAT "%.2" /end AXIS_DESCR
/end CHARACTERISTIC
/begin CHARACTERISTIC Speed_Efficieny_FeedBack_M102 "电机速度-转换效率曲线 发电" CURVE 0x786B55 ECTEK_Curve_u16u16 0 rFactor100_PWM 0.0 150.0 FORMAT "%.2" BIT_MASK 0xFFFF
 /begin AXIS_DESCR STD_AXIS NO_INPUT_QUANTITY rpm1-1 20 0.0 15000.0 DEPOSIT ABSOLUTE FORMAT "%.2" /end AXIS_DESCR
/end CHARACTERISTIC
/begin CHARACTERISTIC AutoPark_Motor_Speed_Torque_M102 "驻坡最大力矩" CURVE 0x786BA7 ECTEK_Curve_u16s16 0 NO_FORMULA 0.0 5000.0 FORMAT "%.2" BIT_MASK 0xFFFF
 /begin AXIS_DESCR STD_AXIS NO_INPUT_QUANTITY rpm1-1 8 -15000.0 15000.0 DEPOSIT ABSOLUTE FORMAT "%.2" /end AXIS_DESCR
/end CHARACTERISTIC
/begin CHARACTERISTIC Motor_Vehicle_Speed_Scale_M11 "转速-车速比例， 优优114.411   D11 36.632   D07  62.111  A9 95.064 D07L 68.836" VALUE 0x786BC9 ECTEK_Value_u8 0 NO_FORMULA 0.0 255.0 FORMAT "%.2" BIT_MASK 0xFF /end CHARACTERISTIC
/begin CHARACTERISTIC Demand_Limit_High_M11 "转速上线  *4" VALUE 0x786BCA ECTEK_Value_u16 0 NO_FORMULA -0.0 4095.0 FORMAT "%.2" BIT_MASK 0xFFFF /end CHARACTERISTIC
/begin CHARACTERISTIC Demand_Limit_Low_M11 "速度下限" VALUE 0x786BCC ECTEK_Value_u16 0 NO_FORMULA -0.0 4095.0 FORMAT "%.2" BIT_MASK 0xFFFF /end CHARACTERISTIC
/begin CHARACTERISTIC Crawl_D_Speed_Max_M11 "D蠕动最大速度  从其他状态进入蠕动的速度" VALUE 0x786BCE ECTEK_Value_u16 0 rpm1-1 -0.0 1000.0 FORMAT "%.2" BIT_MASK 0xFFFF /end CHARACTERISTIC
/begin CHARACTERISTIC Crawl_D_Torque_Delay_Max_M11 "蠕动更新间隔  单位10ms" VALUE 0x786BD0 ECTEK_Value_u8 0 NO_FORMULA -0.0 255.0 FORMAT "%.2" BIT_MASK 0xFF /end CHARACTERISTIC
/begin CHARACTERISTIC Crawl_D_Torque_Delay_Start_Max_M11 "起步蠕动更新间隔  单位10ms" VALUE 0x786BD1 ECTEK_Value_u8 0 NO_COMPU_METHOD -4294967296.0 4294967296.0 FORMAT "%.2" BIT_MASK 0xFF /end CHARACTERISTIC
/begin CHARACTERISTIC Speed_Buffer_Number_M11 "10ms车辆速度采样缓冲次数" VALUE 0x786BD2 ECTEK_Value_u8 0 NO_FORMULA 1.0 69.0 FORMAT "%.2" BIT_MASK 0xFF /end CHARACTERISTIC
/begin CHARACTERISTIC Speed_Average_Number_M11 "10ms平均车速缓冲次数" VALUE 0x786BD3 ECTEK_Value_u8 0 NO_FORMULA 1.0 69.0 FORMAT "%.2" BIT_MASK 0xFF /end CHARACTERISTIC
/begin CHARACTERISTIC Torque_Buffer_Number_AutoPark_M11 "10ms平均转矩缓冲次数" VALUE 0x786BD4 ECTEK_Value_u8 0 NO_FORMULA -0.0 69.0 FORMAT "%.2" BIT_MASK 0xFF /end CHARACTERISTIC
/begin CHARACTERISTIC D_Park_Start_Speed_M11 "D驻坡触发转速" VALUE 0x786BD5 ECTEK_Value_u8 0 rpm1-1 -0.0 255.0 FORMAT "%.2" BIT_MASK 0xFF /end CHARACTERISTIC
/begin CHARACTERISTIC Auto_Park_Speed_Acc_Max_M11 "激活D驻坡最大退行转速累加" VALUE 0x786BD6 ECTEK_Value_s16 0 NO_FORMULA -32767.0 32768.0 FORMAT "%.2" BIT_MASK 0xFFFF /end CHARACTERISTIC
/begin CHARACTERISTIC Auto_Park_Speed_Times_Max_M11 "激活D驻坡最大退行增速时间 单位10ms" VALUE 0x786BD8 ECTEK_Value_u16 0 NO_FORMULA -0.0 65535.0 FORMAT "%.2" BIT_MASK 0xFFFF /end CHARACTERISTIC
/begin CHARACTERISTIC Auto_Torque_Min_M11 "自动转矩最小正值" VALUE 0x786BDA ECTEK_Value_s16 0 NO_FORMULA 0.0 150.0 FORMAT "%.2" BIT_MASK 0xFFFF /end CHARACTERISTIC
/begin CHARACTERISTIC Auto_Torque_Max_M11 "自动转矩最大负值" VALUE 0x786BDC ECTEK_Value_s16 0 NO_FORMULA -150.0 0.0 FORMAT "%.2" BIT_MASK 0xFFFF /end CHARACTERISTIC
/begin CHARACTERISTIC R_Vhms_Average_Ratio_M11 "R档Vhms平均值缓冲比例" VALUE 0x786BDE ECTEK_Value_u16 0 NO_FORMULA 1.0 500.0 FORMAT "%.2" BIT_MASK 0xFFFF /end CHARACTERISTIC
/begin CHARACTERISTIC D_Vhms_Average_Ratio_M11 "D档Vhms平均值缓冲比例" VALUE 0x786BE0 ECTEK_Value_u16 0 NO_FORMULA 1.0 500.0 FORMAT "%.2" BIT_MASK 0xFFFF /end CHARACTERISTIC
/begin CHARACTERISTIC Motor_Speed_Torque_M11 "转速_最大转矩 大地和 30KW 150N   95" CURVE 0x786BE2 ECTEK_Curve_u16s16 0 NO_FORMULA -5000.0 5000.0 FORMAT "%.2" BIT_MASK 0xFFFF
 /begin AXIS_DESCR STD_AXIS NO_INPUT_QUANTITY rpm1-1 26 -15000.0 15000.0 DEPOSIT ABSOLUTE FORMAT "%.2" /end AXIS_DESCR
/end CHARACTERISTIC
/begin CHARACTERISTIC AccPed_Rip_M11 "油门曲线" CURVE 0x786C4C ECTEK_Curve_u16u16 0 rFactor100_PWM -0.0 100.0 FORMAT "%.2" BIT_MASK 0xFFFF
 /begin AXIS_DESCR STD_AXIS NO_INPUT_QUANTITY rFactor100_PWM 11 -0.0 100.0 DEPOSIT ABSOLUTE FORMAT "%.2" /end AXIS_DESCR
/end CHARACTERISTIC
/begin CHARACTERISTIC Speed_Vmh10ms_Crawl_D_M11 "D档蠕动 转速-AD曲线 rpm----mh10ms" CURVE 0x786C7A ECTEK_Curve_s16s16 0 Vmh10ms -500.0 500.0 FORMAT "%.2" BIT_MASK 0xFFFF
 /begin AXIS_DESCR STD_AXIS NO_INPUT_QUANTITY rpm1-1 10 -15000.0 15000.0 DEPOSIT ABSOLUTE FORMAT "%.2" /end AXIS_DESCR
/end CHARACTERISTIC
/begin CHARACTERISTIC Torque_Increment_Crawl_D_M11 "D档蠕动 AD修正转矩给定每周期增量" CURVE 0x786CA4 ECTEK_Curve_s16s16 0 NO_FORMULA -100.0 100.0 FORMAT "%.2" BIT_MASK 0xFFFF
 /begin AXIS_DESCR STD_AXIS NO_INPUT_QUANTITY Vmh10ms 11 -1000.0 1000.0 DEPOSIT ABSOLUTE FORMAT "%.2" /end AXIS_DESCR
/end CHARACTERISTIC
/begin CHARACTERISTIC Speed_Max_Torque_Crawl_D_M11 "D档蠕行模式最大力矩" CURVE 0x786CD2 ECTEK_Curve_u16s16 0 NO_FORMULA -5000.0 5000.0 FORMAT "%.2" BIT_MASK 0xFFFF
 /begin AXIS_DESCR STD_AXIS NO_INPUT_QUANTITY rpm1-1 9 -15000.0 15000.0 DEPOSIT ABSOLUTE FORMAT "%.2" /end AXIS_DESCR
/end CHARACTERISTIC
/begin CHARACTERISTIC Speed_Max_Torque_Crawl_D_Break_M11 "D档蠕行制动状态下最大驱动力矩" CURVE 0x786CF8 ECTEK_Curve_u16s16 0 NO_FORMULA -1000.0 1000.0 FORMAT "%.2" BIT_MASK 0xFFFF
 /begin AXIS_DESCR STD_AXIS NO_INPUT_QUANTITY rpm1-1 9 -15000.0 15000.0 DEPOSIT ABSOLUTE FORMAT "%.2" /end AXIS_DESCR
/end CHARACTERISTIC
/begin CHARACTERISTIC Speed_Vmh10ms_General_M11 "通用相对转速-AD曲线 rpm----mh10ms" CURVE 0x786D1E ECTEK_Curve_s16s16 0 Vmh10ms -500.0 500.0 FORMAT "%.2" BIT_MASK 0xFFFF
 /begin AXIS_DESCR STD_AXIS NO_INPUT_QUANTITY rpm1-1 11 -30000.0 30000.0 DEPOSIT ABSOLUTE FORMAT "%.2" /end AXIS_DESCR
/end CHARACTERISTIC
/begin CHARACTERISTIC Torque_Increment_General_M11 "通用AD修正转矩给定每周期增量" CURVE 0x786D4C ECTEK_Curve_s16s16 0 NO_FORMULA -100.0 100.0 FORMAT "%.2" BIT_MASK 0xFFFF
 /begin AXIS_DESCR STD_AXIS NO_INPUT_QUANTITY Vmh10ms 11 -1000.0 1000.0 DEPOSIT ABSOLUTE FORMAT "%.2" /end AXIS_DESCR
/end CHARACTERISTIC
/begin CHARACTERISTIC Speed_Vmh10ms_D_Park_M11 "D档驻坡 转速-AD曲线 rpm----mh10ms" CURVE 0x786D7A ECTEK_Curve_s16s16 0 Vmh10ms -500.0 500.0 FORMAT "%.2" BIT_MASK 0xFFFF
 /begin AXIS_DESCR STD_AXIS NO_INPUT_QUANTITY rpm1-1 12 -15000.0 15000.0 DEPOSIT ABSOLUTE FORMAT "%.2" /end AXIS_DESCR
/end CHARACTERISTIC
/begin CHARACTERISTIC Torque_Increment_D_Park_M11 "D档驻坡AD修正转矩给定每周期增量" CURVE 0x786DAC ECTEK_Curve_s16s16 0 NO_FORMULA -100.0 100.0 FORMAT "%.2" BIT_MASK 0xFFFF
 /begin AXIS_DESCR STD_AXIS NO_INPUT_QUANTITY Vmh10ms 11 -1000.0 1000.0 DEPOSIT ABSOLUTE FORMAT "%.2" /end AXIS_DESCR
/end CHARACTERISTIC
/begin CHARACTERISTIC Motor_Speed_Torque_Break_M11 "电机最大制动力矩" CURVE 0x786DDA ECTEK_Curve_s16s16 0 NO_FORMULA -5000.0 5000.0 FORMAT "%.2" BIT_MASK 0xFFFF
 /begin AXIS_DESCR STD_AXIS NO_INPUT_QUANTITY rpm1-1 14 -15000.0 15000.0 DEPOSIT ABSOLUTE FORMAT "%.2" /end AXIS_DESCR
/end CHARACTERISTIC
/begin CHARACTERISTIC FeedBack_Coast_D_Torque_M11 "D档滑行回馈 速度-力矩  定点" CURVE 0x786E14 ECTEK_Curve_s16s16 0 NO_FORMULA -5000.0 5000.0 FORMAT "%.2" BIT_MASK 0xFFFF
 /begin AXIS_DESCR STD_AXIS NO_INPUT_QUANTITY rpm1-1 8 -15000.0 15000.0 DEPOSIT ABSOLUTE FORMAT "%.2" /end AXIS_DESCR
/end CHARACTERISTIC
/begin CHARACTERISTIC FeedBack_Break_D_Torque_M11 "D档制动回馈 速度-力矩 定点" CURVE 0x786E36 ECTEK_Curve_s16s16 0 NO_FORMULA -5000.0 5000.0 FORMAT "%.2" BIT_MASK 0xFFFF
 /begin AXIS_DESCR STD_AXIS NO_INPUT_QUANTITY rpm1-1 8 -15000.0 15000.0 DEPOSIT ABSOLUTE FORMAT "%.2" /end AXIS_DESCR
/end CHARACTERISTIC
/begin CHARACTERISTIC Speed_Efficieny_M11 "电机速度-转换效率曲线 驱动" CURVE 0x786E58 ECTEK_Curve_u16u16 0 rFactor100_PWM 0.0 100.0 FORMAT "%.2" BIT_MASK 0xFFFF
 /begin AXIS_DESCR STD_AXIS NO_INPUT_QUANTITY rpm1-1 20 0.0 15000.0 DEPOSIT ABSOLUTE FORMAT "%.2" /end AXIS_DESCR
/end CHARACTERISTIC
/begin CHARACTERISTIC Speed_Efficieny_FeedBack_M11 "电机速度-转换效率曲线 发电" CURVE 0x786EAA ECTEK_Curve_u16u16 0 rFactor100_PWM 0.0 150.0 FORMAT "%.2" BIT_MASK 0xFFFF
 /begin AXIS_DESCR STD_AXIS NO_INPUT_QUANTITY rpm1-1 20 0.0 15000.0 DEPOSIT ABSOLUTE FORMAT "%.2" /end AXIS_DESCR
/end CHARACTERISTIC
/begin CHARACTERISTIC AutoPark_Motor_Speed_Torque_M11 "驻坡最大力矩" CURVE 0x786EFC ECTEK_Curve_u16s16 0 NO_FORMULA 0.0 5000.0 FORMAT "%.2" BIT_MASK 0xFFFF
 /begin AXIS_DESCR STD_AXIS NO_INPUT_QUANTITY rpm1-1 8 -15000.0 15000.0 DEPOSIT ABSOLUTE FORMAT "%.2" /end AXIS_DESCR
/end CHARACTERISTIC
/begin CHARACTERISTIC AccPedCD_rUW_CUR_M11 "油门开度" CURVE 0x786F1E ECTEK_Curve_u16u16 0 rFactor100_PWM 0.0 100.0 FORMAT "%.2" BIT_MASK 0xFFFF
 /begin AXIS_DESCR STD_AXIS NO_INPUT_QUANTITY u5V 7 0.0 5.0 DEPOSIT ABSOLUTE FORMAT "%.2" /end AXIS_DESCR
/end CHARACTERISTIC
/begin CHARACTERISTIC AccPedCD_rUW_CUR2_M11 "油门2开度" CURVE 0x786F3C ECTEK_Curve_u16u16 0 rFactor100_PWM 0.0 100.0 FORMAT "%.2" BIT_MASK 0xFFFF
 /begin AXIS_DESCR STD_AXIS NO_INPUT_QUANTITY u5V 7 0.0 5.0 DEPOSIT ABSOLUTE FORMAT "%.2" /end AXIS_DESCR
/end CHARACTERISTIC
/begin CHARACTERISTIC INS_Scale "临时仪表类型速比 程序内部已经除100" VALUE 0x786F5A ECTEK_Value_u8 0 NO_FORMULA 1.0 255.0 FORMAT "%.2" BIT_MASK 0xFF /end CHARACTERISTIC
/begin RECORD_LAYOUT ECTEK_AscII32 FNC_VALUES 1 UBYTE COLUMN_DIR DIRECT FIX_NO_AXIS_PTS_X 32 ALIGNMENT_BYTE 1 ALIGNMENT_WORD 1 ALIGNMENT_LONG 1 ALIGNMENT_FLOAT32_IEEE 1 ALIGNMENT_FLOAT64_IEEE 1 /end RECORD_LAYOUT
/begin RECORD_LAYOUT ECTEK_AscII16 FNC_VALUES 1 UBYTE COLUMN_DIR DIRECT FIX_NO_AXIS_PTS_X 16 ALIGNMENT_BYTE 1 ALIGNMENT_WORD 1 ALIGNMENT_LONG 1 ALIGNMENT_FLOAT32_IEEE 1 ALIGNMENT_FLOAT64_IEEE 1 /end RECORD_LAYOUT
/begin RECORD_LAYOUT ECTEK_ValueBlock24_u8 FNC_VALUES 1 UBYTE COLUMN_DIR DIRECT FIX_NO_AXIS_PTS_X 24 ALIGNMENT_BYTE 1 ALIGNMENT_WORD 1 ALIGNMENT_LONG 1 ALIGNMENT_FLOAT32_IEEE 1 ALIGNMENT_FLOAT64_IEEE 1 /end RECORD_LAYOUT
/begin RECORD_LAYOUT ECTEK_ValueBlock18_u8 FNC_VALUES 1 UBYTE COLUMN_DIR DIRECT FIX_NO_AXIS_PTS_X 18 ALIGNMENT_BYTE 1 ALIGNMENT_WORD 1 ALIGNMENT_LONG 1 ALIGNMENT_FLOAT32_IEEE 1 ALIGNMENT_FLOAT64_IEEE 1 /end RECORD_LAYOUT
/begin RECORD_LAYOUT ECTEK_ValueBlock18_u16 FNC_VALUES 1 UWORD COLUMN_DIR DIRECT FIX_NO_AXIS_PTS_X 18 ALIGNMENT_BYTE 1 ALIGNMENT_WORD 1 ALIGNMENT_LONG 1 ALIGNMENT_FLOAT32_IEEE 1 ALIGNMENT_FLOAT64_IEEE 1 /end RECORD_LAYOUT
/begin RECORD_LAYOUT ECTEK_Value_u16 FNC_VALUES 1 UWORD ROW_DIR DIRECT ALIGNMENT_BYTE 1 ALIGNMENT_WORD 1 ALIGNMENT_LONG 1 ALIGNMENT_FLOAT32_IEEE 1 ALIGNMENT_FLOAT64_IEEE 1 /end RECORD_LAYOUT
/begin RECORD_LAYOUT ECTEK_Value_u8 FNC_VALUES 1 UBYTE ROW_DIR DIRECT ALIGNMENT_BYTE 1 ALIGNMENT_WORD 1 ALIGNMENT_LONG 1 ALIGNMENT_FLOAT32_IEEE 1 ALIGNMENT_FLOAT64_IEEE 1 /end RECORD_LAYOUT
/begin RECORD_LAYOUT ECTEK_ValueBlock4_u8 FNC_VALUES 1 UBYTE COLUMN_DIR DIRECT FIX_NO_AXIS_PTS_X 4 ALIGNMENT_BYTE 1 ALIGNMENT_WORD 1 ALIGNMENT_LONG 1 ALIGNMENT_FLOAT32_IEEE 1 ALIGNMENT_FLOAT64_IEEE 1 /end RECORD_LAYOUT
/begin RECORD_LAYOUT ECTEK_ValueBlock2_u8 FNC_VALUES 1 UBYTE COLUMN_DIR DIRECT FIX_NO_AXIS_PTS_X 2 ALIGNMENT_BYTE 1 ALIGNMENT_WORD 1 ALIGNMENT_LONG 1 ALIGNMENT_FLOAT32_IEEE 1 ALIGNMENT_FLOAT64_IEEE 1 /end RECORD_LAYOUT
/begin RECORD_LAYOUT ECTEK_ValueBlock16_u8 FNC_VALUES 1 UBYTE COLUMN_DIR DIRECT FIX_NO_AXIS_PTS_X 16 ALIGNMENT_BYTE 1 ALIGNMENT_WORD 1 ALIGNMENT_LONG 1 ALIGNMENT_FLOAT32_IEEE 1 ALIGNMENT_FLOAT64_IEEE 1 /end RECORD_LAYOUT
/begin RECORD_LAYOUT ECTEK_Value_u32 FNC_VALUES 1 ULONG ROW_DIR DIRECT ALIGNMENT_BYTE 1 ALIGNMENT_WORD 1 ALIGNMENT_LONG 1 ALIGNMENT_FLOAT32_IEEE 1 ALIGNMENT_FLOAT64_IEEE 1 /end RECORD_LAYOUT
/begin RECORD_LAYOUT ECTEK_ValueBlock3_u16 FNC_VALUES 1 UWORD COLUMN_DIR DIRECT FIX_NO_AXIS_PTS_X 3 ALIGNMENT_BYTE 1 ALIGNMENT_WORD 1 ALIGNMENT_LONG 1 ALIGNMENT_FLOAT32_IEEE 1 ALIGNMENT_FLOAT64_IEEE 1 /end RECORD_LAYOUT
/begin RECORD_LAYOUT ECTEK_AscII10 FNC_VALUES 1 UBYTE COLUMN_DIR DIRECT FIX_NO_AXIS_PTS_X 10 ALIGNMENT_BYTE 1 ALIGNMENT_WORD 1 ALIGNMENT_LONG 1 ALIGNMENT_FLOAT32_IEEE 1 ALIGNMENT_FLOAT64_IEEE 1 /end RECORD_LAYOUT
/begin RECORD_LAYOUT ECTEK_ValueBlock4_u32 FNC_VALUES 1 ULONG COLUMN_DIR DIRECT FIX_NO_AXIS_PTS_X 4 ALIGNMENT_BYTE 1 ALIGNMENT_WORD 1 ALIGNMENT_LONG 1 ALIGNMENT_FLOAT32_IEEE 1 ALIGNMENT_FLOAT64_IEEE 1 /end RECORD_LAYOUT
/begin RECORD_LAYOUT ECTEK_ValueBlock4_u16 FNC_VALUES 1 UWORD COLUMN_DIR DIRECT FIX_NO_AXIS_PTS_X 4 ALIGNMENT_BYTE 1 ALIGNMENT_WORD 1 ALIGNMENT_LONG 1 ALIGNMENT_FLOAT32_IEEE 1 ALIGNMENT_FLOAT64_IEEE 1 /end RECORD_LAYOUT
/begin RECORD_LAYOUT ECTEK_ValueBlock8_u8 FNC_VALUES 1 UBYTE COLUMN_DIR DIRECT FIX_NO_AXIS_PTS_X 8 ALIGNMENT_BYTE 1 ALIGNMENT_WORD 1 ALIGNMENT_LONG 1 ALIGNMENT_FLOAT32_IEEE 1 ALIGNMENT_FLOAT64_IEEE 1 /end RECORD_LAYOUT
/begin RECORD_LAYOUT ECTEK_Curve_u16u16 FNC_VALUES 3 UWORD ROW_DIR DIRECT AXIS_PTS_X 2 UWORD INDEX_INCR DIRECT NO_AXIS_PTS_X 1 UWORD ALIGNMENT_BYTE 1 ALIGNMENT_WORD 1 ALIGNMENT_LONG 1 ALIGNMENT_FLOAT32_IEEE 1 ALIGNMENT_FLOAT64_IEEE 1 /end RECORD_LAYOUT
/begin RECORD_LAYOUT ECTEK_Map_u16u16u16 FNC_VALUES 5 UWORD COLUMN_DIR DIRECT AXIS_PTS_X 3 UWORD INDEX_INCR DIRECT AXIS_PTS_Y 4 UWORD INDEX_INCR DIRECT NO_AXIS_PTS_X 1 UWORD NO_AXIS_PTS_Y 2 UWORD ALIGNMENT_BYTE 1 ALIGNMENT_WORD 1 ALIGNMENT_LONG 1 ALIGNMENT_FLOAT32_IEEE 1 ALIGNMENT_FLOAT64_IEEE 1 /end RECORD_LAYOUT
/begin RECORD_LAYOUT ECTEK_ValueBlock7_u8 FNC_VALUES 1 UBYTE COLUMN_DIR DIRECT FIX_NO_AXIS_PTS_X 7 ALIGNMENT_BYTE 1 ALIGNMENT_WORD 1 ALIGNMENT_LONG 1 ALIGNMENT_FLOAT32_IEEE 1 ALIGNMENT_FLOAT64_IEEE 1 /end RECORD_LAYOUT
/begin RECORD_LAYOUT ECTEK_Value_s16 FNC_VALUES 1 SWORD ROW_DIR DIRECT ALIGNMENT_BYTE 1 ALIGNMENT_WORD 1 ALIGNMENT_LONG 1 ALIGNMENT_FLOAT32_IEEE 1 ALIGNMENT_FLOAT64_IEEE 1 /end RECORD_LAYOUT
/begin RECORD_LAYOUT ECTEK_Curve_u16s16 FNC_VALUES 3 UWORD ROW_DIR DIRECT AXIS_PTS_X 2 SWORD INDEX_INCR DIRECT NO_AXIS_PTS_X 1 UWORD ALIGNMENT_BYTE 1 ALIGNMENT_WORD 1 ALIGNMENT_LONG 1 ALIGNMENT_FLOAT32_IEEE 1 ALIGNMENT_FLOAT64_IEEE 1 /end RECORD_LAYOUT
/begin RECORD_LAYOUT ECTEK_Curve_s16s16 FNC_VALUES 3 SWORD ROW_DIR DIRECT AXIS_PTS_X 2 SWORD INDEX_INCR DIRECT NO_AXIS_PTS_X 1 UWORD ALIGNMENT_BYTE 1 ALIGNMENT_WORD 1 ALIGNMENT_LONG 1 ALIGNMENT_FLOAT32_IEEE 1 ALIGNMENT_FLOAT64_IEEE 1 /end RECORD_LAYOUT
/begin RECORD_LAYOUT ECTEK_Value_s8 FNC_VALUES 1 SBYTE ROW_DIR DIRECT ALIGNMENT_BYTE 1 ALIGNMENT_WORD 1 ALIGNMENT_LONG 1 ALIGNMENT_FLOAT32_IEEE 1 ALIGNMENT_FLOAT64_IEEE 1 /end RECORD_LAYOUT
/begin RECORD_LAYOUT ECTEK_Curve_s16u16 FNC_VALUES 3 SWORD ROW_DIR DIRECT AXIS_PTS_X 2 UWORD INDEX_INCR DIRECT NO_AXIS_PTS_X 1 UWORD ALIGNMENT_BYTE 1 ALIGNMENT_WORD 1 ALIGNMENT_LONG 1 ALIGNMENT_FLOAT32_IEEE 1 ALIGNMENT_FLOAT64_IEEE 1 /end RECORD_LAYOUT
/end MODULE
/end PROJECT
